    db     "'1'*1-39+24/(3,163)/2",0,17
    db     "136-115-'Z'",0,187
    db     "76/30*(5,(1,'['))",0,102
    db     "120+109",0,229
    db     "(3,(3,71))/42-14-199/14",0,3
    db     "(1,(7,151))/52-171/18",0,4
    db     "'-'/1*(6,(7,12))-204/1/29",0,3
    db     "'3'-'L'+196+250-94/(7,118)+'-'",0,47
    db     "86+'N'/'.'-148",0,111
    db     "108-(4,47)/32*52",0,156
    db     "(3,74)-175/31",0,4
    db     "(0,(7,146))-10/46-23",0,235
    db     "218/80-131",0,127
    db     "'7'/23-29-212",0,17
    db     "140/37*48+'O'/98",0,2
    db     "(4,221)-184+119",0,254
    db     "217-183+17/11",0,4
    db     "'A'+20+'='-2+112",0,0
    db     "162+98*12/(2,'B')*(4,171)",0,0
    db     "(5,249)+216",0,188
    db     "'R'+195",0,21
    db     "(1,34)+96",0,25
    db     "(4,146)+5/'V'*((4,36),61)",0,2
    db     "(4,252)*16-131-'6'/'7'",0,2
    db     "189-126/(5,153)-10+126-136",0,1
    db     "225-(4,71)+248-(4,'5')",0,76
    db     "116+252-211",0,157
    db     "76/29+130-14",0,118
    db     "100+'_'+':'/'B'*'!'",0,99
    db     "171+88*28/(0,'O')+(4,208)",0,58
    db     "(5,232)/(3,120)*(1,164)+'1'",0,55
    db     "'P'-221+233-136",0,212
    db     "'^'/(2,212)-209-(5,233)+8",0,149
    db     "194+128",0,66
    db     "157+135",0,36
    db     "4+','/23+'?'/(2,125)-(4,')')",0,240
    db     "161+78+47",0,30
    db     "(4,98)",0,0
    db     "(0,241)-85/34+80-177+95+143",0,144
    db     "173-74/'0'*99",0,198
    db     "(0,(2,52))*29+(1,244)+(4,151)",0,233
    db     "52+'4'-219",0,141
    db     "152/(0,(7,166))/42*59",0,177
    db     "(1,2)-'8'+(6,(7,16))+116-'D'+'W'",0,202
    db     "(7,140)-106+95+205+118",0,68
    db     "(1,77)-'Y'+1-214+167",0,119
    db     "26+(7,132)/(0,'Y')-(4,(1,(4,75)))+','",0,106
    db     "134/'4'+252/'J'",0,3
    db     "(7,215)/23*0+182-5/(1,201)+247",0,168
    db     "200-'N'/8",0,15
    db     "246+190+'M'-(0,247)-'>'",0,198
    db     "'$'-'*'",0,250
    db     "'F'+(0,48)-(4,39)-(0,'V')",0,35
    db     "101+225",0,70
    db     "67+(2,247)/32-254",0,6
    db     "65-101-222",0,254
    db     "133/25",0,5
    db     "87+'F'+226",0,127
    db     "(6,71)/34",0,4
    db     "68+210/(6,2)",0,5
    db     "'0'/22-200-217",0,97
    db     "(7,221)/4*(5,202)",0,150
    db     "242+152-190",0,204
    db     "105+'+'",0,148
    db     "77-'/'*(0,(2,23))+237",0,11
    db     "228/'O'+51+27",0,80
    db     "(3,125)-251+'S'-'^'-'-'",0,229
    db     "82+120-53/'('+25",0,28
    db     "216-143+207-85/'D'",0,2
    db     "44-187-'*'-160+41-68",0,140
    db     "113/'!'*(6,(5,78))+'J'",0,7
    db     "82-113+152",0,121
    db     "163/'7'*'O'-67/'#'",0,2
    db     "'1'+38-203/(3,214)+195-'='",0,204
    db     "132-(7,(7,'H'))+(0,121)+'G'/'.'",0,2
    db     "192-34",0,158
    db     "111+88/60",0,3
    db     "137-(6,222)+145",0,81
    db     "134+237/26",0,4
    db     "116+(7,89)-94",0,119
    db     "185/(6,70)+(2,(3,187))",0,3
    db     "44/7+(3,156)+38-(4,219)",0,129
    db     "'_'/3*(4,211)",0,0
    db     "28+176+29-201",0,32
    db     "96+'M'-196+33-116",0,150
    db     "1-'F'",0,187
    db     "')'/(1,201)-1",0,40
    db     "(1,86)-159-199/(2,')')+158",0,12
    db     "(5,'G')+213-208/(6,119)",0,199
    db     "181/(3,'Q')+26-165",0,119
    db     "102/'+'+113-203",0,168
    db     "162/'9'*((7,243),218)",0,126
    db     "25*(0,(7,112))+'Q'/'$'",0,3
    db     "63/(5,'N')",0,15
    db     "'B'/22+183-(6,(6,253))-'2'",0,85
    db     "157-'4'",0,105
    db     "'#'/9-(2,123)/(6,(3,205))",0,15
    db     "33-225-192-'5'+'?'",0,138
    db     "133-'Y'*(7,38)*(6,58)-116-' '/21",0,5
    db     "'P'/14*45+117+5-22",0,69
    db     "183-230+209",0,162
    db     "125+'0'+(5,176)",0,113
    db     "142/13-173/15",0,6
    db     "192+78+(4,(1,200))/41+'.'",0,50
    db     "159-(7,(0,'K'))/28+206/'['+96/16",0,6
    db     "164-95-68*9",0,9
    db     "100/(0,89)*2/(5,39)*(0,43)",0,200
    db     "'B'/17",0,3
    db     "35+25-19",0,41
    db     "39*(6,'-')*(6,230)",0,117
    db     "(2,70)*(5,'7')/(2,(2,(5,'7')))/(6,242)-28",0,251
    db     "(2,54)-237+118-156",0,237
    db     "((0,39),100)/27+90",0,95
    db     "(3,',')-107-194/(5,(1,3))+187",0,189
    db     "51+'#'+'2'/(7,'[')",0,22
    db     "(4,'J')-26/(6,(0,'+'))*86-(6,2)/39",0,4
    db     "31+190/'S'+'F'",0,72
    db     "7*11+90",0,167
    db     "49*2+'8'+118-21/'5'",0,4
    db     "124+39-7/13",0,12
    db     "174+103/8",0,2
    db     "56-31-209",0,72
    db     "1-213+(1,208)",0,40
    db     "85/(3,'M')+(3,91)-136",0,145
    db     "200/26+(3,213)+(5,79)",0,207
    db     "'+'+248*(7,192)+204-'4'",0,187
    db     "72/((5,68),88)*24-77-(0,(5,151))-'T'/1",0,12
    db     "(0,120)+103/'T'",0,2
    db     "43-170-':'+(2,(7,119))",0,215
    db     "250-(5,183)/70-233-168",0,114
    db     "(2,88)/13-'<'",0,198
    db     "((3,' '),'/')-156/(4,'=')-246",0,17
    db     "(1,(5,(5,(5,65))))-19",0,129
    db     "60-(2,85)-(0,'F')/57*'>'-68",0,180
    db     "62-'/'+8",0,23
    db     "'W'-102+228/11-104-'+'",0,128
    db     "(7,94)*(2,143)-(1,187)",0,254
    db     "((2,74),100)+224/74",0,2
    db     "'Q'-112-185-(1,241)",0,102
    db     "'N'/31",0,2
    db     "33+184+(5,49)",0,197
    db     "(2,67)+246/'4'-1",0,2
    db     "202-180*(0,39)+((5,0),87)",0,152
    db     "'%'*(5,213)+'#'",0,72
    db     "'4'-206",0,102
    db     "178+197+(1,94)+178+107+232",0,252
    db     "'S'-101-86/50+84",0,87
    db     "78+'X'+(1,215)-120/'('",0,6
    db     "34*(1,111)-72+(5,(6,3))-115-196",0,71
    db     "153-85/20-5",0,254
    db     "166+48/62-193",0,66
    db     "198/(2,210)-(2,113)+177+217",0,157
    db     "88-(4,89)+248+'F'",0,160
    db     "24+40-104-'X'",0,128
    db     "194/(2,(7,166))*(4,'=')+8",0,158
    db     "(3,'Q')+122-209",0,233
    db     "(1,(1,86))+'Y'+66/'2'",0,3
    db     "94+161-(2,'-')-183-(6,95)+(7,78)",0,207
    db     "198-232/51+'C'",0,71
    db     "189+65",0,254
    db     "165+(1,16)+58-136",0,82
    db     "(4,124)+(6,'P')-45/4*18",0,180
    db     "((7,'O'),38)+(5,(5,17))-69/28*26",0,156
    db     "152/70-(0,61)+199",0,3
    db     "95/36",0,2
    db     "'G'+249",0,64
    db     "63+(0,146)-(2,(3,251))",0,61
    db     "(4,(7,(7,(4,55))))/29-(3,233)*51",0,204
    db     "50+'C'-253",0,120
    db     "10*(3,34)+5/4",0,3
    db     "170+'L'",0,246
    db     "(1,233)+51-(4,(0,189))*(5,'D')",0,129
    db     "142-22-229-163",0,240
    db     "94",0,94
    db     "226+87/(0,(7,103))+(1,18)-91-98",0,84
    db     "((5,89),'?')+184-191+79",0,17
    db     "(1,199)-177+149/'2'",0,4
    db     "25/10-109-207",0,198
    db     "242+252-29",0,209
    db     "142+(1,65)-(0,78)",0,246
    db     "17+61/21-48/'5'*49-86",0,61
    db     "26+162+253",0,185
    db     "238/'U'*'?'-'U'-209+(2,39)",0,120
    db     "(2,5)/'0'+54-214/10",0,9
    db     "(0,'>')*67/(5,0)-'#'",0,32
    db     "'A'+101",0,166
    db     "(5,(3,'['))-132/29-60",0,199
    db     "187+26",0,213
    db     "4*16/(4,163)*44",0,88
    db     "250+205/(4,87)+(6,195)-'U'",0,112
    db     "'E'-229+'J'/'I'+145-'E'",0,78
    db     "68+(6,(5,126))+159",0,183
    db     "'U'-191+164-177",0,137
    db     "221-(7,190)+133+201/26*27",0,108
    db     "6*3*(1,232)-'V'+204",0,118
    db     "(7,210)+'-'",0,107
    db     "'3'-149-216-162*(6,(2,8))",0,0
    db     "58+(6,200)",0,56
    db     "182/'F'*'K'/37",0,4
    db     "168-(7,15)+122+'%'",0,131
    db     "190/41+248-99",0,153
    db     "144+(0,3)+176+232",0,184
    db     "142+21/73*49",0,98
    db     "150+'U'+94",0,73
    db     "242+175",0,161
    db     "' '-'U'+71+156/35*40",0,160
    db     "137+134/(4,(3,139))/(1,(0,'X'))*3+88",0,133
    db     "109+138/101+139+177",0,62
    db     "68-148+0/40*'-'",0,180
    db     "(0,'+')+201+107+194+(3,34)",0,1
    db     "172/22-']'/21",0,8
    db     "92-167-115-(7,11)",0,3
    db     "(7,(0,'('))/'3'*31",0,124
    db     "(7,'G')/44+185",0,188
    db     "87/'#'+47+'V'",0,135
    db     "(0,242)+22/3-'R'+211",0,135
    db     "16-145",0,127
    db     "93/33",0,2
    db     "7*((0,173),224)/10-131+'I'+69*1",0,16
    db     "25*(3,(2,195))+111",0,111
    db     "151-157+129/28",0,4
    db     "116/27*42",0,168
    db     "(6,'=')+'B'*27",0,81
    db     "']'+54/(7,74)+111/(0,189)+(1,'A')-182",0,188
    db     "'A'/3+'4'-148-(7,206)",0,195
    db     "23*4+(0,'C')-7+'O'-'I'",0,92
    db     "135/57-184",0,74
    db     "'<'-'G'+127+(1,107)+239+117/'('",0,2
    db     "243/112*120-(4,(1,206))-((6,'*'),79)",0,59
    db     "(3,(7,25))/'&'*3-'X'",0,186
    db     "41/5-111",0,153
    db     "216/36-1",0,5
    db     "92/(7,153)-(3,205)-181/23",0,7
    db     "70-209/55+'<'/2+'U'-185",0,187
    db     "'F'/7*6/(6,'-')",0,60
    db     "213+'&'/73",0,3
    db     "(3,(0,105))+249-'B'-225/20",0,10
    db     "198-(7,(2,(1,189)))+224/82*32-(3,12)-31",0,92
    db     "(6,77)+184",0,239
    db     "'O'/' '+244+196/(2,8)-(1,10)",0,9
    db     "205/57*(4,190)",0,18
    db     "31+'Q'-231/30+122+231",0,101
    db     "221-'('+58-240-170-26/(5,68)",0,19
    db     "(5,90)+'/'*(6,62)",0,0
    db     "154-34/'$'*((7,((4,177),98)),(7,63))*35+165/22",0,5
    db     "77-197+'G'",0,207
    db     "'0'/(3,1)-'X'",0,216
    db     "220-196",0,24
    db     "(0,'#')+224",0,164
    db     "137+'*'/19*0-33",0,223
    db     "10*20-240/'6'-127",0,133
    db     "181+9/32-232+12-42+'='",0,60
    db     "'Y'/12+((7,12),'G')+202/'-'",0,2
    db     "'H'",0,72
    db     "164-155",0,9
    db     "66/8*25/38*0-(1,235)",0,255
    db     "119/9-0*3+'P'/10",0,11
    db     "138+(2,86)+51",0,190
    db     "','/(6,10)-((0,183),89)/38",0,3
    db     "(7,206)-(3,(2,'U'))+99-175/'U'",0,2
    db     "(6,159)-55+101",0,48
    db     "(0,((7,'#'),86))+174-'Y'-196-36",0,47
    db     "134/12+155",0,166
    db     "(6,210)/'1'-(1,96)/(2,'J')+157/','",0,4
    db     "'O'-(2,108)*0+64",0,64
    db     "'K'+23-131+' '+(1,(5,((6,137),162)))/'&'*(0,108)",0,5
    db     "(5,30)+195+163/2",0,22
    db     "128",0,128
    db     "97-171+((3,144),'.')-121*52+11",0,63
    db     "67-'0'+2*(0,'>')+(7,((4,'?'),197))-130-154",0,151
    db     "20+'D'+38+60+152-103",0,235
    db     "42-'7'/'&'*(1,193)-222",0,52
    db     "21/1-152",0,125
    db     "(3,'6')+'C'*7",0,28
    db     "49+163+237/91*76+(5,141)/'%'",0,2
    db     "(1,250)/63*'T'",0,252
    db     "244-195*(4,250)+145-187",0,7
    db     "'W'-(2,149)+94+167-(7,'K')-108+(6,(6,142))",0,162
    db     "17-223+60",0,110
    db     "48-225/(7,'N')+(0,(5,226))",0,4
    db     "167-193/110-75-(4,41)",0,158
    db     "35+132-226",0,197
    db     "' '*(2,201)-'X'",0,232
    db     "(1,215)/9+198-237-35",0,204
    db     "35*6+138-'('/17-126-'='",0,72
    db     "'J'+153+(2,137)/57",0,4
    db     "(5,14)+189",0,191
    db     "(1,'B')/'T'-156/'*'",0,2
    db     "'1'/22*(4,'-')-(5,99)-(4,'V')",0,238
    db     "(2,131)/9*8/16-238+122",0,147
    db     "2*79/'1'+153/23",0,6
    db     "167+'B'",0,233
    db     "228+213/'Y'+50+(7,97)",0,60
    db     "(1,59)+(5,202)-' '",0,239
    db     "45/(7,82)",0,15
    db     "'8'/(3,(0,112))+(2,'W')-(1,37)+77",0,141
    db     "65+(1,107)/10/7-17",0,241
    db     "149+175/(5,'I')*(3,(5,'+'))",0,24
    db     "126/23-66+47",0,242
    db     "4*51+'6'",0,2
    db     "68/14",0,4
    db     "'_'/24+227",0,230
    db     "(2,66)/(7,((4,7),66))-121",0,141
    db     "176+222-99+99/56",0,2
    db     "236/'&'+97",0,103
    db     "150/66+112/14+186-130",0,64
    db     "134+227",0,105
    db     "(7,(1,53))-240",0,114
    db     "128-68",0,60
    db     "'6'-87/16-226-(4,65)-81",0,214
    db     "111+(7,'U')+9-(2,190)",0,60
    db     "42*(2,(4,95))+219-4/(7,(1,54))",0,8
    db     "162-205-249/((3,93),134)",0,18
    db     "'B'+204*11",0,154
    db     "111/38-86/':'+195",0,197
    db     "116+(1,46)-'C'+202+51",0,248
    db     "')'-96/33-(4,'R')-135/70",0,2
    db     "'B'/(7,177)+'P'",0,146
    db     "68+(3,100)/32*41",0,164
    db     "214-115-(1,(3,206))-58",0,44
    db     "70/12+45-(6,61)+((6,33),9)",0,99
    db     "215/89-245*11/52+12*(5,95)",0,14
    db     "'5'/(7,94)",0,7
    db     "'%'+66+(0,(1,124))-156+'9'",0,206
    db     "140+36-138",0,38
    db     "62+240/(5,(0,27))",0,3
    db     "'H'/24-'<'",0,199
    db     "102",0,102
    db     "(0,'_')-192/(7,146)/8*42",0,84
    db     "35+28+43/40-']'+29",0,194
    db     "(6,'#')-8+'$'",0,226
    db     "192/'Z'*28-(0,225)-(2,125)/'2'",0,3
    db     "106-104*4-39/45-63",0,198
    db     "66-81+'G'-(4,(3,180))-'?'/8",0,9
    db     "','-77-250/'F'*'<'+0",0,180
    db     "(1,(2,37))/(0,71)*20-136",0,24
    db     "(3,109)-120-((1,167),7)-'H'",0,91
    db     "63/17-116/10*(7,143)+189",0,45
    db     "58/(5,153)*7+172",0,49
    db     "214-'C'+32",0,179
    db     "(0,(1,'Y'))+171+(7,132)/91+210-212",0,0
    db     "19/3-(6,'&')",0,64
    db     "'!'-12+'P'-72*(2,(4,'5'))*4",0,116
    db     "64/(3,181)+206-190+21/17-147",0,112
    db     "(3,'1')+'C'+181",0,115
    db     "114/43-103+53",0,208
    db     "83+(5,213)/(7,103)*(4,183)*'3'",0,153
    db     "'&'+253*(0,69)/15-235+125",0,150
    db     "33/(6,(6,9))/(4,36)+','/(2,137)",0,9
    db     "40*(7,(((4,65),60),(3,206)))/8-86",0,190
    db     "233+')'+158/45",0,3
    db     "159+(3,'^')-74-'R'",0,147
    db     "33/(2,(6,239))+(7,150)",0,81
    db     "78+151/61-158+191-75",0,217
    db     "138+135-102/33-65",0,196
    db     "'Y'/'+'-141",0,117
    db     "(2,188)-117+4",0,39
    db     "156-249+'+'",0,206
    db     "14/6-']'-'B'",0,99
    db     "47-'Z'+56/(7,23)+51-(5,148)",0,126
    db     "226/23+(5,55)*(5,142)-239-115-' '",0,166
    db     "'2'-70-7/110*113",0,226
    db     "144-242/52-(4,76)-'0'",0,148
    db     "175/'9'*66",0,198
    db     "54-27/((5,25),87)-102",0,163
    db     "(0,(2,179))/10/2-164",0,101
    db     "222+85+183",0,234
    db     "32/7+249",0,253
    db     "19+175-85-'P'*5/'+'",0,3
    db     "175/(5,109)-(2,'0')-(7,95)/41*((1,((5,7),34)),26)",0,213
    db     "174+173+161",0,252
    db     "241+235-232-203-158",0,139
    db     "'N'/33*64/17+'C'",0,74
    db     "(6,13)/'('+241+'L'",0,65
    db     "254-(0,121)+149+152-(2,198)",0,74
    db     "'7'+3+'F'",0,128
    db     "']'+6-165",0,190
    db     "82+85-229+45",0,239
    db     "(2,57)+243+(2,(6,182))",0,20
    db     "235-187-75+'K'-166-207",0,187
    db     "183-'@'-163/'7'*'L'",0,228
    db     "209+28+90-(3,70)-115+115",0,89
    db     "165-247-223/28+219-','",0,182
    db     "(4,29)*(3,(4,(1,230)))*(6,108)+'I'/8",0,5
    db     "51+241-140+168",0,64
    db     "31+6/14-151/')'",0,2
    db     "252/'4'",0,4
    db     "'9'/15+155/'?'",0,2
    db     "109/(6,86)-119+49+42/106",0,2
    db     "(5,253)-(7,130)/'/'+127",0,131
    db     "(4,235)/88",0,2
    db     "(5,2)/'U'*')'-'B'-74-174",0,24
    db     "137+152-223-62+119+196",0,63
    db     "(6,226)-254+(((7,247),100),'N')+':'+141",0,2
    db     "(2,((6,':'),223))/82+165-30+161",0,42
    db     "178-104-122",0,208
    db     "252+109-203-(2,160)-34",0,187
    db     "'6'/16",0,3
    db     "(1,171)-(1,70)-144",0,235
    db     "42-169+'5'+96/4*'2'+190",0,184
    db     "68+224*(4,(1,215))-176",0,116
    db     "'H'-';'-'.'/6+170/45",0,4
    db     "'V'-227-240/(5,(0,141))",0,65
    db     "151+54-49-84",0,72
    db     "208+242+220+29+123",0,54
    db     "127+(3,6)+19",0,92
    db     "114",0,114
    db     "'C'/20-(6,236)-95",0,168
    db     "216+198+73-140-(5,'G')",0,153
    db     "'^'-201/'?'-206",0,52
    db     "201/(3,228)*(4,'&')+'['",0,59
    db     "240/'^'+21+226/(4,127)",0,20
    db     "(3,100)-94-62-206/'5'*6",0,24
    db     "82-(4,'2')/72*'U'-((1,(0,'P')),'1')",0,173
    db     "199+154-53+178/42",0,5
    db     "175/25",0,7
    db     "104+(3,(6,90))-'#'",0,192
    db     "(7,22)+70+212/84+47*(3,233)/31",0,3
    db     "98-174+18/40",0,4
    db     "225/1/(5,127)-15-')'-'['",0,112
    db     "26/(3,79)*8",0,208
    db     "'1'*(6,'5')+0",0,0
    db     "87/16-249",0,12
    db     "34/(5,'[')*8-'X'",0,48
    db     "(4,183)*85-185+124+241+105",0,114
    db     "248-203+29-((6,(0,200)),((7,177),(7,(5,'/'))))+((4,121),121)-52",0,212
    db     "((5,111),187)+77/90+247",0,249
    db     "177-163/(3,(5,215))+252",0,10
    db     "253+'S'/34*77",0,154
    db     "36-225/21+200+(0,155)",0,204
    db     "207-199-236",0,28
    db     "154/'3'",0,3
    db     "98-27/4/3+216/83",0,2
    db     "53+78/3-(1,'<')",0,81
    db     "171+250/'!'+5-'1'",0,217
    db     "17+196+197-130*(3,122)",0,0
    db     "(6,56)*(3,214)/31-67",0,191
    db     "115-34-'4'",0,29
    db     "26+103+34/'6'-127/'7'-141",0,117
    db     "125-(1,90)-240+121-166/(5,129)",0,31
    db     "(0,95)+114-231+170-(7,231)*(2,143)",0,0
    db     "134/')'-234-6*(3,((4,68),139))-(1,':')+(7,204)",0,67
    db     "244/18/(7,'$')+66",0,79
    db     "34+24-'M'-247",0,246
    db     "194+146/14+22/13",0,2
    db     "'_'-177/'I'",0,2
    db     "76-5+13-'L'",0,8
    db     "213/3-'?'*(7,12)",0,48
    db     "(6,4)-143-55",0,121
    db     "99-128/(7,204)+'4'",0,97
    db     "246+74+'.'/'6'+25",0,27
    db     "231/108",0,2
    db     "133+228+(4,0)",0,158
    db     "7+'G'",0,78
    db     "(3,61)+250-36/123+(3,176)+((0,33),192)",0,227
    db     "247+251+230",0,216
    db     "121+124",0,245
    db     "'S'",0,83
    db     "(6,168)-49-(2,'B')",0,191
    db     "52-250-'$'/(4,'#')",0,22
    db     "'8'/(4,(4,172))*7",0,63
    db     "72-(6,126)/8-117+31",0,172
    db     "'#'+134-179",0,246
    db     "29-((6,'E'),(6,240))-240",0,45
    db     "(7,'K')/(4,')')-212/(6,(6,196))-3+(4,4)-(5,'D')",0,104
    db     "(5,237)-(1,112)+(7,19)/106",0,2
    db     "'&'*4/(2,120)-(5,228)/19",0,12
    db     "'Z'+'5'+229-'2'",0,66
    db     "'L'+59/41*'L'+44-166/39",0,2
    db     "'Z'+'E'+130+165",0,198
    db     "(4,'<')-88/'<'",0,2
    db     "207-226+253",0,234
    db     "'D'+')'+'_'",0,204
    db     "9*6",0,54
    db     "(1,'7')-139-237",0,139
    db     "189/69-126",0,132
    db     "175+248-79",0,88
    db     "48+'6'-'>'",0,40
    db     "157+' '+41",0,230
    db     "'N'+105+(3,(7,114))",0,39
    db     "(7,170)/51-149+172*(4,(3,142))",0,26
    db     "105/27+204",0,207
    db     "100/(7,17)*102+136+'K'-6",0,153
    db     "206-100+65",0,171
    db     "(7,216)/6-'['/47+69",0,72
    db     "162+107*(6,188)-'W'/(5,109)/(6,86)",0,5
    db     "180+108+'_'+(6,99)+141/3",0,4
    db     "(6,77)-211+(4,245)/32",0,3
    db     "123-1",0,122
    db     "69-59-'='",0,205
    db     "87",0,87
    db     "182-(5,165)+67-'<'+164/6-21",0,243
    db     "51-15-160-36",0,96
    db     "(6,':')+134",0,134
    db     "6-(2,201)+(6,232)-'<'",0,234
    db     "64+196-((2,137),(5,39))+17",0,17
    db     "229+180-28/17-(5,42)/4+183",0,191
    db     "250-109+10-(0,(2,76))",0,202
    db     "65+232*(2,163)",0,82
    db     "72/30-(0,((0,'E'),'0'))",0,53
    db     "69-122-99-117",0,243
    db     "(4,'L')+(3,(7,135))/'*'",0,4
    db     "57+132/27-182+191",0,16
    db     "127/(6,'-')/53+'S'",0,85
    db     "126/60",0,2
    db     "245-135/42",0,2
    db     "9+85+196*(5,163)",0,102
    db     "182-97-150",0,191
    db     "70-(3,31)/')'",0,3
    db     "152-138+';'+252+'@'",0,133
    db     "'5'-6/15-71",0,188
    db     "'^'+'O'+'#'",0,208
    db     "184/'!'+(2,'V')+7+92",0,105
    db     "(3,'9')/65",0,3
    db     "'&'+64/')'-8/(4,8)+195+171",0,104
    db     "166+197+(6,115)/'Q'",0,2
    db     "186+187-' '+244",0,73
    db     "21-'A'",0,212
    db     "205-99-2+(4,(0,194))/'('",0,3
    db     "114/5+48+222*(0,194)",0,0
    db     "(6,((7,119),41))/(5,45)*(3,88)",0,84
    db     "245+'*'*(0,204)-'9'*(7,38)",0,36
    db     "149+'J'/108+(1,'W')/'&'+251",0,254
    db     "167-'8'/(6,146)-229/4-161",0,102
    db     "(0,',')/7-'3'",0,234
    db     "246-':'-'9'+72-202",0,1
    db     "20+0+101",0,121
    db     "175+129/(5,(6,135))",0,9
    db     "137/'!'+']'-163",0,190
    db     "116+248",0,108
    db     "(0,(7,(6,'0')))-82",0,172
    db     "178+68",0,246
    db     "187/'T'*'L'",0,152
    db     "'M'+115-251+139+'/'/44",0,2
    db     "(7,253)*17-'!'",0,35
    db     "47/(2,221)/(7,134)+186+78+99",0,110
    db     "137+133*7+227",0,69
    db     "(0,(3,'+'))-'7'/((0,175),106)+'D'",0,82
    db     "248/((4,190),((2,(6,181)),189))-63+30+98-')'",0,86
    db     "108-((4,81),219)+29+88",0,228
    db     "(4,(2,18))/22+170/60*46",0,92
    db     "97-((2,(7,'Z')),19)",0,159
    db     "129+4+37/47-'M'",0,182
    db     "(2,'&')/47-21/'9'",0,4
    db     "75+(5,118)-189",0,82
    db     "'%'+(5,248)+104",0,145
    db     "169/'8'*'K'-26+119-'+'",0,19
    db     "'M'/23*'J'-(5,'4')-246",0,26
    db     "51/21",0,2
    db     "61-27/(0,81)+191-19+154+'R'",0,157
    db     "151/35+';'+'8'",0,119
    db     "236-65+(7,(0,138))",0,13
    db     "12-71+33-104",0,126
    db     "84+'G'/27-63",0,198
    db     "(2,252)-(6,54)-249",0,158
    db     "205+204",0,153
    db     "179+147-55+'0'/8+231",0,238
    db     "'!'*(0,90)",0,66
    db     "72-'N'+(1,(1,(3,211)))+(3,157)-122",0,5
    db     "(6,229)-16-(0,12)",0,97
    db     "168-189/30",0,7
    db     "225/'P'+'^'",0,96
    db     "(3,42)/'%'+(6,142)",0,128
    db     "(6,114)-168-(3,144)",0,143
    db     "'@'+17-'I'*(3,209)",0,0
    db     "176+142+0",0,62
    db     "230-78+'&'/43-'Q'",0,179
    db     "159+(0,(1,'5'))-((6,92),45)-(7,152)-75",0,91
    db     "234-141-106",0,243
    db     "138/'='*(2,'_')",0,166
    db     "0+'Q'",0,81
    db     "129+75-(5,'Q')+208",0,92
    db     "209-(6,67)-24",0,169
    db     "70/34-(0,192)+73",0,44
    db     "'B'+170-125/(4,22)/(2,221)+199+(6,241)",0,251
    db     "24+251*(4,160)",0,228
    db     "'&'+(0,(3,(0,(7,(2,1)))))/'^'",0,2
    db     "'S'/33-108-'@'",0,86
    db     "2-'E'",0,189
    db     "99-161/83",0,2
    db     "81-(5,114)-190",0,209
    db     "(6,119)*'W'-217",0,126
    db     "229/34-62",0,200
    db     "206/'R'*'.'+155",0,247
    db     "'Z'+190/5",0,4
    db     "(6,9)+147+117",0,220
    db     "172",0,172
    db     "141+42",0,183
    db     "(0,219)/70+183+95-28+230-76",0,151
    db     "185-72/'3'-27/94+88",0,90
    db     "'O'+144+(2,49)/94*'6'",0,108
    db     "135/'6'*40",0,80
    db     "108+'I'/(5,(3,(5,218)))/(3,(3,'M'))",0,90
    db     "2+(1,24)+(2,50)-39",0,13
    db     "245+167+182-224-(0,56)/12",0,9
    db     "232+71/(6,92)-136-84-126",0,213
    db     "91+58+227+97-164",0,53
    db     "79+85/(4,75)",0,2
    db     "113/(5,142)*(0,'C')+'4'+217",0,41
    db     "155-182+91-'P'+48",0,32
    db     "(5,146)+16-152-'V'",0,66
    db     "157-103+(1,178)+(2,54)/84",0,2
    db     "129+176-9*5",0,200
    db     "184+190-(0,((0,194),189))/'C'",0,3
    db     "(4,33)-77-(0,78)*((((3,32),15),39),168)-195",0,154
    db     "76",0,76
    db     "(1,(5,(4,24)))+46*4+129-(1,188)+219+(0,102)",0,57
    db     "((3,144),86)+212",0,108
    db     "198-(4,74)/(2,'P')+60+29-'T'/19",0,3
    db     "234/(7,158)+(4,175)",0,3
    db     "'@'/3*((7,198),(4,168))+77+189",0,10
    db     "107/'('+120-172+(6,52)-'='",0,74
    db     "114/52+(3,1)+49",0,52
    db     "'&'/(0,245)/(7,177)-111",0,164
    db     "38-'3'/'^'",0,2
    db     "97+'('+(1,(6,(6,29)))/(0,29)-12+149",0,139
    db     "136",0,136
    db     "(3,134)+86*(3,192)/21*(0,175)-'^'",0,166
    db     "223+(0,235)-(6,102)+41",0,157
    db     "15/6-193-(0,193)",0,119
    db     "207-'E'",0,138
    db     "50-133-(4,148)+26/'5'",0,4
    db     "71/(7,94)+18-':'+(5,(2,'%'))",0,206
    db     "'='/(4,(0,204))/(6,178)",0,15
    db     "'X'/(4,33)*10",0,220
    db     "124+206+172+54",0,44
    db     "122/4+198/48+'['",0,95
    db     "'Q'/' '-(6,76)/9",0,28
    db     "(3,'H')+183-4",0,119
    db     "71+32-'E'/11",0,3
    db     "(2,111)+171/19*12-254/'+'-129",0,130
    db     "72+196*6",0,72
    db     "'N'/9-198-177+(4,91)+(0,100)",0,47
    db     "127+(0,190)",0,65
    db     "'M'-159-248/'N'+'('",0,42
    db     "29/(7,(2,1))-'5'-186*9",0,216
    db     "13-169+134",0,234
    db     "170+89*22+103+186-(2,62)",0,188
    db     "95-89*36-235/'4'+237-24",0,217
    db     "151/(5,(6,62))+(7,129)+104",0,179
    db     "253+14-'$'/'4'-48+166",0,122
    db     "'Y'-165+(0,230)-165",0,79
    db     "72-(6,':')-(5,84)/(7,113)+58",0,63
    db     "(4,175)",0,0
    db     "226+77/(1,'[')-8-125/51-209",0,49
    db     "153+(6,102)-188",0,18
    db     "21+234-147/25",0,4
    db     "192+'9'-175",0,74
    db     "136/(2,212)/55+60/(6,'$')-214+147",0,251
    db     "4-190",0,70
    db     "91-'/'+153+99",0,40
    db     "35+62/(6,'8')*'G'",0,213
    db     "(5,222)+200-28",0,112
    db     "253/5+37-96-192",0,55
    db     "192/(2,224)/(4,147)*78-'F'",0,164
    db     "205-39+153",0,63
    db     "23/6+214-254",0,219
    db     "'#'+133-(6,((2,80),(1,(5,86))))-130",0,37
    db     "217/86+135",0,137
    db     "75/(7,251)*(2,213)-201+'.'",0,119
    db     "141/56+(4,5)+15/20*7",0,28
    db     "36-36+232",0,232
    db     "'-'+'#'+224",0,48
    db     "7+(5,'6')+(1,181)",0,148
    db     "197-71/24+74+224",0,47
    db     "(3,34)+(5,' ')/(1,203)+(0,'W')-'*'*6+244",0,114
    db     "(3,38)+9/(4,169)",0,3
    db     "'@'+97-(0,203)-199/4+(1,(3,(7,152)))",0,206
    db     "163+131-66+(7,76)/'L'",0,3
    db     "(3,207)+'_'+'Q'+103-248/6",0,13
    db     "'G'-151/19-(0,120)+'I'",0,194
    db     "(2,(2,((1,206),38)))-'&'",0,220
    db     "45*(0,(0,177))-95/101+((6,'>'),191)",0,2
    db     "28+(1,102)+207",0,235
    db     "','*((4,107),116)/(3,77)+';'",0,103
    db     "'='-'G'+172",0,162
    db     "74-';'-232+66",0,105
    db     "129+(6,88)-29",0,40
    db     "(7,0)+'U'-201",0,140
    db     "227+101+(5,'.')*8-95",0,241
    db     "16+31-136+148",0,59
    db     "171",0,171
    db     "243+207",0,194
    db     "227+153-(5,210)",0,123
    db     "126/30+48/8",0,6
    db     "246-66/'4'+220",0,223
    db     "'N'/38",0,2
    db     "93/14*'!'-111+'O'",0,166
    db     "245-(3,59)+4",0,217
    db     "'Z'/23",0,3
    db     "(1,35)/(6,'+')+33-101",0,191
    db     "148-24-(6,(5,168))-184+122",0,132
    db     "133/')'*78+118/((7,245),61)",0,2
    db     "'@'+'<'",0,124
    db     "70-(0,137)",0,68
    db     "143/'$'-44+243+5",0,207
    db     "(4,86)+150",0,175
    db     "31+116+10",0,157
    db     "88-91",0,253
    db     "(7,140)-'*'/(2,138)-202+17",0,75
    db     "40/((4,35),61)*(6,(1,36))-232/19+'5'",0,56
    db     "70+((4,193),169)-';'+158-178",0,254
    db     "71/(5,20)+184",0,255
    db     "'&'/11-177+150+130",0,106
    db     "(6,67)/1/7+217/45*13",0,52
    db     "4+33/17",0,2
    db     "(5,108)+176-'J'-(7,'X')/(3,132)-131/((5,(1,'&')),238)",0,2
    db     "111+172/(4,193)*')'",0,164
    db     "249-'D'/'J'",0,2
    db     "130+(7,'G')+246-223",0,45
    db     "225",0,225
    db     "5-222/(5,254)",0,7
    db     "92+(5,167)+(4,(2,(6,(5,(0,49)))))",0,237
    db     "'D'-(7,'&')",0,67
    db     "238+209",0,191
    db     "'5'/23*(6,33)*' '",0,64
    db     "(7,87)*4-(0,177)/(5,127)+242",0,244
    db     "210-']'/17*12/20",0,3
    db     "116-(7,231)/37-37-25/3",0,65
    db     "86-210+'Y'",0,221
    db     "236/47*11-52",0,3
    db     "25/(7,(5,236))*22/18-'9'-86",0,120
    db     "(4,98)",0,0
    db     "154/3-91",0,216
    db     "'0'+99/24-(6,238)+'V'-221",0,79
    db     "123/43-210+144/89*(6,49)",0,102
    db     "'X'+17-47/(0,183)",0,19
    db     "'3'+248",0,43
    db     "98+6",0,104
    db     "61/11-204",0,57
    db     "'P'/1",0,80
    db     "44*((7,(3,(6,(7,207)))),207)-98",0,246
    db     "31/(7,((1,132),(0,183)))*(3,142)/(3,185)",0,56
    db     "79+(3,223)+74/75",0,2
    db     "(3,123)+203+'6'-179+'_'",0,176
    db     "'W'+43/54-203",0,55
    db     "'<'/24*103+113/25",0,2
    db     "165/'6'+(3,147)",0,159
    db     "(5,99)+181",0,182
    db     "89/(1,123)-254/14",0,3
    db     "207/'P'+83-'A'",0,20
    db     "'N'-25-185-156",0,224
    db     "233/'8'",0,4
    db     "((6,(0,(1,81))),(6,159))/54",0,3
    db     "'C'+(3,89)-215+105-'U'*(2,(7,(7,151)))-228",0,58
    db     "'+'/17+'P'/40*89",0,178
    db     "129-186-214/90*6-211",0,57
    db     "215",0,215
    db     "19/(2,124)/2+137+39",0,185
    db     "40-133/(2,60)*(4,154)+5/6/(5,119)",0,4
    db     "(4,((3,'I'),225))-48*7-(7,(3,(1,59)))+58",0,132
    db     "35/4+153/47*20",0,60
    db     "125+183/5+36",0,46
    db     "(5,102)/42*31",0,93
    db     "127/51-223+64",0,99
    db     "254+151/6*9+19/'<'",0,3
    db     "124-195/88",0,2
    db     "(6,(2,87))+((5,(7,'Z')),'L')*5-(2,(4,122))-134",0,90
    db     "32/(3,101)",0,5
    db     "12+(3,100)",0,75
    db     "217+(5,62)+35+38/'S'",0,3
    db     "'2'/23*'R'+197",0,105
    db     "112-(5,208)*(7,85)+88-140+((5,(7,' ')),'5')",0,199
    db     "10+(1,(3,'O'))*3",0,24
    db     "106/(1,117)/3",0,11
    db     "(6,(7,(2,54)))*((4,35),224)/11-124",0,140
    db     "(0,208)/(2,137)*(5,14)",0,48
    db     "0+91+175",0,10
    db     "(7,254)/'L'*66",0,132
    db     "192-'O'+237",0,94
    db     "129-250",0,135
    db     "(4,'9')/56*40",0,120
    db     "137+179+46",0,106
    db     "'P'/4*(3,142)+49+'Z'-(4,(0,247))",0,100
    db     "'M'+17/5+((6,159),62)/25",0,7
    db     "80+171-85+'W'+253",0,250
    db     "':'+54-'0'-208/1",0,112
    db     "(0,160)+201/'2'+(6,235)-208",0,7
    db     "169-76/3",0,31
    db     "','-(7,157)-(3,116)+80",0,36
    db     "136/34-'*'/'4'+33",0,37
    db     "34*(5,']')-241",0,83
    db     "(7,'T')/5-248+6-246",0,27
    db     "241+126+28-87/(4,197)-(5,'S')/27",0,2
    db     "'S'-174+195/31",0,3
    db     "70/6-3-161-89",0,14
    db     "192+135-(4,99)",0,184
    db     "126+(1,(5,234))+86-95+'G'",0,191
    db     "(3,22)+'Q'+(2,78)/'A'",0,2
    db     "(5,155)-146+'&'",0,212
    db     "46-28-114",0,160
    db     "((4,183),12)-94/(4,115)+(7,147)+119+'M'",0,64
    db     "207+(7,212)-233",0,216
    db     "'6'+179-215",0,18
    db     "54-'1'+234/1",0,239
    db     "105/43-73",0,185
    db     "17/(7,243)+180",0,185
    db     "(1,233)/51-(0,(7,'K'))-98-5",0,4
    db     "11*(0,(1,169))+175",0,197
    db     "52/7+80",0,87
    db     "139-92*(1,159)",0,0
    db     "'D'-(2,((0,'_'),203))+178-104",0,141
    db     "(1,106)+(2,'H')-169*(7,(7,4))",0,170
    db     "108/36-(4,((4,((7,180),223)),(4,30)))/77",0,2
    db     "'7'/(0,62)+'E'+242-219",0,119
    db     "0-((7,'U'),14)-(1,184)+115",0,34
    db     "20*((5,'7'),24)-(1,113)-210",0,194
    db     "'X'-18/(7,(0,247))",0,17
    db     "84-187+160",0,57
    db     "195+55/73",0,3
    db     "(2,(2,49))-24/'I'",0,2
    db     "(7,'Q')-240+233",0,69
    db     "236/71*12",0,36
    db     "200/6-227-102-(3,'2')-154",0,11
    db     "227-73",0,154
    db     "6-193-28*5/((6,242),55)/(3,38)*(0,189)",0,22
    db     "'L'-(6,159)",0,74
    db     "71-154",0,173
    db     "208/62+99-55*3",0,141
    db     "92-144",0,204
    db     "249/9*((6,140),(4,41))-(5,227)+207",0,11
    db     "(3,216)+(3,'&')",0,15
    db     "54+173+180/63",0,2
    db     "162+102+'U'/33",0,2
    db     "'O'+229-'B'+236-'R'",0,140
    db     "(7,194)-239-115-239+170/'S'",0,2
    db     "'*'-251+((2,122),'V')/'?'*39",0,117
    db     "'2'+17",0,67
    db     "((4,100),(0,9))-224+','/(0,73)*'0'+100",0,196
    db     "(4,0)/(3,(7,'&'))/((4,';'),195)+192",0,209
    db     "64+42/15-121",0,142
    db     "234+217+206",0,145
    db     "22-211/31*59",0,118
    db     "211/'E'*'$'+25/16",0,8
    db     "71-'X'-173",0,66
    db     "'P'-(3,199)+6-100-184",0,102
    db     "127+66-234+210",0,169
    db     "(5,78)-98-224",0,194
    db     "243/'+'*2",0,10
    db     "165/'@'*')'",0,82
    db     "83-'8'+(4,(2,'3'))/(5,39)+'R'",0,193
    db     "'U'/35*94-188-160/(2,64)",0,32
    db     "'U'-'8'",0,29
    db     "'4'+58-186",0,180
    db     "142-16/58-252",0,6
    db     "'#'+((5,(0,(6,10))),32)/(0,230)+131/28*'9'",0,228
    db     "186-';'",0,127
    db     "34/(2,129)-87",0,175
    db     "'!'+','+170",0,247
    db     "','-(1,244)*(5,79)/38-31",0,227
    db     "31-(2,((3,(2,195)),(6,94)))+182-149-193-118",0,21
    db     "(4,166)+88+(1,(2,(6,121)))",0,89
    db     "38+(1,(7,'6'))/6-62-'S'",0,116
    db     "71-90-174-1+51-(1,235)+183",0,39
    db     "232+'O'-90/46+(5,(4,245))",0,200
    db     "15-93-180/11",0,23
    db     "52/(1,96)-(3,(3,'4'))/(7,'R')",0,18
    db     "134+'&'/46",0,3
    db     "'-'*(7,253)+153/10",0,7
    db     "135+98/48+'B'+(7,86)",0,244
    db     "140+119*(4,96)+(7,2)-89",0,228
    db     "51+(6,41)/(5,123)-18",0,242
    db     "125+'5'-'9'",0,121
    db     "121/41+73/7-252",0,14
    db     "198-124+212-(1,(0,203))+'Z'",0,224
    db     "(0,(1,13))+')'+(4,147)-' '*9-'+'",0,101
    db     "'='-119+248",0,190
    db     "178/87*118+158",0,138
    db     "207+'J'",0,25
    db     "100+'2'/'#'",0,4
    db     "'^'+(4,201)+(7,248)-254-(4,176)/3/34",0,2
    db     "42+57-((3,214),129)",0,94
    db     "122-(2,125)/'('*((3,228),'M')+48",0,8
    db     "231+15/'X'-75-26+237",0,138
    db     "224+'Q'*(4,175)+14+'W'/38",0,2
    db     "1*141",0,141
    db     "';'+185",0,244
    db     "(1,246)+'F'/2-41",0,223
    db     "50/1-(5,125)-41",0,7
    db     "100/39*114",0,228
    db     "234/108*72-'R'+89+220",0,115
    db     "(5,183)*(3,26)-44/'H'",0,2
    db     "24*(4,173)+(1,2)+95+190/'='+79",0,82
    db     "124/(5,'Y')/12",0,5
    db     "'E'+56-36-143",0,202
    db     "'M'-169-161*25",0,75
    db     "(5,224)+136+199/(3,64)",0,66
    db     "86-'M'+129+167",0,49
    db     "47*(6,'-')*(3,(5,19))",0,0
    db     "(7,251)-230/(1,(7,145))",0,15
    db     "239+80",0,63
    db     "6*31/26-64+179",0,122
    db     "'>'+226+199+'+'*5",0,90
    db     "(1,(0,33))+3+222",0,171
    db     "202+246",0,192
    db     "163-138*2+(3,'6')",0,243
    db     "21-87-201",0,245
    db     "'^'+(7,23)/15",0,6
    db     "(7,14)*5-(5,';')+68+55",0,178
    db     "123+15/'%'*47/13",0,10
    db     "107+131",0,238
    db     "(1,(5,32))-112/34+171",0,175
    db     "224-(0,139)*39/38",0,5
    db     "(1,243)+'('/10+171/'['",0,2
    db     "81/9-(0,140)-113",0,212
    db     "247+14+98+99",0,202
    db     "187+(1,230)/36*17/(0,158)",0,42
    db     "242+141+']'/38+196",0,201
    db     "104+62/75*(0,(7,(6,136)))",0,62
    db     "57+227+181-218-15+18",0,250
    db     "155-137/8",0,2
    db     "56-'B'+94+'['+(2,(2,40))",0,143
    db     "197+77-245/(7,225)",0,7
    db     "130-91/(4,'N')+68",0,72
    db     "83/5/(3,1)-96-'S'+69",0,162
    db     "52/4-140",0,129
    db     "224+146/2-23",0,34
    db     "218+204+' '-179/7*29",0,58
    db     "'^'-(7,112)-(3,(6,233))",0,68
    db     "97/'!'+138-179+(0,(4,228))-(6,169)",0,148
    db     "214+29-(2,(5,'!'))+99-91+'D'",0,50
    db     "210+2/'T'-'%'",0,221
    db     "245+170-' '+129",0,0
    db     "'J'/16+75-178-137/(3,181)*45",0,225
    db     "246-34-75",0,137
    db     "70+'6'/'2'",0,2
    db     "177-'Y'+(6,(1,'S'))-'6'-142/'*'*'>'",0,186
    db     "232+'+'*(1,6)/16*98",0,196
    db     "159+69+227+133+111/(3,'M')",0,187
    db     "133-'Z'+197-(6,'V')-2/86",0,2
    db     "59+120/'J'-124+(6,'Q')",0,46
    db     "63+(6,180)+183",0,0
    db     "185+232-48/31+200+93",0,40
    db     "(4,141)-'K'-7-37",0,137
    db     "'8'-18-212",0,82
    db     "(3,165)",0,0
    db     "'6'-241+162+154+246",0,119
    db     "130/59+14-169",0,103
    db     "43*(3,(0,'='))+237",0,24
    db     "254-203-(0,(2,'*'))+72",0,185
    db     "(0,(1,'K'))+24/(5,'H')-'G'+12",0,218
    db     "157/':'-52/'W'+(7,(4,147))-28",0,23
    db     "7-49+'Z'-(5,238)+(7,(5,'Y'))",0,84
    db     "65-146+93-160",0,108
    db     "223-232",0,247
    db     "204+'I'+200/'Z'-90/17",0,9
    db     "74-74-(7,(2,222))",0,254
    db     "(4,(2,54))-(2,207)+163-(((4,242),85),155)/1",0,19
    db     "(6,253)-239/1/26-'J'",0,184
    db     "108/')'-(1,119)+237+246",0,227
    db     "29*6+92+80/(4,9)",0,3
    db     "233+(6,'X')/'('",0,4
    db     "142/' '-(4,19)-199+'E'",0,136
    db     "'X'-'<'+74+78/25-171+111",0,203
    db     "'V'-175-141+(6,66)+205",0,219
    db     "190+52-6+206-36",0,150
    db     "(5,99)-'L'+33",0,214
    db     "165+(5,114)+142",0,245
    db     "29+160",0,189
    db     "19+145+202-246+18-82",0,56
    db     "29-(3,231)/114+26",0,28
    db     "169-16/13",0,11
    db     "'C'",0,67
    db     "52/(7,(6,45))-173/13+'V'-(1,245)",0,30
    db     "209-(4,';')",0,208
    db     "111/(7,119)+(6,'M')-'K'/93",0,2
    db     "181-208",0,229
    db     "'E'/(0,(5,73))*10+207+14-46",0,149
    db     "217+10-21/42+19",0,23
    db     "'<'/15+'R'",0,86
    db     "200+169/20-(4,89)/(3,250)+(0,184)+112",0,116
    db     "64-'^'+10+(0,195)-104+124",0,144
    db     "243/'A'+93-((3,'L'),102)",0,93
    db     "(2,106)+'@'+66+84",0,227
    db     "'I'-'$'-'U'-(4,47)",0,211
    db     "'%'/16*118+138",0,118
    db     "251-125/'3'*100-192-95",0,169
    db     "130-135+166+216",0,121
    db     "'-'-21*((4,171),89)",0,120
    db     "44-234-107/85",0,2
    db     "(0,239)+240+4/44+111",0,115
    db     "20/(7,192)*(5,161)-(5,(5,23))",0,83
    db     "'%'-'B'/'D'+204+3/42",0,5
    db     "(3,(5,218))+133-141/90-(5,(2,79))-6+156",0,172
    db     "(5,140)-(4,'I')+':'/26",0,2
    db     "101-74/(7,131)-29-171",0,69
    db     "173/'('+(2,165)",0,254
    db     "'R'-7-29/(1,96)",0,2
    db     "'['-241-(2,(2,'Z'))+(5,7)/(4,127)",0,4
    db     "(4,'S')-39-198",0,147
    db     "'L'+'K'/'*'+'8'+161",0,220
    db     "'?'+189",0,252
    db     "43-31/(0,132)*(7,((3,130),166))/(5,109)-(1,151)",0,116
    db     "';'-52-171",0,92
    db     "93+'0'/'?'",0,2
    db     "110-(1,(0,((0,118),217)))-'5'-(5,230)-250",0,167
    db     "20-122",0,154
    db     "55/11*(1,'7')+'9'/(5,228)",0,3
    db     "61/23+(7,(6,'='))",0,194
    db     "':'-142/39",0,4
    db     "'N'-((6,(3,160)),(4,'F'))-9",0,74
    db     "49+'/'/'.'+165/' '",0,5
    db     "(7,21)+(1,(4,(6,(6,179))))-'P'-96",0,63
    db     "'G'-94/37+219+(2,204)",0,213
    db     "224-184",0,40
    db     "'S'-186/74+241+188",0,175
    db     "141/((0,177),92)*'Q'/43",0,5
    db     "(2,(4,(3,'C')))/17",0,14
    db     "18*(5,216)/(3,(0,'C'))/4",0,4
    db     "228/78+91+177",0,14
    db     "18-14+7/4",0,2
    db     "37+159+(7,189)+'D'+196+(1,(0,140))+68",0,177
    db     "240+'E'-4+145+'2'",0,244
    db     "10-250+59",0,75
    db     "147+137-222",0,62
    db     "79/(4,(0,122))*(0,28)/36",0,3
    db     "'-'-75-'!'/'.'",0,4
    db     "186-((4,242),128)-126+148+(2,30)+(4,117)",0,60
    db     "128/19-'/'/38-(4,'L')+(7,'R')",0,201
    db     "228",0,228
    db     "(2,'4')-45+75",0,30
    db     "146-102*(7,(4,31))",0,0
    db     "106-'&'-'V'-(0,230)",0,174
    db     "'#'*(4,27)/(5,79)",0,17
    db     "(2,18)+116",0,170
    db     "153/(5,'D')-6/17",0,2
    db     "78-48+(1,((6,183),50))*(7,204)+195-'+'",0,46
    db     "220-209*(5,172)",0,55
    db     "(1,'3')-182",0,72
    db     "3+100+104/54",0,3
    db     "((1,183),(7,71))/72*'7'+68-'Y'+29",0,118
    db     "137/'<'-'!'",0,225
    db     "58-'&'/(0,186)/1+(1,108)/93-169",0,89
    db     "(5,96)+'T'",0,70
    db     "127+(2,'@')-142",0,244
    db     "16/3*'+'/'B'-(4,219)-(1,'0')",0,99
    db     "132+'1'",0,181
    db     "137-64",0,73
    db     "202+'-'/'S'*'O'-73-97",0,244
    db     "'H'-(0,71)+'F'-167",0,200
    db     "43*(6,26)+48+159",0,207
    db     "'R'-80-147/48*'2'",0,100
    db     "71+116/6",0,31
    db     "62-148",0,170
    db     "151/' '*':'+'U'",0,61
    db     "'J'/(0,130)/((1,(7,185)),14)+225",0,249
    db     "(7,'V')+143/(7,16)+'J'",0,76
    db     "'6'+125-1-83/((0,137),'V')",0,95
    db     "235/'5'*'%'-'+'",0,105
    db     "222/'<'-'1'+183",0,137
    db     "160+229/28",0,4
    db     "143-'9'",0,86
    db     "'X'+(3,121)/(1,193)*(1,117)*(5,153)-'I'",0,255
    db     "220+(0,(0,(4,180)))/'*'*(5,223)-50/(2,70)",0,5
    db     "143/(7,'S')*56",0,168
    db     "98/(7,'H')+82-'>'",0,22
    db     "'1'*2-191-28/65",0,2
    db     "190/'1'-120",0,139
    db     "1*52+(0,(5,(7,137)))",0,246
    db     "202/93",0,2
    db     "'W'/(3,181)+30",0,51
    db     "47*(2,163)-(2,227)-246+9",0,184
    db     "195/87-(4,36)",0,1
    db     "188+(3,'#')+(3,'<')-'M'/18",0,9
    db     "191-(7,26)+93",0,28
    db     "'*'+70/(7,82)+157-61",0,133
    db     "7-'I'-(3,144)+30+144/(0,102)",0,36
    db     "152/(0,81)*(4,(7,235))",0,100
    db     "(4,232)+101-40",0,1
    db     "'.'-103-171/(1,92)",0,28
    db     "15/(3,(1,108))/2-(1,185)+((0,183),175)+60/7",0,13
    db     "(6,59)+(3,204)/31",0,4
    db     "107-227-(6,94)",0,73
    db     "(5,(3,'%'))-(6,136)/(7,109)",0,4
    db     "(2,'^')*(2,')')*((4,204),108)",0,32
    db     "72/(5,91)/9+218",0,222
    db     "229/108-105-217-(2,(2,188))",0,99
    db     "(5,' ')-181/14",0,15
    db     "'%'/4*10+43/11+(5,129)/7",0,2
    db     "2*91-204+65+57",0,100
    db     "7-(6,202)",0,10
    db     "46*(4,179)",0,0
    db     "6*(7,14)-'7'-((3,237),172)",0,29
    db     "50/((7,146),161)-(4,'V')",0,25
    db     "134+23-(5,43)*(5,181)/'6'",0,2
    db     "138-53+159-(5,243)+'?'",0,111
    db     "'J'-204-(6,23)",0,226
    db     "138-153/90*46",0,92
    db     "'F'/(3,'I')+'Z'/((0,13),'@')",0,100
    db     "185-218-'I'/(1,6)-(1,205)",0,135
    db     "163-113/16+212+135",0,94
    db     "93/9*(3,177)+192",0,192
    db     "28+(3,133)",0,81
    db     "(6,156)+5-40-228",0,69
    db     "192-':'-145",0,245
    db     "'S'-'1'",0,34
    db     "36/(2,106)+238",0,240
    db     "232/'7'",0,4
    db     "39-86-(4,(7,89))+')'/(1,238)-140",0,143
    db     "85/'$'*(2,'P')*23+169",0,5
    db     "230/'L'-123/56+(5,95)",0,3
    db     "27/11*59",0,118
    db     "76+126-244-(3,80)+145/(6,(0,(0,60)))",0,16
    db     "'>'+(6,178)",0,64
    db     "150-114/5*1-176",0,87
    db     "252/(1,(6,174))/1",0,42
    db     "88+32/34+(4,243)",0,54
    db     "(2,238)-17/(2,224)+207",0,212
    db     "117+161/(5,59)-53/'5'",0,3
    db     "145+115*'*'/22",0,7
    db     "53+113+134/16",0,2
    db     "(1,26)+157+250",0,166
    db     "'>'/6-187/17",0,4
    db     "173-(2,52)-(1,(1,72))/1+5*(1,103)",0,78
    db     "(6,49)+' '/23",0,3
    db     "209+207+154+146",0,204
    db     "242+(5,45)+232-102+72",0,192
    db     "(6,'(')+' '/'#'+138",0,140
    db     "108-76+158/62*'('-(3,'K')/11",0,16
    db     "'9'-(5,212)/'-'",0,2
    db     "118/'-'+174",0,176
    db     "(5,6)/(7,(3,110))/(2,251)*41",0,246
    db     "(4,208)-193-213+(2,(4,(3,163)))",0,157
    db     "126-199-23-12/'@'",0,2
    db     "215+79/17*'Y'/'H'*93+19",0,205
    db     "125+8+114-157-'T'",0,6
    db     "(2,(1,'D'))+'='/11+(3,((6,(5,181)),192))+'N'",0,136
    db     "(2,8)-73/115-107/'!'",0,4
    db     "227+(0,161)+8-(1,62)",0,69
    db     "43-'!'*22",0,220
    db     "170-93/10+238",0,245
    db     "249/36*')'",0,246
    db     "223/9*(1,111)+39",0,39
    db     "(6,184)-(2,128)+33-(2,'Y')+'S'+14",0,67
    db     "'.'+211+187+(4,29)-159",0,54
    db     "129-167-'<'",0,158
    db     "(4,'B')+167/50",0,2
    db     "125-'S'*1*(1,111)",0,0
    db     "186/'C'*119/105*'D'-75",0,61
    db     "'R'/20*' '+28",0,156
    db     "148-189+213",0,172
    db     "6+102+248",0,100
    db     "129+101",0,230
    db     "171+26-'<'-'<'",0,77
    db     "27*(0,'@')-(0,'Y')-'='-(2,55)-154",0,126
    db     "76+(4,187)+((7,135),61)-252",0,145
    db     "112-(4,253)+176-126-239",0,236
    db     "','/2+56-148/50",0,3
    db     "138-146+(0,39)+18-108/(5,(0,94))",0,158
    db     "'.'/12",0,3
    db     "60-138-((0,'>'),164)*(7,207)",0,34
    db     "254/(4,'!')-(3,(0,159))-(0,254)-(0,161)+149-195",0,45
    db     "106+'G'-'3'/(6,102)+'L'",0,78
    db     "71+112+247",0,174
    db     "12*2+249+104+((1,85),46)+141-(3,'<')",0,169
    db     "(2,(4,72))+'5'/27*':'",0,232
    db     "77-76",0,1
    db     "167+(3,1)/26*11",0,66
    db     "227-226-134-':'",0,65
    db     "196-178*(5,'/')",0,54
    db     "130/(2,(6,(5,'B')))+(5,235)-(4,147)",0,73
    db     "235-239/111-127/(2,'@')+229",0,16
    db     "229+'S'+246",0,46
    db     "95+'&'+'%'/27",0,6
    db     "' '-185+(3,30)+144+'K'",0,119
    db     "241+(6,166)+232",0,109
    db     "95/'$'-16-243",0,255
    db     "236/8",0,29
    db     "(7,135)",0,0
    db     "55+(7,(2,(0,158)))-220*(1,206)",0,0
    db     "171-62/41",0,2
    db     "(1,(6,216))/'+'-(6,126)",0,206
    db     "'1'+'Z'/16",0,8
    db     "47+58+69",0,174
    db     "145+216/(3,(1,'*'))+90-111/74",0,3
    db     "168-169/(7,27)*56",0,224
    db     "216-219-15/'%'+'Q'",0,87
    db     "(1,((6,'$'),29))/15+211-74",0,153
    db     "222+2/24*16-106-'9'",0,237
    db     "(0,253)/'('-6+147",0,147
    db     "'F'+(0,15)-68-((7,249),(4,'S'))+160",0,222
    db     "170-205+250",0,215
    db     "((5,78),207)-227-(1,'O')-166+58",0,50
    db     "16-159+((3,212),84)-195-(7,205)-99",0,111
    db     "98-213+3",0,144
    db     "70/13*'.'",0,230
    db     "'.'*4/'T'*(3,(7,'&'))",0,2
    db     "207+151/45",0,2
    db     "(6,(6,'['))-'1'/'*'+186",0,189
    db     "232-(2,34)",0,179
    db     "203+102*(6,58)",0,0
    db     "'I'+53+116+58",0,44
    db     "13*((3,(5,2)),33)-179-215",0,118
    db     "210/(7,'!')",0,4
    db     "'5'-226/40+111",0,113
    db     "35-(6,26)+151/'%'-69+162",0,98
    db     "'R'/24",0,3
    db     "34-121-'$'-173-77",0,139
    db     "'X'+(0,43)+155",0,253
    db     "57+15-49*(7,'O')",0,46
    db     "195/'.'-92",0,168
    db     "161-13/11",0,13
    db     "'W'+'T'+(4,120)",0,235
    db     "100/(5,248)-61/65*57",0,171
    db     "(3,72)-12-'O'+'0'+142",0,39
    db     "253/117*13+217",0,243
    db     "(3,223)+(4,(2,254))-(2,33)",0,150
    db     "178+73",0,251
    db     "122+10+61",0,193
    db     "50",0,50
    db     "235-194*(5,248)+12/28+(1,(5,121))",0,150
    db     "11-(6,83)/25",0,2
    db     "118/' '+(6,(2,(7,',')))+(6,64)+80",0,199
    db     "']'+'E'/'!'*39+239",0,139
    db     "232+69-250+86+51",0,188
    db     "244-212/(0,186)*6+(5,(7,(4,236)))",0,132
    db     "63-'V'-239-119/34",0,3
    db     "251+226-(4,(3,35))+(2,49)/'<'+97",0,100
    db     "44+((7,'I'),'C')*(4,175)+159/(7,128)-(4,28)",0,52
    db     "225+181",0,150
    db     "((7,129),167)/(4,((3,'I'),26))*5",0,20
    db     "(3,67)/69*83-(6,90)/60",0,3
    db     "(3,58)/(0,21)+107/31",0,2
    db     "58+(5,208)-'N'+213",0,0
    db     "(2,3)+95+'#'",0,127
    db     "(6,98)-118+237/59*'0'/(0,234)",0,72
    db     "59-132/(6,240)*32/83*10",0,20
    db     "202-98-(5,'X')-191",0,231
    db     "204+124-216/'%'",0,3
    db     "149/(6,14)+210+119",0,82
    db     "(4,26)/(5,248)-79/41",0,5
    db     "'E'-'&'",0,31
    db     "209+((1,41),73)/107-'?'/88",0,2
    db     "((5,0),147)/5*(6,165)/41-'&'-210",0,10
    db     "(6,188)+109+'B'+153-226-165",0,195
    db     "'B'-141+254/61+227-138",0,91
    db     "(0,248)+(1,136)+(1,231)",0,182
    db     "125/','+90/(3,163)/8/(3,181)",0,2
    db     "'4'/4-90+68/'B'-'A'",0,194
    db     "133/32*'1'",0,196
    db     "222+201+(5,31)-39",0,125
    db     "(1,((5,'7'),103))+162/(5,97)-30",0,128
    db     "154/(7,243)/16*'%'/1/21*45",0,225
    db     "'Q'-73*(3,122)+38",0,38
    db     "202+181-'&'",0,89
    db     "225+174+174+131",0,192
    db     "241/')'+(5,9)-108/48",0,2
    db     "'7'/5-232*(7,(6,137))+78/34",0,2
    db     "33/5-170",0,92
    db     "47+'.'-'-'-'_'-173",0,36
    db     "(2,(7,151))+172+(5,234)-'M'",0,153
    db     "205+47+242/'R'+(4,240)",0,51
    db     "'.'+239-48-191-109",0,193
    db     "222+37*2",0,6
    db     "227+(0,(4,'L'))/(6,178)-(1,75)+'R'-56",0,117
    db     "'4'-108/'M'*'Q'",0,162
    db     "'?'+109-227/74+184",0,186
    db     "'S'-(5,217)*(7,117)",0,0
    db     "'2'-(4,34)+226",0,79
    db     "((4,190),55)+222+209",0,115
    db     "235/87-'D'/89-16",0,242
    db     "77+(2,223)*9-238",0,171
    db     "((3,13),37)+(6,(4,20))",0,142
    db     "197-'$'",0,161
    db     "11*22",0,242
    db     "132+44/60*1*'G'-216",0,182
    db     "147-(4,248)/19",0,7
    db     "231+118+185",0,22
    db     "59/8+73-104+170+199-229",0,116
    db     "128-'N'/(2,187)*9",0,90
    db     "133-134",0,255
    db     "'8'+120+(7,39)",0,229
    db     "144+(5,((1,204),(1,91)))+96+(6,31)-'R'-160",0,150
    db     "142/17+(7,2)+(0,'5')-(1,126)",0,5
    db     "(3,137)+231-'!'-101-197",0,93
    db     "39+219*58-180-(3,38)",0,189
    db     "(2,104)+245-(1,225)-105/99",0,2
    db     "212/'0'-'+'",0,217
    db     "210-240-65-140",0,21
    db     "(1,144)-52+17+55",0,15
    db     "11*(5,200)-69-'H'/33",0,4
    db     "38-(4,'G')/'6'",0,2
    db     "(4,'<')-'J'/'<'",0,3
    db     "18-(6,64)+213-121+(4,100)*(5,81)",0,128
    db     "88/'$'+39*2-28+220",0,18
    db     "(3,'W')+59+'?'-(7,'G')",0,233
    db     "'6'+245*(1,228)-35*5-243+26",0,79
    db     "']'/(4,9)-253-169+(1,185)",0,95
    db     "77+128-86+(7,189)",0,136
    db     "191+(6,232)+' '-76-36",0,145
    db     "32/(4,36)+'Y'/(3,212)+19",0,140
    db     "47-242-151/'+'-'.'",0,213
    db     "(4,108)/2+(2,42)-22",0,39
    db     "81/7/4-6/((1,167),37)",0,4
    db     "228+204-'W'",0,89
    db     "132-247/'5'+205-4",0,203
    db     "'H'/(3,168)+93+211/23",0,5
    db     "202-(6,77)+161/25-176",0,82
    db     "96/(1,148)-201-29+'0'",0,90
    db     "15/3*(5,73)",0,140
    db     "'8'/(3,250)*13/34*'#'",0,105
    db     "62-23-122-'E'",0,104
    db     "(5,((6,159),21))+148+76/68",0,2
    db     "117/51+247+17-138/20",0,6
    db     "185+202+(5,92)/15",0,5
    db     "231+249/(5,39)",0,112
    db     "229-217-49+218/(2,109)",0,3
    db     "197-(4,25)-17/35",0,4
    db     "231-'_'/'='-(3,(2,202))-235+(6,((0,130),'-'))",0,248
    db     "27-'$'+65-242+224",0,38
    db     "'W'+131-88/(3,158)",0,32
    db     "(3,'K')/'%'-123",0,138
    db     "' '-'7'/(7,241)+(0,(6,'Q'))+229-36",0,17
    db     "0+202-(1,(4,(7,1)))",0,8
    db     "'>'/6*(3,29)-46",0,24
    db     "(6,12)*(1,24)-'W'",0,181
    db     "159/5/13",0,2
    db     "((6,185),3)+219+183-33/49",0,2
    db     "72-188+169",0,53
    db     "165/26-237-131+159+'G'+58",0,182
    db     "92-115-226",0,7
    db     "252+114-213+213+230/37",0,2
    db     "(6,38)-22-21/17+122",0,131
    db     "13*(5,(5,';'))-(4,91)",0,250
    db     "'H'+29+65+11",0,177
    db     "'['-88+180+136",0,63
    db     "234+(0,',')/74",0,2
    db     "' '*(0,234)-244+192-(5,';')",0,7
    db     "72/27*123",0,246
    db     "';'-'<'-57-(1,'K')-'('",0,165
    db     "'0'+(7,182)",0,10
    db     "(5,(7,221))-162+31*26",0,104
    db     "153+'!'-22-'W'",0,77
    db     "232-114-94-125+'='/88",0,2
    db     "71",0,71
    db     "25+201-30+49+(3,(1,52))+144/20",0,3
    db     "227/22-97/60-186-224",0,104
    db     "'&'/1*(2,54)-26-148-163",0,175
    db     "19/((4,(0,'U')),110)/(1,(0,86))*14",0,126
    db     "(7,233)*2+132+219-'5'",0,124
    db     "210-(6,(7,224))+'+'/(5,47)/4-226",0,34
    db     "(6,(2,(5,(5,36))))+88-']'",0,191
    db     "123/((0,175),88)-38+97",0,62
    db     "216-'&'+(0,(0,54))",0,176
    db     "223/'S'+55",0,57
    db     "(4,(7,54))/(6,0)-62/75-222-((2,33),(3,'+'))",0,50
    db     "68+66+(2,51)",0,74
    db     "33+88-(5,152)/71",0,3
    db     "(7,(4,','))-'G'/(5,(1,206))-180",0,172
    db     "151/((1,187),(0,217))+235",0,237
    db     "(0,2)*64+135-'9'",0,206
    db     "'8'/10",0,5
    db     "238+92/((7,(7,157)),55)/18",0,4
    db     "(1,161)/93+(6,'R')",0,53
    db     "67-150/'#'",0,4

   db "38179-Z-5938+3982-831+36",0  
   dw 35359
   db "63133+(4796-5106+4654-Z)",0  
   dw 1872
   db "(C-C)-2548/16157+3335+C",0  
   dw 4367
   db "(39057+Z)-10-A/Z",0  
   dw 566
   db "23426/7573+A/2+864",0  
   dw 872
   db "48835+(Z/A+4965)+729-34+100",0  
   dw 54600
   db "995/Z*A-3345",0  
   dw 62373
   db "16847*2/1595",0  
   dw 21
   db ":65324)/10537*Z+4454/(19874-5926/2504)",0  
   dw 932
   db ":60)+3994+1368",0  
   dw 55593
   db "(E+C+4761-:65409))*7-5879/7209*E",0  
   dw 168
   db "((51064/((:65436)-2407/2347)/2)/1354)-1166-A-C)-940+4215",0  
   dw 1072
   db "C/289+5960",0  
   dw 5963
   db "41619-4028+A+394",0  
   dw 37998
   db ":447)+1657/11057",0  
   dw 5
   db "A+(A-(A-6029/:229))/(:65305)+Z/4657)+Z)*3/C+6504",0  
   dw 6518
   db "A/3*2179",0  
   dw 8716
   db "61661-3967-1079",0  
   dw 56615
   db "37506-2813+4084/(61957+357/C)",0  
   dw 646
   db "(((28778+4540-2757)-5151+(47719+A/11446)-6421)/A/123)*2727-4997+5176-2435/C",0  
   dw 26
   db "36879+2522-((21742-1541*2+3002)/822/6*:65458))-2286/9819",0  
   dw 3
   db ":65391)+3661+(C/268)+(C/E+C+4450)",0  
   dw 65228
   db "(:453)/16353)*12449/6376*8217",0  
   dw 41085
   db "33901+(24387-E/5515)-E/10284",0  
   dw 3
   db "3531-4257/5325*1493",0  
   dw 17916
   db ":43)+C+1218+6075",0  
   dw 16158
   db "((57720-E+2473/Z)*48/1265/6)-716/18201*6446",0  
   dw 19338
   db "(4480-5732)-5462",0  
   dw 58822
   db "(:249)/127+735)+Z-Z*A",0  
   dw 9594
   db ":81)-4460-:65428)",0  
   dw 59545
   db ":65519)+5195/4728",0  
   dw 7
   db "(C+1897*A)/1117*1248+:21)-2074",0  
   dw 40551
   db ":415)*265+2924+384-6468",0  
   dw 47985
   db "(36217+4459)/29/Z-2099/14137",0  
   dw 4
   db "Z/11-:67)-771-3715",0  
   dw 60605
   db "62495+1183/73/284-C/A",0  
   dw 4962
   db "((Z*445-A/(52282/E+4734/A))*142+A)-(46335+E/2035)*5/7076-2813",0  
   dw 62729
   db "(:65298)+((:65346)-C+Z/19448)+C-(:13)/7176*Z))/12675)-A-E/(46961/10967)*3",0  
   dw 49113
   db ":508)+152*(:65493)+E/:414))*((((:65353)*5+4706)/:398)/73)+6451/2003))/200",0  
   dw 15
   db "Z+:388)-1599+4077",0  
   dw 3001
   db "47081+(4073+5536/C)+4621-5170-619",0  
   dw 45922
   db "6123-4797*36+3204+803",0  
   dw 51743
   db "50199+3918+6349",0  
   dw 60466
   db "(A-Z-:65377))-6285+Z-Z",0  
   dw 58737
   db "50092/(:199)+1983/12938)",0  
   dw 12523
   db "E-E+695",0  
   dw 695
   db "14936-4918+:249)",0  
   dw 10468
   db ":65465)/(:111)-6475-:65464)-2069)*2503/A",0  
   dw 2503
   db ":65302)+2452+5865+3766/E",0  
   dw 1488
   db ":65437)+:21)+A-1366",0  
   dw 9841
   db "(Z+1433-2578)+446-3998",0  
   dw 60908
   db "14062-A+(E-3949/13449)-449",0  
   dw 13604
   db ":65311)/1167*2072+C",0  
   dw 9317
   db "(56532-2277-A)+1703-1101+613+(C+E+5199/E)",0  
   dw 55606
   db "2933/A-1280",0  
   dw 64481
   db ":80)*156",0  
   dw 39156
   db "E*A+E/169+6049",0  
   dw 6052
   db "19235+786/3135*8799+4237+4948",0  
   dw 61979
   db "Z-A-C+:65309)-C",0  
   dw 63793
   db "51188-1466/10259*2648",0  
   dw 10592
   db "37709-(8681+C/C)+6472-4325",0  
   dw 39847
   db "6512*(C-E/217)+3260",0  
   dw 29308
   db ":377)*77+5068+C+:65456)",0  
   dw 43545
   db "(:61)-Z*2)-E/E/113-4604",0  
   dw 60937
   db "41886+((:65441)*6-2565)/(3495+184+1553)+2834)/10779+5505",0  
   dw 5509
   db "63022/17598-5228+2029",0  
   dw 62340
   db ":322)+3340+3081-264",0  
   dw 22333
   db "A*4400",0  
   dw 57200
   db "((:402)/(:184)-C/Z))*3482/13952)-3506-Z",0  
   dw 61965
   db "(36366-5724)/8127+1815-2635/21274",0  
   dw 3
   db "((14875+1506/3683)-5355-((59437-1643/A*13)+6129/10751))+:79)+:347)",0  
   dw 61401
   db "23349-2332+2698/:500)*C",0  
   dw 37044
   db "51414-A",0  
   dw 51401
   db ":294)+2847/9100",0  
   dw 5
   db "A-2540+3489/275*(A/3*3613+4351)",0  
   dw 56409
   db ":498)+2916-A",0  
   dw 19287
   db "53690-595/13747",0  
   dw 3
   db "C+5092+2579",0  
   dw 8700
   db ":65451)*3-4113+5800",0  
   dw 43306
   db "(48206+2278)-C",0  
   dw 49455
   db "(13565/1745-(((24385-4796)/(64642/6414+4700)+1621/107)+Z/19))*E-3905",0  
   dw 61757
   db "Z+A*492-6107-2749+362",0  
   dw 31850
   db "23491-C",0  
   dw 22462
   db "41852/11442*5273",0  
   dw 15819
   db "46333/((32237/10303-(A*E-6485/4921))+2855-2522)+:79)-3678",0  
   dw 62768
   db "((3366*18+((41405-5304+A)/9900+5583/E))/6204)*E+5276",0  
   dw 5654
   db "(23692/C-440/15267)-1209/3576-2515+671",0  
   dw 63709
   db "A*514*8",0  
   dw 53456
   db "C/(C*30/9151)-5539",0  
   dw 60340
   db "(48554-4946/11733)-:191)-3758-5148",0  
   dw 53365
   db "18193/C/3-A-(2679/A/28)/10736",0  
   dw 6
   db "47894-((56370-C+:65377))/13720)-Z",0  
   dw 47821
   db ":487)+3351*4",0  
   dw 39628
   db "Z/17*12868",0  
   dw 51472
   db "64644-(E-925/2955+1304)/:277)+1039*12+4598",0  
   dw 17150
   db "30819+C+1569/1622",0  
   dw 20
   db "15129-1875/4100*6186-E",0  
   dw 18516
   db ":340)-1014+4693-(A+:427)+1107)",0  
   dw 5842
   db "45484+5682/C/9",0  
   dw 5
   db "3621-A+1934/1499+(38379/(12013/1845)-6141)",0  
   dw 258
   db "(55570)/(29467+4115/7762)+A-2616/524",0  
   dw 21
   db "26731/5717*5385/6832+657",0  
   dw 660
   db ":56)-(Z*540/6052*(Z-6507/16169))+2991+4822",0  
   dw 40775
   db "((:65384)-(C+(E/11)+51/339))+1418)+4594+1299",0  
   dw 5198
   db ":327)-4186-E/5429",0  
   dw 8
   db ":65288)/(10527/A*16)+Z",0  
   dw 73
   db "7511*6+2259-(:43)-2343+C/(25552/(63381+Z-C+4469)/2))+E",0  
   dw 46643
   db "12162-Z-6250-2373",0  
   dw 3470
   db "34266/C/9-Z",0  
   dw 65470
   db "(3684/(:65458)/20+1126)*20384)+6270/175+A",0  
   dw 23
   db ":65427)-578/982/11-4102-5873",0  
   dw 55567
   db "181/41*2326-3354*6",0  
   dw 35700
   db ":65441)*3/5611*E/44",0  
   dw 3
   db "(64430-5181+(C+2651-3377/A))/(10552+E-710+(44258/C))",0  
   dw 5
   db "35953-6497+A",0  
   dw 29469
   db "C-:495)*36",0  
   dw 30096
   db "(35922/A*16/12131)+C-(:157)-5985/(Z+88/12))",0  
   dw 63169
   db "A+124-1476-2946",0  
   dw 61251
   db "((12731*4-572-5635)+1851-C)+2350+528",0  
   dw 48417
   db "E+2052+C*9+1480-((7168-4492/547)+5856/1914)",0  
   dw 29584
   db "A-2884+4810",0  
   dw 1939
   db "Z-2747/:53)+((A*1130*2+Z)/5277+C)-1730-2795",0  
   dw 62356
   db "(60662-:93)-1279)+4358-1173+2402",0  
   dw 62778
   db "A*920/2051",0  
   dw 5
   db "14603+A-Z-2161*3-486",0  
   dw 36672
   db "16213*2/E*30-E",0  
   dw 23118
   db "24941/6425",0  
   dw 3
   db "37035/6677+E",0  
   dw 47
   db "A+E*(58219/(53533+:232)+5746/(:65414)+6435-552))-6190/Z)*11",0  
   dw 30250
   db "10926-2224*3/4164",0  
   dw 6
   db "7796-:504)-2136",0  
   dw 5355
   db "A-(A/3-4516/((:471)/12974*18773)/Z/Z))+Z/:101)*709",0  
   dw 2127
   db "(30703-1007/C)/7",0  
   dw 4
   db "42113+Z/655*377",0  
   dw 24128
   db ":12)/11362+A*982/1707",0  
   dw 10
   db "(Z+(49857+Z+497/5463)*637)+790",0  
   dw 50476
   db ":448)/E*26",0  
   dw 23504
   db "(41001/Z+964)/Z+3301-E+:82)",0  
   dw 3731
   db "42904-1829+1218",0  
   dw 42293
   db "15009+E+(Z*268/2398)-(E-3508/Z)",0  
   dw 14159
   db "A-3126/12515-4967+5142",0  
   dw 179
   db ":22)+Z",0  
   dw 49478
   db "(:65412)+C/1050)-1404/E",0  
   dw 1527
   db "37823-(:28)/706+:489))+320-167/7310",0  
   dw 5
   db "43301-5500/A/234*3958",0  
   dw 47496
   db "((C/250*C/90)+1230+4790-A)/666+4040/405",0  
   dw 9
   db ":99)-4293-3619-2602",0  
   dw 39713
   db "(:65326)+4955-2946+1166)-4886/14823",0  
   dw 3
   db "(2508/399*5429)/Z-3053/3232*(Z+:373)/A)/916",0  
   dw 5
   db "((62525-2465+:65425))+E-6303)-5294+1911",0  
   dw 51129
   db "E+4954*9",0  
   dw 44964
   db "((Z*707/:333))+6313/1659)-6194",0  
   dw 59345
   db ":65386)-4167",0  
   dw 47609
   db "57520-((27041-1470/8484)*C)/3495",0  
   dw 15
   db "(50379+((47622/(4172*13/7019)*2+790)/E/30)/15384+4520)*5-1135",0  
   dw 21480
   db "64095+(24907/(56486/15445+61)-((8896-326+5614-Z)*2/:65434)))/19642+5340",0  
   dw 5343
   db "20477+5524/166",0  
   dw 156
   db "(((((:116)-5586)+5559)/11420)*19-824))+C-1699",0  
   dw 64118
   db "1911/238-4045/Z",0  
   dw 891
   db ":65384)",0  
   dw 63426
   db "21291/318",0  
   dw 66
   db ":65481)-5875+5833/E/201",0  
   dw 5
   db ":65302)-1891-820",0  
   dw 47719
   db "8837-A*3-2529/(:65419)/255)",0  
   dw 7981
   db "E-C-1025",0  
   dw 63524
   db "15319/:108)-:458)-E/:149)",0  
   dw 3
   db "36612/11654+6136-2107+4285-5744",0  
   dw 2573
   db "56064-2862/25",0  
   dw 2128
   db "55507+2443+599-C",0  
   dw 57520
   db "E+(((:65521)-(1219+992-A)/18183)-(A-377+5015))/A)+5453/C",0  
   dw 9
   db "33581-4246",0  
   dw 29335
   db ":506)-((46118-2356+2376)/A/(3843+4634/(((C+C*13)/1461)/4)-1522))/:15)+1996*14",0  
   dw 28882
   db "21383*2-(4767/:15))",0  
   dw 42760
   db "20888-1815+5588-4164",0  
   dw 20497
   db ":65517)+2574",0  
   dw 54291
   db "44/6",0  
   dw 7
   db ":65493)/5126*1507",0  
   dw 18084
   db "A-Z+2993",0  
   dw 2937
   db "(C-4594-(22988-(:65457)+1828)/910+E))+(6763*5/10356+:67))/6071",0  
   dw 10
   db "E+:82)+1899+3561-:130)-:482)",0  
   dw 2887
   db "(64385/E-4556-5554)+6433/18586*10027",0  
   dw 30081
   db "(60633/C)*805/3561",0  
   dw 13
   db "C-(:65474)-1998/219-Z)-3029+3312",0  
   dw 1164
   db "54473-A+5284/C*821/6685",0  
   dw 7
   db "11308-139/3284-E",0  
   dw 65497
   db ":343)-4123+Z/E",0  
   dw 289
   db "49045-(Z/9)/1683",0  
   dw 29
   db "((C-6168-734)/16252+:65309)-3065)/3264-4336",0  
   dw 61219
   db "((A-4925+Z-(:272)-Z/3728))+5834-1308)/20412*E+A",0  
   dw 139
   db "434/Z+:490)-4203-E",0  
   dw 61953
   db "C/118+6398-347/(21889-:238)/3447)",0  
   dw 1009
   db "32677/Z-:212)",0  
   dw 168
   db "42569/3772-A",0  
   dw 65534
   db "29262/C-4553/7827*8461",0  
   dw 59227
   db "Z*372-3366/5937*10231",0  
   dw 30693
   db "7429+5630-((:464)+:388)+226*33)-4028/2131)",0  
   dw 13052
   db "5967*7-4206-(((:409)-5180/Z)/168+:444))-Z-2813)",0  
   dw 36116
   db "(5070*3-1015)/E/56-1248/18415-2276",0  
   dw 63263
   db ":337)+:377)-(48154-829/:65396)+5520)",0  
   dw 55258
   db "((46065+5080/5329)+4392/C)*5451-5505",0  
   dw 16299
   db "58742-308",0  
   dw 58434
   db "(36423+1438+4538+2208)-(C-810/(22943-C+2714/:161)))",0  
   dw 44597
   db "56651/16062*(:135)/E+Z)+:364)/A",0  
   dw 510
   db ":484)-:489)/(C/128-A/C)*35/E",0  
   dw 855
   db "(21552+E-4398/C)/4-617",0  
   dw 64923
   db ":235)-Z+(55868/11363*E*(39745/3428))/51",0  
   dw 43
   db ":95)-3671-Z",0  
   dw 32875
   db "14435+:456)/1358+C+583-((40459+A+(Z+C*(:65515)-1349/9020)))-A/C)",0  
   dw 1580
   db "A+1220-4075+6016/E*706",0  
   dw 52950
   db "31308/5102*1251+5175",0  
   dw 12681
   db ":62)/366+:458)+6387-((28414/8003+837)+Z/134)",0  
   dw 10436
   db "29695-:129)+C-((:26)+A/Z)-934+5334-:65487))",0  
   dw 29663
   db ":65404)/13856+3896*12",0  
   dw 46788
   db "27662+1879",0  
   dw 29541
   db ":85)/(31972+4120/((:27)-4340/Z)-C+532*10))-((:106)/2938+5306)/1197)+461/41",0  
   dw 13
   db "(7848/C)*515/A+4396",0  
   dw 4673
   db "((:368)/280)+771/166)-547+3195/622",0  
   dw 4
   db "(33670/4192-6402)+1961-A-1637",0  
   dw 59453
   db "35093/8070+4097",0  
   dw 4101
   db "58468+3849",0  
   dw 62317
   db "18157*2/8974",0  
   dw 4
   db "25177-724",0  
   dw 24453
   db "A/3*6117",0  
   dw 24468
   db ":491)-A+318*A*2",0  
   dw 39650
   db "56143/1741-2619",0  
   dw 62949
   db ":189)+:488)/3965",0  
   dw 12
   db "(12365+6045-3684)/4400-2300-4299",0  
   dw 58940
   db "6992*2/3480+1886-Z+1736",0  
   dw 3557
   db "40671-3277+3152",0  
   dw 40546
   db ":65341)+A-566-2583",0  
   dw 46531
   db "Z/4+964+2618+(E-785/:498))-1798",0  
   dw 1804
   db "(23530+3356+669)-2537",0  
   dw 25018
   db "E*898/12150-255/4401",0  
   dw 14
   db "372*(5733/1650)*49-5663",0  
   dw 49021
   db ":65316)-(23152-120/3754)-1724-:65531)+C",0  
   dw 50938
   db ":65322)/(43236-4934/C)*(28124/A/374)+(48559-1790/:82)+1075)/E",0  
   dw 235
   db "2068*9/453/4",0  
   dw 10
   db "C-1169",0  
   dw 65396
   db "(5848+4700*5)/:65373)+6211-5823",0  
   dw 442
   db "Z/14*Z",0  
   dw 276
   db ":136)/C/14",0  
   dw 3
   db ":65320)-(((:12)+3567)+597+4099)/356-2648/162)+4841+6034-6372",0  
   dw 55955
   db ":65317)/1513*1175",0  
   dw 38775
   db "E/12+1773",0  
   dw 1776
   db "Z/13-(:23)+((64465-C)/Z-90+2095)/4701*Z)",0  
   dw 65334
   db "50258+519-5960+860-277/14783",0  
   dw 3
   db "(27043+A)/(:429)/7311)*7",0  
   dw 31563
   db "3426+1621*4",0  
   dw 20188
   db "51482+(14441/((10975+E*2)/2895-1065/21159)+E)",0  
   dw 56337
   db ":356)/2840-(11982+4881/2471)",0  
   dw 65534
   db "19540/((:142)+5268)/9854)+1761/24",0  
   dw 236
   db ":229)-A+(3048+A/540+1310)",0  
   dw 4570
   db "((61588-E/4617+2390)*12/2545*271)/888-3675/:65408)",0  
   dw 4
   db "52294/Z*75-4991",0  
   dw 51784
   db "(47360/3411*2920)+3052/5437+5298+4071",0  
   dw 9376
   db "C+C/270*1206/820-3295",0  
   dw 62251
   db "28883/(26456/2636*A)+2883*8",0  
   dw 24840
   db "E-6078/13082",0  
   dw 4
   db "52306/(:212)-2535-2592+5973)*1342",0  
   dw 60390
   db "(16644-176+4828-2483)/4137+4006*13/Z",0  
   dw 755
   db "29744-2998+C",0  
   dw 27775
   db "21133+5073+:65424)",0  
   dw 29474
   db "18040*2+A-3053",0  
   dw 33040
   db ":290)-34+(((C*E-1045)+E-3433)-(:105)/E-(58639+4624/9246)/99)/239+:501))-5013/A",0  
   dw 2838
   db "40770/5396-3725",0  
   dw 61818
   db "24767+E",0  
   dw 24809
   db "(:176)/289-1404)/E*36",0  
   dw 54972
   db "20973-6105-((64723-:2)/19811)-1544-4271/19154)/C",0  
   dw 14
   db "9912/C+520+851",0  
   dw 1380
   db "E*1391+:413)",0  
   dw 58871
   db "55020-343/C-C-((5917/:65375)+4003*3)/(:65334)+965+6389-3020)+A-(14740*3/11435))",0  
   dw 64547
   db "(59908+2666+4023)*(7951/2019)*5-A*3",0  
   dw 47706
   db "(2204-A/(:436)-(26445/2583)-5031/569))-2105+3559*15+295+4337",0  
   dw 28962
   db "(29656+3994/(51053/(46966/7392*(21633/389/5))))*1023+C-2861",0  
   dw 42157
   db "47533/5436+C-Z",0  
   dw 968
   db ":65416)/1996+105*259+4929/(A/3-134+2403)",0  
   dw 14
   db "(44202/C/5)+3212*3-1792/310",0  
   dw 25
   db ":457)/833-4297",0  
   dw 61242
   db ":348)+A/1966",0  
   dw 18
   db ":376)/2682*C*4+C/C",0  
   dw 13
   db "(44190/1202+3838)+4412-:504)*3-5731",0  
   dw 18212
   db "14862+4392/5302",0  
   dw 3
   db ":394)*2",0  
   dw 26112
   db "E-Z/1557*1156+1194/7421",0  
   dw 6
   db "(((:65469)/11-E)-C-4298)-A-C)/C/17*:413)+2648",0  
   dw 3995
   db "C+:344)/368+E",0  
   dw 46
   db "A+C/108",0  
   dw 9
   db "A+4197-(31623/C)",0  
   dw 4180
   db "(:65452)-1802)+158+2658",0  
   dw 1027
   db "(59754/17407+:65452))+3984+5560+(:288)+(:65340)/10532+1118+1737)/16495)-6049",0  
   dw 3514
   db "(44634)+3711/C",0  
   dw 46
   db "54898+4683+2969-1909",0  
   dw 60641
   db "Z+179-819",0  
   dw 64965
   db "19469/4297+3506/C",0  
   dw 3
   db "(37615-5935/(:197)/C/11)*7)+Z-(:23)-3523+:65453)-6052)",0  
   dw 51063
   db "41244-C+E/A",0  
   dw 3096
   db "8328*6",0  
   dw 49968
   db ":460)/E-1267+3309-E-:495)",0  
   dw 3038
   db "(42666)-5917-E",0  
   dw 36707
   db "49960/(:444)-4380/:421))/516",0  
   dw 3
   db "A/3+E*(A*510/895)-3771",0  
   dw 62087
   db "15053/Z/(61757+837/C/(1697/Z/3))+6299*4/((:471)/8064)+822*8)",0  
   dw 3
   db "Z+6386+5636*4+6097",0  
   dw 54461
   db ":65357)+(60281/E+3852)",0  
   dw 57001
   db "43201+4520/((65370-A/13710)+1621+6078)*2646/47/15",0  
   dw 22
   db "64137/3354/5",0  
   dw 3
   db ":291)+:59)/C-5871",0  
   dw 59714
   db "19828+1471*(:70)+2026/12768)",0  
   dw 63897
   db "(42376/C-2466)/13475-2520",0  
   dw 63020
   db "39848/((:65391)/9668*3722)/3978)+2124+:501)/2222",0  
   dw 6
   db "52716/5824*6770",0  
   dw 60930
   db "(5358*3*2/E)/74+A+131",0  
   dw 154
   db "60479/10384",0  
   dw 5
   db "((1854-2712-5424)+3058/:508))*29*2",0  
   dw 17980
   db ":394)*2/8316+Z",0  
   dw 72
   db "23691-1198-662",0  
   dw 21831
   db "9001*2+4727",0  
   dw 22729
   db ":65509)/19-(:65525)/14575-3797/:504))",0  
   dw 65344
   db ":372)+2620*4",0  
   dw 26688
   db "22654/(17493/3165*C/1069)*2-:237)-A*2",0  
   dw 20282
   db "(:408)+4241/952)+E-1710",0  
   dw 63886
   db "((((31325+((:94)-5291+1314+:65311))*36/A))/E)-Z/54)-A)+:244)-2889",0  
   dw 63105
   db "49712-3230-1807",0  
   dw 44675
   db "(44262/Z/75+532)*(35140/(((Z+94*Z)-719)/:122)/6)*9/7604)/595",0  
   dw 5
   db "11547-4208/866",0  
   dw 8
   db "20710-280*2-333",0  
   dw 40527
   db ":65334)+5294-3578-922/(A+:206)/390+2807)+5798",0  
   dw 5821
   db "36197+Z+6452-2534",0  
   dw 40184
   db ":65500)-A",0  
   dw 49803
   db "(:65329)*64/615+:65425))-2308+Z",0  
   dw 64070
   db "64273+2860-E",0  
   dw 1555
   db "((A-A+:130))-2442-4570)-5150+A+A",0  
   dw 55644
   db ":73)-1786",0  
   dw 48135
   db "16974+4850*2+C",0  
   dw 44677
   db "48282-A-(8256-:165)-1775)-1808+4200+4179",0  
   dw 54760
   db "3457*7-(:70)/C/5)/:159)",0  
   dw 3
   db "(53318/(:108)-A-1524+4431)+(13458/962/3)+A)*:90)/(6038/74/19+5762)-5823",0  
   dw 59716
   db "Z*657",0  
   dw 45333
   db "(32219/9809-C)/2423*E",0  
   dw 1092
   db "42217+(C-A+(9260/A/E)/E)-2433+3269-6259",0  
   dw 36818
   db "Z/22*1169",0  
   dw 3507
   db ":266)+1536-1772",0  
   dw 49939
   db "16684+2574-3922-(5373-6109/14542)",0  
   dw 15332
   db "21291/6809",0  
   dw 3
   db "30460",0  
   dw 30460
   db "(:408)-C-288)*2+:27)",0  
   dw 25609
   db "45351/(4892/C*Z)*312",0  
   dw 51168
   db "(22661+5136)-6274/7020*21685-5257+1044",0  
   dw 60842
   db "(6027-1183-5977+5906)-6357+E",0  
   dw 63994
   db "Z-3858/(:306)/14436)/E/119",0  
   dw 4
   db "58305+420/(37126/6016-5899/E)*249",0  
   dw 10209
   db "(C*19)-2695+3513",0  
   dw 20369
   db "E-1241+((21625-5603+C)/4566+3538)",0  
   dw 2342
   db ":85)/:55)*(58972+402/A)/1047",0  
   dw 13
   db "30948-(33053/E+Z)",0  
   dw 30093
   db ":65392)+(62515+(57525+(((Z-197+2025)-C*41)/5994*:29)+4288)+5461)/9636)/A+824-C",0  
   dw 3792
   db ":447)-4672+5308-330",0  
   dw 62772
   db "11736/1217-A",0  
   dw 65532
   db "39764+5264+2869/(E+4232+3076/1676)",0  
   dw 11974
   db "A-2447-1196-6533",0  
   dw 55373
   db ":144)/15387*352",0  
   dw 1056
   db "E/13+E/14+4164",0  
   dw 4167
   db ":65383)+E-2703",0  
   dw 33067
   db "36094+(28729/499-E/3)/2530*1509*2",0  
   dw 42252
   db "25292/:65339)*:504)*2",0  
   dw 22570
   db "11990+5000-5855+2378",0  
   dw 13513
   db ":65435)-301/((9397/1973+1828)*18-Z/8652)*14",0  
   dw 39914
   db ":356)/2129*E*83/(53975/17107)-C",0  
   dw 5943
   db ":496)-A/16244",0  
   dw 3
   db "39775-A-1541",0  
   dw 38221
   db "Z*E+2049-Z-217+(:475)-2377/C)",0  
   dw 4707
   db "((8699+5124+((25759/6824)-6539-C/15835))/733/5)-5765/(Z*244*2/Z)*27",0  
   dw 3294
   db "41602+5670+2847/3474/2",0  
   dw 7
   db "((:102)/857/7)-:89)-(((9665/249/2/4))*14143/15641))/12649*((18756/Z/39)-5322/Z)",0  
   dw 4360
   db "4390/(33811-E/:500))-(59346+5907+901/E)/4+:302)",0  
   dw 787
   db "(:420)-Z*78)+1316",0  
   dw 50378
   db "12017/177*907-271",0  
   dw 60498
   db "(57907+(:65308)/2372+Z/5)+(:65474)-5549-A/4674))+3766/6581",0  
   dw 9
   db ":449)-(353/53+4170)/18545",0  
   dw 3
   db ":149)-3889-(29584-4922/3383*:0))*4+1149",0  
   dw 37113
   db "49874+6097+2669/:193)+3356",0  
   dw 3360
   db "C+1203+:41)",0  
   dw 2425
   db "(:303)-4271+((22014-3186+2218)*2/1088/3)-3305)+2034-Z/10832",0  
   dw 4
   db "32746/E+(6034-1353/458)+A*8/C",0  
   dw 6
   db "29567+(((:10)/14724-(C*6-1991))/(15319-E/2938)+A)/1546+4924)/:325)/3-1770",0  
   dw 63773
   db "(17150*2+3239/3039)*(:492)-5429/3017)/49*6963+1262",0  
   dw 29114
   db "(26401/(Z+987-7+:65382))*81)-2515+5253-4308+1650*17",0  
   dw 23392
   db "Z+Z*48",0  
   dw 6624
   db ":194)/55",0  
   dw 3
   db "26622+(56391-5107/15639)+4345/E*(:65493)-4201-(17028*2/C)/C)+:65425)",0  
   dw 41985
   db ":307)/1942*5069-2481",0  
   dw 38071
   db "28223-1291/2326-A-1601",0  
   dw 63933
   db "59671/17745-:65428)",0  
   dw 64063
   db "15643-E+2849/(:385)+3945-E)*((C/183*11172)-2054/14227)",0  
   dw 12
   db "41033",0  
   dw 41033
   db "52286/12536-5704",0  
   dw 59836
   db ":111)-(21481/6922)+231",0  
   dw 14051
   db "Z*Z/1576-(36499/:65365)+2943+(((:379)-3239)/:65460)*9928-3293)/C+3232))",0  
   dw 59283
   db "C/337+C",0  
   dw 1032
   db "29401-2990+2706",0  
   dw 29117
   db "246*E*4+754",0  
   dw 42082
   db "C+6485/1932*21378-2282",0  
   dw 61852
   db "32940/145+546-C",0  
   dw 65280
   db "((45460-:125)-3073)-:65375)+1003)+1788",0  
   dw 44207
   db "C+:422)*19",0  
   dw 28177
   db ":404)/9801-1920/C",0  
   dw 61
   db "6982/C+E-2050",0  
   dw 63534
   db "55546+5687-235-3262",0  
   dw 57736
   db ":184)+Z",0  
   dw 50308
   db "50147/722/14",0  
   dw 4
   db "((:65373)/(40719+264/12907)+3549+(E/8+1916))+3658/1496-1884)+4869/E*739",0  
   dw 52469
   db "29569+C-1404/7366",0  
   dw 3
   db "4802/(Z-A+(24361/3571))+1196*2",0  
   dw 2546
   db ":115)-1673/A/(63916/11097)",0  
   dw 986
   db "(:127)+:49)-3173)+:344)-(34646/E)-3708",0  
   dw 32625
   db "(Z*859-(:381)/:178))/13340)-1608/(2880/467*A)",0  
   dw 819
   db "(43564/1716/6)+251-(40976/((:242)+(5784-5111+3818))/:65339)-68)/E)/51",0  
   dw 3
   db "C+4270-(26314+1042+5575/9344)+1374/360+6062",0  
   dw 6080
   db ":490)-846-Z/Z*A",0  
   dw 12298
   db "(A-5117+Z)+6258*3",0  
   dw 3669
   db ":65467)-(Z-A+2933)+439-4233/1790",0  
   dw 9
   db "A+1069+812+1984/(35993-666/1132)/6",0  
   dw 20
   db "40710-2332/Z",0  
   dw 556
   db "31590-A+(42932-5786/Z)+:65509)",0  
   dw 32311
   db ":65351)+Z-5783/:54)",0  
   dw 20
   db "57039-2063+:362)",0  
   dw 55179
   db ":65406)-4764-(5615*2/313)",0  
   dw 35137
   db "54344+6495-5864-6230",0  
   dw 48745
   db "C-3465/(52805/15116*:161))/(((:429)/982-1236))/12223)-2860",0  
   dw 62679
   db "12569+2401-:458)-:413)-(Z*777/9768)",0  
   dw 10464
   db "(A*4289+4389+((:416)-140*3)/C/7))-438/Z-2865-1307",0  
   dw 62229
   db ":250)/10018+((10112+:65336)/2298)-2822/5387)",0  
   dw 17
   db "(30030-:115)+5888+A)-E",0  
   dw 35633
   db "(42719/(A*:65409)+4215)-Z)+2144/530*C",0  
   dw 3087
   db "(E-4035+(43398/E))+2998+A/15",0  
   dw 3
   db "A-C",0  
   dw 64520
   db "(:299)-3565*5+600)+1382+C/15851",0  
   dw 3
   db "Z-:65487)-E",0  
   dw 61239
   db "44421-5161+1270+5550-6056-2820",0  
   dw 37204
   db "(42567-:65431)/2529)*3757-A-3694",0  
   dw 56405
   db "6787+Z+E/336",0  
   dw 20
   db "54023-3830",0  
   dw 50193
   db ":376)-(13007*3-3072/11667)/A/73+5020*2",0  
   dw 10056
   db "E*1470-Z-2728",0  
   dw 58943
   db "C*53-2112",0  
   dw 52425
   db ":65467)-6345/Z+(:335)*2/4529+E)-A*155",0  
   dw 44485
   db "(:319)-Z)-(28874-1620-2316/C)-371/(23722+C/4561)",0  
   dw 9852
   db "E-((18601/1134*3893)/C-3214/:65496))-5743-4004",0  
   dw 55710
   db "17008/2907+C",0  
   dw 1034
   db "39002-4637/Z-E",0  
   dw 456
   db "19902/A-(42645-4580/7773)",0  
   dw 1526
   db "9136*(36637-58/11235)/:65513)",0  
   dw 142
   db "55201+6535/:395)-:55)",0  
   dw 65349
   db "48110/C-1922/19451",0  
   dw 3
   db "3782+84+C/716*7229+700",0  
   dw 44074
   db ":65517)-4115/(:80)-6384/:115)/A)",0  
   dw 2800
   db "E*336+4682",0  
   dw 18794
   db "5560*(E*(37086/Z/141)+936/277)-2148*2",0  
   dw 29064
   db "(:88)*3+6452/459)/28-C/5972",0  
   dw 10
   db "((11909/A)*52/((54007/Z+2531+(E/:65452)+3336+E))-5953/168))*4+Z",0  
   dw 47701
   db "54941/(19682-67/3259*E)-1600+180/C",0  
   dw 62
   db "E/6*A/14",0  
   dw 6
   db ":290)/10604*(:256)/1729*2737/11811)*4621",0  
   dw 55452
   db "Z-2037",0  
   dw 63568
   db "C-E*59/16124+2635",0  
   dw 2638
   db "55842/15033*(19831-(C-5074/6295)-:65382))",0  
   dw 57924
   db ":238)*120+:44)-6131",0  
   dw 48663
   db "50176+572-E/2895",0  
   dw 17
   db "Z/3+4517+A",0  
   dw 4553
   db "54375/C*:41)*2",0  
   dw 20072
   db ":504)/51*2926-4882",0  
   dw 9748
   db "968-468*79/E/42*1914",0  
   dw 42108
   db "(A/(:467)-3438/17463)*9581)-E-C/Z*36-3611",0  
   dw 15793
   db "Z/4+6348-C+5143/156",0  
   dw 67
   db "(63584+:65531))-1395+382",0  
   dw 62772
   db "39191+:308)-4969+(2277/27*40)+5852",0  
   dw 43620
   db "6175-:65377)/1139+1789-A",0  
   dw 1781
   db "(:65379)-4249+:89))+A+610-:91)",0  
   dw 59355
   db "A*:362)+576*A-(49886+A/:65419))",0  
   dw 41744
   db "59063+E",0  
   dw 59105
   db "C*59+:65444)/(:222)+1897/E+E)",0  
   dw 49
   db "Z*652+3102+E/:65441)*1405",0  
   dw 7025
   db "(26057)+E/E+C+Z-3720",0  
   dw 63535
   db ":156)-6274",0  
   dw 30580
   db ":93)+4220*6/A",0  
   dw 2959
   db "12031-5842+1209/:65329)+3797+417",0  
   dw 4226
   db "30085/(Z-1379+6420-5017)*137",0  
   dw 44251
   db "11616-172+6210",0  
   dw 17654
   db ":175)-A+Z",0  
   dw 13636
   db "2923+((18830/2514+C)*E/C+361)-193",0  
   dw 3133
   db "25251-2978/2351",0  
   dw 9
   db "C-(23604/(:233)/8251)/Z)/A/11*9291",0  
   dw 55746
   db "Z-E*1283",0  
   dw 34641
   db "(48549/A+(52382-A/:243)))-1712/216*3380+295",0  
   dw 30715
   db "29812/((59730/18096+3276/972)+3347/(52863+2846/18056)/273)",0  
   dw 7453
   db "A*5020-A/:179)",0  
   dw 332
   db ":65518)*2",0  
   dw 33276
   db ":65500)+4226",0  
   dw 54042
   db "E/7",0  
   dw 6
   db "26844/2845*2902",0  
   dw 26118
   db "46330/Z+1586",0  
   dw 2257
   db ":382)+(:489)+5615/671)/E+C+2230",0  
   dw 4500
   db "65373+(:65490)+6313/480)",0  
   dw 65379
   db ":125)-Z+Z-708",0  
   dw 65085
   db "34958-3759-857/8315",0  
   dw 3
   db "35068/7438-A-5266",0  
   dw 60261
   db "(A/2)-5129/:405)*Z-(:118)+2794/E)",0  
   dw 1816
   db "(E-875-((8934-2475)/:206)))/359-((C-E/Z)-4989/15587)+5272-C+4674",0  
   dw 9094
   db "((61240/6119-A-C)/15422+1269*(:114)+C/:390)))/1191-4932",0  
   dw 60607
   db "E/13+A",0  
   dw 16
   db "43430+3775/2709",0  
   dw 17
   db "15898-Z+(4682+1525/(5302-E/162))/1144",0  
   dw 14
   db "(14559+1650-(47987/5797))-5463-(43368/5108*Z)+5556-6069-3948",0  
   dw 5725
   db "64234+874/2007-3130",0  
   dw 62438
   db ":230)+:79)/12609-C-3896",0  
   dw 60615
   db "1022-A*27-206-2680-A",0  
   dw 24344
   db "32499+1768+C",0  
   dw 35296
   db "36689/C*Z/169",0  
   dw 14
   db ":410)-C+:353)/273-A/2",0  
   dw 9
   db "((:65516)+56+3803-762)-969)/1446-5884+6202+6380+(:429)+C/(34619/8824+3116))",0  
   dw 6750
   db "5874+2996-3813+5417",0  
   dw 10474
   db "41118-4199+4870",0  
   dw 41789
   db "C+838/556",0  
   dw 3
   db "7004/1948+4172-Z-5965+1980",0  
   dw 121
   db "42817/11128*3331+4136",0  
   dw 14129
   db "C*E",0  
   dw 43218
   db "32319-5192",0  
   dw 27127
   db "(65108-3882)-6304",0  
   dw 54922
   db "E+(:65329)+4195/1572)-3735-E+6519*20",0  
   dw 55740
   db ":267)/:322)*2181/1277",0  
   dw 5
   db "8687+214+5444",0  
   dw 14345
   db "25660/6571",0  
   dw 3
   db ":65336)-2401+E+1258",0  
   dw 65397
   db "4615*((30671/990/4))/7558",0  
   dw 4
   db "((:236)-3465-C-C)/7992*3378+6546)/E/E+Z",0  
   dw 86
   db "65364-2851/14619",0  
   dw 4
   db ":343)*3/:65443)+5386",0  
   dw 5390
   db "8051-Z-6001",0  
   dw 1981
   db "24888/5252+606-C+E",0  
   dw 65159
   db "(((51567-(43972/5003))/13251-C-3667)+C-1174)+3276+(64031/1932+6400)*6",0  
   dw 29226
   db "(6552/1324-4177/19595)*Z*:380)+A/E",0  
   dw 951
   db "48491/10333*((28521-17)/E)-5494",0  
   dw 62754
   db "(7774+929-2285)-((13348-(4783*4/4199)-(17380/3744))+679/1772)*9+4485-2308",0  
   dw 59876
   db "(45346+1732/6405)-((Z-34-2076)+5800/221/2)/A/C+2750/854",0  
   dw 3
   db "A*2402+2286",0  
   dw 33512
   db ":65531)*254",0  
   dw 51054
   db "E-6493-Z+4586",0  
   dw 63602
   db "1248+E+A",0  
   dw 1303
   db "E/8+(:406)+:65379)/7479)*C*4-2531",0  
   dw 46861
   db ":128)-C/8382*5416+(:164)-5992/2235)/Z",0  
   dw 392
   db "((13402-6107/:65377)/4)-2601-3498)+(Z*A+Z)/16642",0  
   dw 3
   db "(A-(((:65350))+3620*14)+3111/9771)-2056/18707)-6210/A+4673/1831-664",0  
   dw 64877
   db "62761+222-1796",0  
   dw 61187
   db "50255+4993+A-5530-1619",0  
   dw 48112
   db ":387)/:229)-288-5498",0  
   dw 59753
   db "23993+4575+1707/(11180-5088-((8708+2151+5131)/A/326))-1242",0  
   dw 64298
   db "43480-Z+A-1680-Z",0  
   dw 41675
   db "29585+4783-2904",0  
   dw 31464
   db "(39377+3072/1608)+4334+1880/798+910*39",0  
   dw 35763
   db "24680-A-:308)+4457",0  
   dw 28938
   db "44577-3316-1930",0  
   dw 39331
   db "(28650/:364)*132/162)+E+5269*(19594/3794)-A-5834",0  
   dw 20738
   db "(C-5781-5046)+(:357)/:159)+1445)/A",0  
   dw 4399
   db "(:65316)+1438-6455)+5074/9650",0  
   dw 5
   db "18891/1735",0  
   dw 10
   db "(Z*906/6455)-5183-(:257)-((Z/17+:65289))/48+5908)/9501)-6432",0  
   dw 53927
   db "(22163-5033/3252-5156)/E/323+405+C+2827",0  
   dw 4265
   db ":65411)+627+(22661/6293)",0  
   dw 53142
   db "(60899+3167+2254)-Z/51-(:476)/215/A*(:74)+1010-5585/2505))/11821",0  
   dw 5
   db "(A-C+E)/12212+880-C-3355/11400",0  
   dw 5
   db "A-4753+E+870",0  
   dw 61708
   db "(37011+1231/5975*C)+5987*3-((:65409)-5055+3559)+5375-C)+3358-C",0  
   dw 35766
   db ":218)+(C/184+2894+980)+C/E",0  
   dw 1067
   db "42536-((:345)+2834-6284)/6286+(C+554/Z))+5741",0  
   dw 48248
   db "46403/Z/152",0  
   dw 4
   db "24272/5483-6034",0  
   dw 59506
   db "64564+4630*15/12815+3106",0  
   dw 3110
   db ":158)-(:281)/182+((6325*(10033+445/971))/16381+204+C))-4026/:150)*401",0  
   dw 8020
   db "24280-3122+C",0  
   dw 22187
   db ":443)/7939-2848/:65479)+E",0  
   dw 46
   db "7148-3284*11-C+754+5419",0  
   dw 47648
   db "Z*754-((41893/13618+1905)+E*31/12685)",0  
   dw 52022
   db "((29452-4756/7451+A)+(4769-E+5943-6054)+4003)-Z*2-5118",0  
   dw 12014
   db "(55264-(8980/1259*7751/9230)+C)-2045-6084+5846",0  
   dw 54005
   db "(((Z-E/(14426+E/3375))+(7832-6534/(56251+2265/3128))-5450)-C)-3547+E-C",0  
   dw 54601
   db ":464)",0  
   dw 65482
   db "(:260)-(C-A/A+4978)/16316-Z)+4633/526-Z",0  
   dw 65475
   db "52901-A",0  
   dw 52888
   db "53457+2664",0  
   dw 56121
   db "C+4558-3311-3595/(:167)-4833/6779)",0  
   dw 16054
   db ":389)/10846*14577+:191)",0  
   dw 61576
   db "A+A/6",0  
   dw 4
   db ":65431)+E+807/320",0  
   dw 4
   db ":97)/56-3379+Z+:65444)",0  
   dw 92
   db "Z/A+5536*8/1094",0  
   dw 40
   db ":259)-4802-4650",0  
   dw 44822
   db "((:256)+(:65527)/1167+4389-3729)-4656)+C/C)/7",0  
   dw 4
   db "948*(E/13-558/(:43)-E+1497))-((21696-3992+4888)+6153/5346)-Z",0  
   dw 5614
   db "19392/(58326+1042/9186)*(:65287)/2656/5)",0  
   dw 9696
   db ":65512)+((62634-2231+Z)-173/((:350)/16639-(C-1748/11251))-4386/2566))-813",0  
   dw 1753
   db "(3516*12-Z+1470)/13717+4246*4-(45835/(:65306)+3451/8328)-5977)",0  
   dw 15334
   db "C*45/15306+1349",0  
   dw 1352
   db ":281)-3852-5188+3503/16022*A",0  
   dw 39
   db "A+(34857/C+Z)/2-3013",0  
   dw 62580
   db "Z-1780+6408/1345+C",0  
   dw 1032
   db "Z*198+A/3720",0  
   dw 3
   db ":273)*12*4",0  
   dw 46272
   db "(:247)+A+2674)/C/3*434/1844",0  
   dw 4
   db ":193)/3837*20721+5318/193",0  
   dw 10
   db ":65387)/15905-58",0  
   dw 65481
   db ":369)+(C/309+1603)-1679-:65365)/(A*2965/6142)",0  
   dw 2581
   db "(47137+3533+6481+E)-(45099+E/2056)+:41)-6050+2427",0  
   dw 53742
   db "Z-((52375+(15853-1235*2/8618)-1332)-1633/16389)+1246",0  
   dw 1312
   db "27783-4155/917*855",0  
   dw 21375
   db ":418)/C+4593*6",0  
   dw 27636
   db "(62471+((36633+106)/1062+Z/33))-1599",0  
   dw 60875
   db "55023",0  
   dw 55023
   db "39812+(14974-C/:244))+2326",0  
   dw 42168
   db "(:65433)+2159/1566)+1894-1387",0  
   dw 516
   db "E-(:29)+A-305/21302)+4548-(((22179/:65345)+6370+C)+2577+1799+A)/3718+E)*12",0  
   dw 54504
   db "21159/6331+339/39+4011",0  
   dw 4019
   db "((29593/1750+2968+4)+4019*(A+Z/21))-Z-:65453)",0  
   dw 20500
   db "C/198-Z",0  
   dw 65472
   db "7216-(31185/6420)*3/4375*:194)-4163",0  
   dw 62145
   db "24005/((:282)-A-E)/E/19)/E",0  
   dw 7
   db ":81)/8126-A/14474",0  
   dw 4
   db ":365)*2-((37305/E+1058)-(52079/C+E/7)-A/110)+5923",0  
   dw 38978
   db "61235/2141*Z",0  
   dw 1932
   db "57164+((3027+E+808)/595)+A+4531-5832",0  
   dw 55882
   db ":75)/2885/4+2279+2822+907",0  
   dw 6012
   db ":65352)+6309+A",0  
   dw 56241
   db "29199-1102-:194)-1501-:370)",0  
   dw 25940
   db "63097+3970*E",0  
   dw 64302
   db "61497-5972+1190+((((C*62/17470)*3891+4806+E)/C+5234/C)+5515)",0  
   dw 62235
   db "54845/E-5910-(((35040+1784)/7117+(:65459)/4837))*A)/12539",0  
   dw 4
   db "C+4658/:495)+362-C",0  
   dw 64898
   db "E/5-6529+C",0  
   dw 60044
   db "E+2125/414",0  
   dw 5
   db "48738/:65412)-C",0  
   dw 64510
   db ":93)*27/Z/A+(C+A-:437))",0  
   dw 914
   db "(C-Z+3604+A)*(12944+Z+(:65521)/18669)/2408)-A/:65531)",0  
   dw 113
   db "52734-1003",0  
   dw 51731
   db "(39508-E)+602+6039/C",0  
   dw 44
   db "33650+E/1104+6165",0  
   dw 6195
   db "58768-3299+:495)/E*19",0  
   dw 25175
   db "A+3643+6121*4/8175*346",0  
   dw 1384
   db "A*E/(:364)/223/2)/9",0  
   dw 8
   db ":304)+:9)/4718",0  
   dw 3
   db "(39997/(18876-5432/4473)-(E-Z+574)/1605)*1998+C*3-3386",0  
   dw 41659
   db "A*2320+Z+Z",0  
   dw 30298
   db "18959/3602*862/1272",0  
   dw 3
   db "C-1694/7720-:347)-E",0  
   dw 65048
   db ":132)/9432+C/223",0  
   dw 4
   db "(33622+E)+(36230-5383-C/6396)-4888-4034/Z",0  
   dw 358
   db "C*3+3192/(1025-1693+2205-1402)/12+(C/235)",0  
   dw 7
   db ":71)+3787+:65469)+695+3209-E",0  
   dw 57600
   db "44590+2616",0  
   dw 47206
   db "28388/C-A",0  
   dw 14
   db "56137/13868*13848",0  
   dw 55392
   db "21072/(15737/1466+3994)-A+A+4235",0  
   dw 4240
   db "32344+5040",0  
   dw 37384
   db "34384",0  
   dw 34384
   db "(Z/A*6645-1936)+E+5395+38",0  
   dw 36764
   db "(16265+1325)+3784",0  
   dw 21374
   db ":107)/15181",0  
   dw 3
   db ":249)*90-5752/9899*Z/11",0  
   dw 18
   db "24002/1766+3627",0  
   dw 3640
   db "(4597-869+(E*E/2))-3828*23/(Z*E/208)*E",0  
   dw 58086
   db "8256-2571-3136-E",0  
   dw 2507
   db ":65423)-507/8/7",0  
   dw 8
   db "6559*7/:376)-4094/20343",0  
   dw 3
   db ":171)-2053/1441",0  
   dw 9
   db "(47343+:65419)-(4892/Z/12))-3397/(9697/(C-:235)+C)+C/277)",0  
   dw 14967
   db "Z*E-(Z/12+4577)",0  
   dw 63852
   db "14303/4226*E+(55720/16551-6293/9607)/15*4575",0  
   dw 36600
   db ":147)+5908/5625*1649",0  
   dw 11543
   db "30971+1922+Z",0  
   dw 32962
   db "24921-4675+A+((41519-750/12453)-586+1066-Z)",0  
   dw 20673
   db ":65377)-(28475/:65423)/2)-3263",0  
   dw 62717
   db "8870*5+:65337)",0  
   dw 46034
   db "22075+1413-2362*2-:461)",0  
   dw 41487
   db "(:126)-4339+:502))+3943",0  
   dw 53025
   db "(:466)+3735/412)+E*828-Z+(C-C)",0  
   dw 41331
   db ":217)-3112/C-5808/:245)+3869",0  
   dw 4001
   db ":15)*36+E+E",0  
   dw 27696
   db "31896/A+(E/(41521/C/6)+E)+1680+A",0  
   dw 4195
   db "(E-A*1436)+6406+A-1806",0  
   dw 46257
   db "14560+141*2",0  
   dw 29402
   db "(45204+(55872-E/1583*A)-2262)-A-E/:62)-3673",0  
   dw 61898
   db "43992/9506-C",0  
   dw 64511
   db "(51338-1859+1052+5764)/(63043/C)-693-2046+Z",0  
   dw 63788
   db "Z-1749+E-Z-(:116)+3819/16210+E)",0  
   dw 63784
   db "Z+:275)-925+:65321)-A",0  
   dw 65501
   db "(E*464+4387-5231)/E*56",0  
   dw 24808
   db "60058/11616+4148*12",0  
   dw 49836
   db "42243-Z-:65502)",0  
   dw 41917
   db "51715/14193*13880+((41753-6009/8593)*8282/Z)/E",0  
   dw 1002
   db ":302)/139*A*(C-742/(6552-5553-5382/C))",0  
   dw 260
   db "(A*:91))-:413)/:104)-4240-5347",0  
   dw 55952
   db ":65438)+(3629+2423+A)+1515/4269-Z-5654",0  
   dw 59816
   db "(:474)/2372)*18182-3247",0  
   dw 51299
   db ":34)+361+E",0  
   dw 38297
   db ":318)-241+((32923/Z+605)+C*3-1637)-C",0  
   dw 24102
   db "38315-4721+:21)+((Z+2483*17+4056)-5998/:65444))+4135",0  
   dw 37934
   db "10329*5+C/E/(A*2522/((20370+Z/4370)+1002+5415))/72",0  
   dw 3
   db "((C-6507-1134)+E+4817)+5562+E*A",0  
   dw 50063
   db "(5528-C+1066+A)*(20276-3456/A/124)+4109/8497",0  
   dw 7
   db "38392/3594*1387*3",0  
   dw 41610
   db ":278)-Z+3887*A-1672",0  
   dw 63250
   db "18447+:97)/4382+4338",0  
   dw 4342
   db ":201)-116",0  
   dw 39820
   db "44766/14809+(5314*5/7144)-5755",0  
   dw 59787
   db "43267/7457*E",0  
   dw 210
   db "C/(E/(16314*2-Z/5370))*Z-(A*(45480/9210)+3112+273)",0  
   dw 6706
   db "46186-(Z*161-E/Z)/14439-3123",0  
   dw 62416
   db "55355+1310/9436",0  
   dw 6
   db ":65371)/5206",0  
   dw 12
   db "((:23)-:65337))+E-3408-4382)/A*189",0  
   dw 60102
   db "E+2604*8",0  
   dw 21168
   db "Z/A",0  
   dw 5
   db "E+1148-3254-Z",0  
   dw 63403
   db "(((:28)+5361+((21901+(:287)/16642))-C/C))-:65414)-3599)+(38363/C/2/3)+4945)+E+A",0  
   dw 3407
   db "24549-A-A-(24803/4320)",0  
   dw 24518
   db "31579/A+(62033/(11372-E-(11311-5477-2339/754)-A)*Z+1885)-5517+1525-4392",0  
   dw 61811
   db ":16)-3063/A*12",0  
   dw 57648
   db "E+3727-2601*19",0  
   dw 22192
   db "Z+5146+E*5-6441*2",0  
   dw 39688
   db "59588-(52252/5851+:82))-4137/:44)",0  
   dw 283
   db "57390/11723+(12532/(:101)/A+A+2772)+1878)",0  
   dw 1885
   db ":408)+1718+(51974+Z/:187)*2173)/C*476+Z",0  
   dw 9589
   db "20869-3613",0  
   dw 17256
   db "26732/A*4/367",0  
   dw 22
   db "47846-C-Z+963",0  
   dw 47711
   db "13818+E-2116",0  
   dw 11744
   db "5545+Z+1933-Z+(2826*21-6270/:65395))",0  
   dw 7481
   db "44575+(34832/(39501/1111+26)/129)-3379",0  
   dw 41200
   db "57915-3348-C-1857",0  
   dw 51681
   db "64115+6265-4495+C+2481",0  
   dw 3859
   db "53180/6377*2364",0  
   dw 18912
   db "38843/12584*21380",0  
   dw 64140
   db "8687/2137*1013/1208-6423",0  
   dw 59116
   db "32960-6306-A-2124",0  
   dw 24517
   db "C-(:78)-:232)/:9))+4874+A+2561+3276",0  
   dw 11725
   db "48093/6500*(38435/4965-(12801/761/3))+:484)*255",0  
   dw 52785
   db "A*3148/7246+1293+4412",0  
   dw 5710
   db ":159)+(:65525)/(:457)-5133+6198)/3)*4",0  
   dw 26636
   db "38541+4212",0  
   dw 42753
   db "11648/2445",0  
   dw 4
   db "(:83)+434-5423)/E*19+(:65490)-E/17608)+C+:59)",0  
   dw 29931
   db "1105*E-(:298)/:65418)/49)",0  
   dw 46405
   db "20074+4842-5294+1731",0  
   dw 21353
   db "(11675+1947)/C+1956",0  
   dw 1969
   db "38627+Z-3226",0  
   dw 35470
   db "39560/535-4968/16542*(:327)/2475/4+(C/198))",0  
   dw 30
   db "Z-A+4789/E+Z*A",0  
   dw 2392
   db "((59538-:65366))+950-E-3833)",0  
   dw 56417
   db "E*A-2796/6701+4458-E",0  
   dw 4425
   db "((57216+A/A)*5/1553)/2+(36721+4443/(18448/(E*494/2332+4886)+1137))+3296",0  
   dw 3339
   db "A*3368+A-(C*9-5955+Z)",0  
   dw 40422
   db "(Z+(:65417)-1573+4346/A)/Z)-(:510)+4970/1210/2)-E+5778",0  
   dw 5733
   db "22152/2706-Z/3905",0  
   dw 16
   db "15921+(C-1477+6351)/:55)-1753+1788",0  
   dw 147
   db "14196+C-472/(((26205/7623)+Z/3*1951)-(45948-2517/9590)-4196/Z)",0  
   dw 23
   db "14370-A/A/((33441-2897-503)/5376+(1880*9/2265+425)/141)",0  
   dw 368
   db ":65449)+4161+(:0)/148*:237))/3113",0  
   dw 5
   db "((:329)/3969*:65427)/164)/2+508+726)+235-E/395",0  
   dw 3
   db "(48885+(:37)/16003+6160)/4073-2916)/51-2216+E",0  
   dw 64590
   db "15694+1106+6147",0  
   dw 22947
   db "((C-5755/5962)*:125))-112*25+5671",0  
   dw 1585
   db "34003/2830+5287/851+Z",0  
   dw 75
   db "(25210-6116*2)+2972+C-C-1058/6229",0  
   dw 6
   db "48035-2879",0  
   dw 45156
   db "C+((11030-3664*5)/(A+(C-5093-947/:65487))*E*(48339/11131))-3467/8149)-A/A-89",0  
   dw 65525
   db "C+237/A+5452+1882+6224",0  
   dw 13655
   db "(:448)+2121+E)-A+5870",0  
   dw 45988
   db "7542+488+(31562/6901+:490)-A)",0  
   dw 8677
   db "((Z-C)/E/E*497)*2-(:228)*2/:65452))",0  
   dw 33303
   db "E-2742/6037",0  
   dw 10
   db "58981/17322+5367*11",0  
   dw 59070
   db "54736-3297+6233+:29)-Z",0  
   dw 57799
   db "(53557/:149)*16502)-5257-5000",0  
   dw 39249
   db "11187+Z/2386",0  
   dw 4
   db "623/125",0  
   dw 4
   db "(C*4+A)*3*3-5560",0  
   dw 31601
   db "61083+674",0  
   dw 61757
   db ":62)+5434+(36244/3404-527/Z)/828",0  
   dw 9
   db "49977/11094",0  
   dw 4
   db "40716-3708-522/9891",0  
   dw 3
   db "(48501-A-2490-(7191/2223*10423/9980))-:44)/11166-:439)-E",0  
   dw 65045
   db "38829-2080+Z",0  
   dw 36818
   db "((42190+3771+(:65512)+4774/Z)-(55922/C+Z+5158))+185)-2775/10050",0  
   dw 3
   db ":205)*2/2926*C",0  
   dw 9261
   db "Z/17",0  
   dw 4
   db ":490)*94+6499+3113-E",0  
   dw 5698
   db ":36)+3921*2",0  
   dw 32986
   db ":65356)/9957-2875/19589",0  
   dw 3
   db "31414-C+E",0  
   dw 30427
   db ":99)/6013+4688*12-A",0  
   dw 56339
   db "(:65412)+3691+2905)*2/1858",0  
   dw 20
   db ":65389)-4782-2967+6030+4204",0  
   dw 54451
   db "A*2573+4684/4147+2766-5221",0  
   dw 63090
   db "25483-4774-2308+A",0  
   dw 18414
   db "8741*5-2077",0  
   dw 41628
   db "(29112+4132)/((:183)-1876)/3365)+2276+1860",0  
   dw 12447
   db "E/2+(58437-2192-1262/15819)",0  
   dw 24
   db ":125)+:488)-5260+1465",0  
   dw 62451
   db "25010/Z*A-(52842/(A+360+5391))*A",0  
   dw 61061
   db "Z/6+4254",0  
   dw 4265
   db ":253)/C/7",0  
   dw 5
   db "(22959+511/5115)-:213)-:65336)-3417",0  
   dw 60968
   db "C*28-253+3799-6322",0  
   dw 26036
   db "A*E+Z",0  
   dw 615
   db "24582/8076",0  
   dw 3
   db "E*E-A",0  
   dw 1751
   db "46336-1678+296",0  
   dw 44954
   db "42404+C/1795",0  
   dw 24
   db ":263)/10861*10010",0  
   dw 30030
   db "12894/Z*90",0  
   dw 16740
   db "(56843-1636+C)/12891",0  
   dw 4
   db ":290)+1965/A/518",0  
   dw 6
   db "18859+269-4922+4269",0  
   dw 18475
   db "43654/1315",0  
   dw 33
   db ":460)-1133/(:406)+C/:387))-5776*3*2",0  
   dw 41214
   db "47000/C+4738/A",0  
   dw 367
   db ":69)-4625-6013+841/:65339)",0  
   dw 63
   db "38909+4236/5136",0  
   dw 8
   db "C+6388-Z-2219-Z",0  
   dw 5060
   db "(A-3993+1387)/A+2390",0  
   dw 7231
   db ":392)",0  
   dw 38963
   db "2697*7-5798/2415+((:384)-4854/288+A)-472/16746)",0  
   dw 8
   db "10225/2114-(42660/4549*C/2350)*(:110)/2809*729/(:460)+6469+3571+4696))*828-5547",0  
   dw 6045
   db "((40839+(:25)-C/(A/3-5812/:65502)))-Z))/13480*8118-(11953+2161/729)-447",0  
   dw 23888
   db "A/2+300-5388+440",0  
   dw 60894
   db "11814/1397*2628-E",0  
   dw 20982
   db "(48963-E/(1175/Z/3)+7)/2156+(E+4463-3800+2335)",0  
   dw 3044
   db ":300)+E-363",0  
   dw 42883
   db "57713+4955/8129+6042",0  
   dw 6049
   db "(:358)/(:120)+2890/11465))+E",0  
   dw 17637
   db "47639-(:65480)-5699+Z/E)/14906+E",0  
   dw 45
   db "(:65398)*104/9384)*9985/(:65355)-3906/(5069+:29)-2487/340))",0  
   dw 6
   db "8396-(22763/1661)-4802+1858-(:353)-A/894)+Z",0  
   dw 5501
   db ":38)-Z+1521-4625",0  
   dw 95
   db "C/229-E",0  
   dw 65498
   db "13281+2484-1691-35/E",0  
   dw 334
   db "26384/A",0  
   dw 2029
   db ":156)/A*A+5947+5735",0  
   dw 48524
   db ":65493)/Z+5015",0  
   dw 5920
   db "(33978/6447-2965)+4894/137-5269-4361",0  
   dw 55920
   db "55928-4775+C/(:65289)/(19467-4710/2944)/(:65372)-3478/:33)))",0  
   dw 1023
   db ":481)/18016+2191/E",0  
   dw 52
   db "9185-3663+2091+3878/1263",0  
   dw 9
   db ":440)/2184",0  
   dw 3
   db "46899-213+3766-(Z-5682/14630+1826)+(:15)/E+1751)",0  
   dw 50391
   db "26004-(6432/1583+Z)/A",0  
   dw 1994
   db "((57544/2266+6449)+:232)*2)*2-3503",0  
   dw 23165
   db "(156*:484)+4279/934)-Z",0  
   dw 65503
   db "((:148)*2-C+:160))-:65409)-1532-927)+3182",0  
   dw 32244
   db "57120-6140-438/E",0  
   dw 1203
   db "A/2*(Z-5090/6891)",0  
   dw 48
   db "39536+C+((37008/C/7)+2333-5047+:444))-4065",0  
   dw 38115
   db "(31246/322-233)-E+1567/214",0  
   dw 6
   db "44414/5436+E*558",0  
   dw 27900
   db ":65532)*2+E/A",0  
   dw 2829
   db "46561",0  
   dw 46561
   db "(:65)+5353-A)-4285+5459",0  
   dw 56435
   db "22195+4190+2500+(:70)/A-1334)",0  
   dw 30465
   db "(:389)/E+A)*A/((27766-146)-591/1734)-4510",0  
   dw 62084
   db "E+C*54/:65396)-:302)/C",0  
   dw 63
   db ":65512)+1971-6471",0  
   dw 60981
   db ":65473)+Z/4708",0  
   dw 7
   db "18455-2070/851",0  
   dw 19
   db "(59006/E-689/Z)*1883-(28279+1465/A/599)",0  
   dw 18827
   db "39030/Z+3325",0  
   dw 3890
   db "E-:65423)/8260",0  
   dw 7
   db "2925*9-Z/5932",0  
   dw 4
   db "((40945/8981+4116)+:420)/927)+6404-330",0  
   dw 6079
   db "61263-5264+Z/16901",0  
   dw 3
   db "A-2964-2634+3380-(:47)/3434/3)",0  
   dw 63327
   db "29907+368/3936*((21070/C)/2)/13+A",0  
   dw 18
   db "27218-5731",0  
   dw 21487
   db "50212+4807-4571-4580+624-C",0  
   dw 45463
   db "14081-2015+5024-Z*2",0  
   dw 34042
   db "22015+2221+336",0  
   dw 24572
   db "7828+4993-:65314)/3846",0  
   dw 3
   db "32043/A-3211+1380-(55048+E+1274/2281)/Z",0  
   dw 8
   db ":65312)/(20081)-(5817+4820/1839+(40195/10215+3803))/4137",0  
   dw 14
   db "(((17846-683-6459)-(41655/13736+6399)-E+E)-5081-C)+1884/15",0  
   dw 5
   db "62275/((13277/1855*1454)-((:65349)-226*51)/2885*Z)+2602)-88/17066*20186",0  
   dw 60558
   db "41050/6928+5861+2362+2269-4493",0  
   dw 6004
   db ":65363)/(:248)/134+:125))*Z/3660",0  
   dw 3
   db "28226+Z",0  
   dw 28295
   db "C/299*10372/(E+E/14)/Z",0  
   dw 75
   db "3393*5+1404/5000",0  
   dw 3
   db ":301)-335-(5985-1475+(31221/7683+(((Z/14*13979)-5002+A)-1714/Z))-2528)",0  
   dw 46681
   db "C/161*E-1095-E",0  
   dw 64651
   db ":65353)+5040-4460*2",0  
   dw 17540
   db "17856*2/4190-4476-:504)-1570",0  
   dw 59193
   db "Z*562-(:486)-Z/3800)+4549",0  
   dw 43324
   db "A-Z/(:354)-509+782/(46340+5211/12385))+4952",0  
   dw 4956
   db "(:65441)-E/1347)+Z/12",0  
   dw 6
   db "A/3",0  
   dw 4
   db "60109/6167*48",0  
   dw 432
   db "34487",0  
   dw 34487
   db "51487/Z-:427)/(:65467)/E+5503)",0  
   dw 10
   db "30771-1012/9084-6078/9955",0  
   dw 5
   db ":230)-1233-:244)-C",0  
   dw 47510
   db "1716/136*C",0  
   dw 12348
   db ":65330)/1935-1792-2765",0  
   dw 61012
   db "(47197)/(16701*2/1235*A)+3403-5313",0  
   dw 63760
   db "12225/Z/((30712/3321)*E/8)",0  
   dw 3
   db "23687/E-4486",0  
   dw 61613
   db ":65425)/53-5083+A",0  
   dw 60479
   db "15086/2544*5700/4900",0  
   dw 5
   db "(:151)/:53))+380-Z-275",0  
   dw 283
   db "(51366-842)+(23213/E-E)+E/Z",0  
   dw 740
   db "61030/:65433)*A*421",0  
   dw 21892
   db "(9039-:427)*6)-5645",0  
   dw 43975
   db ":65389)/E-(:193)+405/A)*220",0  
   dw 52580
   db "(58066-Z+4147)/(A+3020+Z/:461))-(((E+1628-4937)/Z-309)/E/3)*3/5425+1759",0  
   dw 1767
   db ":373)+:15)/(:511)/E/38)/274+5090-4358",0  
   dw 735
   db "25597/6670-(24954/5001-(:230)-4952/11437))",0  
   dw 2
   db "23370-1494",0  
   dw 21876
   db "((59474-624-6074)-(A-:141)/20937)+3815)-2610+:410)-(:183)/5046)+1768",0  
   dw 59011
   db "45794/(C-A/58/4)/1548*3643-4763",0  
   dw 20738
   db "41506-(A-427/8598)/:457)+3504*A",0  
   dw 45734
   db "26739/C",0  
   dw 25
   db ":253)+:333)+5905-(C-534+1954/783)",0  
   dw 45744
   db "51812/11291-6412-:65409)",0  
   dw 58932
   db "(((Z*920-A)/9613*C)+6177+(:261)/(E+906+3337)+5761))/4174",0  
   dw 4
   db "45287+1921+5946",0  
   dw 53154
   db "9700*5+:90)-C/11374",0  
   dw 4
   db "39411+5905/:85)*335-416",0  
   dw 22029
   db ":65292)/3373/2*5199+1349",0  
   dw 37742
   db ":12)-E-C/C*156/Z",0  
   dw 124
   db "8659-1410+2355*2+1099",0  
   dw 20307
   db "19676-3979/:194)/19",0  
   dw 4
   db "(59136+82+6041)-3506",0  
   dw 61753
   db "(41161+E)-C/8754*C-974",0  
   dw 3142
   db "46969/:24)",0  
   dw 3
   db "65000+1390*A+(50515+((25214+5799)+738/1597)/:129)+3921)",0  
   dw 15219
    db 0

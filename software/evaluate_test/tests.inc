    db "38179-194+333/4116-20631/7230+53",0
    dw 59
    db "28911/46+1433-74+22+9*25",0
    dw 50450
    db "61474-94/189/16/1+47574+293/175",0
    dw 273
    db "21153*2-155+52255",0
    dw 28870
    db "58303-393-286",0
    dw 57624
    db "36230-50889",0
    dw 50877
    db "40109*1-142+173+130",0
    dw 40270
    db "36503-377/85*41",0
    dw 17425
    db "50987/4182/1*4354-334",0
    dw 51914
    db "3319-97/2+146",0
    dw 1757
    db "2748+59+208*10-41449",0
    dw 54237
    db "26660+64",0
    dw 26724
    db "33258+52508-37*2",0
    dw 40386
    db "64127-34128/23+59414",0
    dw 60718
    db "53523/2916/2+40*209",0
    dw 10241
    db "1011-95/19+49*32",0
    dw 3104
    db "51973/9490*113-35+172*65",0
    dw 45630
    db "29571+385+122-322-134-262",0
    dw 29360
    db "9523/86/1+36+282-165",0
    dw 263
    db "25726/126-20/10+279+281+365",0
    dw 943
    db "14263-78-100+180-339-122/1649",0
    dw 8
    db "59245-217/8587+309",0
    dw 315
    db "37540/159/28*4703/131",0
    dw 287
    db "31195+79-229/26*26-36407",0
    dw 60173
    db "9655-32*2*2",0
    dw 38492
    db "10654+391-15+240-227/63*103",0
    dw 18025
    db "7171/71*539/91",0
    dw 598
    db "51746+158+174",0
    dw 52078
    db "55176+22881/1703*2914+369*2",0
    dw 41534
    db "39725*1+120-0",0
    dw 39845
    db "19927-262/64-246-23-320",0
    dw 65254
    db "61079/87+357-10872",0
    dw 55723
    db "61025-185",0
    dw 60840
    db "43897-65/155/2/7/1-39820+372",0
    dw 26108
    db "56086+145+181+350-16",0
    dw 56746
    db "59148-116+65069+255",0
    dw 58820
    db "55033+154-6+101+338",0
    dw 55620
    db "36220-111+342",0
    dw 36451
    db "58895*1+296/180+102",0
    dw 430
    db "28587+346/126*72/117-135*6770",0
    dw 33850
    db "282/5*500+350/146/6-45+97",0
    dw 84
    db "62358/195-38126+233/5",0
    dw 5592
    db "44545/121+381/3-84-257",0
    dw 65444
    db "13787-24464-387-372/24*22-105",0
    dw 49483
    db "63860+43099/158+295-67",0
    dw 490
    db "6591*4/80/14/1/3-85/1721",0
    dw 38
    db "17867-93-200+156+288",0
    dw 18018
    db "33131+47426*2/23",0
    dw 1306
    db "47209/199*28-16/65*99+28",0
    dw 10027
    db "28197/118*167-294",0
    dw 39452
    db "49107+296+298/154*77-294",0
    dw 24500
    db "50179/115-19*83/28-33+361",0
    dw 1564
    db "26981-176-39",0
    dw 26766
    db "34902/15*26-28+17-70",0
    dw 60395
    db "52774-147",0
    dw 52627
    db "58609/34*23/89+57604/43*15",0
    dw 20235
    db "14530-4243+26/34*107/81",0
    dw 400
    db "28643-224/2+271-306-177",0
    dw 13997
    db "63463/1797/1-28-305+58+18145*2",0
    dw 35810
    db "2812*15+4+81",0
    dw 42265
    db "45848/58+311/9+163*36+102",0
    dw 10362
    db "53114-57986+265+333+343",0
    dw 61605
    db "25432/120/9*302/16",0
    dw 434
    db "58267-8304-334+124+93-118/8",0
    dw 6216
    db "49794+69+47/2095+168-61146-361/60",0
    dw 70
    db "28390-398/48*8+47/245-243",0
    dw 65312
    db "56113+190*1+326",0
    dw 56629
    db "7680*6+58/25-290-180/74-197",0
    dw 65357
    db "62559/22*16/3694/2",0
    dw 6
    db "63599/27-322/254+15/3",0
    dw 7
    db "58848+97+385-83",0
    dw 59247
    db "59837+155/90*5*15",0
    dw 49950
    db "13363-334+106*2+306",0
    dw 26576
    db "17040+286*2",0
    dw 34652
    db "8707-91-207-333*4/36*62",0
    dw 55614
    db "22972/19/68-202+195-235",0
    dw 65311
    db "11590*3/81-374/1",0
    dw 55
    db "49125-148+57/161/2+30564",0
    dw 30716
    db "8852+121*3+180",0
    dw 27099
    db "50419-29724*1+55+125",0
    dw 20875
    db "56887+354+199-297",0
    dw 57143
    db "60828+146/7106*5367/1696-51",0
    dw 65510
    db "4656/43+45443+366+254",0
    dw 46171
    db "61275/116+185*49/166/35",0
    dw 6
    db "39834+166/100",0
    dw 400
    db "27328+10276+59+69/1218/3+277+322",0
    dw 609
    db "48921/106*117/226+238",0
    dw 476
    db "29021+142*1/143/29-60",0
    dw 65483
    db "20094+304+250+118/138-306",0
    dw 65380
    db "30766+32-367+58",0
    dw 30489
    db "40938/102*139",0
    dw 55739
    db "12093+51793+212+228/9504*867+233",0
    dw 5435
    db "42161+144/7638",0
    dw 5
    db "4086+5040+25/81/3/4+394*102",0
    dw 41106
    db "61057+185+149/151/5/6*4995",0
    dw 64935
    db "34680+271-188-313/28",0
    dw 1230
    db "13767-184-49-278+196-288",0
    dw 13164
    db "31040+282-51026+219/117",0
    dw 393
    db "18845*2-21-366",0
    dw 37303
    db "42513/35-24302-376-176+214",0
    dw 42110
    db "41686+231/55/9/7",0
    dw 12
    db "25763/133-94*585+357/7083*5087",0
    dw 40696
    db "48661+122-219/175*133",0
    dw 36841
    db "59219-180-245-259/8009-120",0
    dw 65423
    db "11274/40/48-26546+276",0
    dw 39271
    db "45866+180+349+37+101-101+60374",0
    dw 41270
    db "23695+104+186+177-239-206+361",0
    dw 24078
    db "43409/37/60-345/12853+296",0
    dw 301
    db "57815-384+272/180",0
    dw 320
    db "9502-233*5+352",0
    dw 46697
    db "1449-72-310+211-336*19+294/82",0
    dw 221
    db "41480-366+115+262-184+153+32922",0
    dw 8846
    db "56224/102-221/5",0
    dw 66
    db "12608-251/61/8/1/4+283",0
    dw 289
    db "11005+318/6/156*1727-398",0
    dw 20326
    db "8329*4+22808/221+215*43+180",0
    dw 20304
    db "63684/156/19+204",0
    dw 225
    db "51380-18/8+105*5/5-212",0
    dw 6313
    db "60350/197-151+6994*7-261",0
    dw 49782
    db "49741-4/79-317*35",0
    dw 10920
    db "5791+47*10-301+290+135",0
    dw 58504
    db "22537-192/94+237+128/5/7",0
    dw 17
    db "65311+38*1-360",0
    dw 64989
    db "34274+332-32+323/58/16-53250",0
    dw 12323
    db "32349-51760+61/163+338",0
    dw 621
    db "21775+340-342*2",0
    dw 43546
    db "13948/70/2/7",0
    dw 14
    db "11310*4+189/6463*3786/122",0
    dw 217
    db "7749+24*3-125/111",0
    dw 208
    db "4212*14+324/223",0
    dw 265
    db "26672-43/109+243/8*793-380",0
    dw 47200
    db "41181+111/143*6",0
    dw 1728
    db "19558*2/5364*5566/121+290-338",0
    dw 274
    db "51245/216-172/6+33",0
    dw 43
    db "8992-219*2*2",0
    dw 35092
    db "17692+49/21+76",0
    dw 920
    db "24091*1-398/58+300",0
    dw 708
    db "47115+194/23+235",0
    dw 2291
    db "60526/110+57/3",0
    dw 202
    db "1352/33/3-278/182",0
    dw 358
    db "64388+147+142",0
    dw 64677
    db "997+156-46/2-107+163/3*210",0
    dw 42630
    db "35998+111-7",0
    dw 36102
    db "11238*3/32*58/209",0
    dw 292
    db "43676/1610+194+39+260/11",0
    dw 47
    db "64562+350/244+41857+44",0
    dw 42167
    db "26414-64/2431",0
    dw 10
    db "44179+256/10-202/43/6*891",0
    dw 14256
    db "16562+300+172+205/18*54",0
    dw 51678
    db "13116*3+332+228-263",0
    dw 39645
    db "45282/58/14/4-123*1",0
    dw 65426
    db "53107*1+325+166/22+158*16",0
    dw 41504
    db "885/7*39+396*7-345",0
    dw 36825
    db "36232+2/150+219+297-397/16",0
    dw 22
    db "51298-200+67+374-228/52",0
    dw 986
    db "54310+0+76",0
    dw 54386
    db "47400-298-97+125",0
    dw 47130
    db "59263/7858+48+47/9*2556",0
    dw 28116
    db "38049*1/154-349-48869",0
    dw 16565
    db "34079/1536-192*1/189*160/31",0
    dw 1780
    db "37207+43585/65-172-242-364",0
    dw 64992
    db "30392+166*1/17*11",0
    dw 19767
    db "13201+159-99+157",0
    dw 13418
    db "64492+68-212/170-135-23186*1",0
    dw 42593
    db "60134-312-42-176",0
    dw 59604
    db "45257/36+84-175/23+62932/72*66",0
    dw 57684
    db "13919-0+203/113",0
    dw 124
    db "10858/97+36/6/3+337-380",0
    dw 65501
    db "49693-298-43266",0
    dw 6129
    db "45772/91-54/17*1511",0
    dw 39286
    db "22012/43-129-109+319*13/8",0
    dw 962
    db "7360-51-34+166",0
    dw 7441
    db "2249*11-234*1",0
    dw 24505
    db "27592+179+305",0
    dw 28076
    db "42284+256/50+366+32",0
    dw 1248
    db "18762+249-180+181-271/131+35-238",0
    dw 65476
    db "41955-316/117",0
    dw 355
    db "24868-369/1233-204/32+158+215",0
    dw 2415
    db "464/6/4/2",0
    dw 9
    db "33719+245/117*90-195+332/57/12",0
    dw 38
    db "51558+150+273/121-128+210",0
    dw 511
    db "55575/144/14+185",0
    dw 212
    db "50459+266+262/216+157+106*51",0
    dw 25449
    db "35218/2437+16",0
    dw 30
    db "35898+277-76/24",0
    dw 1504
    db "29545/102+91+19*38",0
    dw 15162
    db "39004*1-384+368",0
    dw 38988
    db "18041+139+10738+311-237",0
    dw 28992
    db "53190+78-206-362-166-387",0
    dw 52147
    db "40310-219+11415",0
    dw 51506
    db "12964-330*2-28661+343",0
    dw 62486
    db "16004+355-167",0
    dw 16192
    db "45002+191/29/118+309+1808*14+352",0
    dw 30172
    db "44267/109*6*9+319-228*1*1",0
    dw 22015
    db "23241+354/3783",0
    dw 6
    db "6267+48294-70/8+186*4",0
    dw 27988
    db "47915-351",0
    dw 47564
    db "46603-309+295-188",0
    dw 46401
    db "20889-64-135/512",0
    dw 40
    db "4703+395/196/1*478*3",0
    dw 37284
    db "63014+286+16382+134/79*297-59",0
    dw 53401
    db "36444-288/62+320*70",0
    dw 63210
    db "52759+386/69-14446",0
    dw 51860
    db "37040+330+253-28-358",0
    dw 37237
    db "40599/119*3-254*63",0
    dw 48447
    db "65432-352/57+337-97/31",0
    dw 44
    db "42987-53081+371/5*3-230",0
    dw 33256
    db "25111-311-294/103",0
    dw 237
    db "32578+247-286-22-8692-135/130+43504",0
    dw 43686
    db "65285+282*869",0
    dw 26939
    db "64766-154+238/167",0
    dw 388
    db "31440/19+34*28+233-13597/132",0
    dw 256
    db "31314/85*54*2",0
    dw 39744
    db "17418-157*2",0
    dw 34522
    db "13080+322+368+295+213*1",0
    dw 14278
    db "10258+205-36",0
    dw 10427
    db "7504-79-236/762-267+326/4",0
    dw 17
    db "11787/77+357/6*184",0
    dw 15640
    db "32577-241/1941+224*236+316",0
    dw 56956
    db "56762-261/193-203*403",0
    dw 35867
    db "32297*1-250",0
    dw 32047
    db "64905+197+89/163+275*31+167",0
    dw 21061
    db "5717/66+254+358-130",0
    dw 568
    db "3760/18-24+36-398-60-255",0
    dw 65043
    db "5866*4+53551",0
    dw 11479
    db "63018+13-224-187-154",0
    dw 62466
    db "53022-382",0
    dw 52640
    db "15651/2191+57-346*1-346",0
    dw 64908
    db "7890/68*91+127-293+40505-391",0
    dw 50504
    db "6839-352/58+378-216",0
    dw 273
    db "55462+65239/70+59*23-88",0
    dw 19393
    db "61874-390/100-274",0
    dw 340
    db "64102/64-101+3/26*1909-176/198",0
    dw 326
    db "43445/59*3/56",0
    dw 39
    db "21187*2+86-209",0
    dw 42251
    db "18428*2/13/501-169",0
    dw 65372
    db "17352+81-91+52301*13-375",0
    dw 53016
    db "61303+66+159",0
    dw 61528
    db "49288/59*71/221-350",0
    dw 65454
    db "62750/10870-179/184-353",0
    dw 2
    db "31966-168-312/158/8-210-289",0
    dw 65061
    db "4403+322*11",0
    dw 51975
    db "56246-333+274/2392-154",0
    dw 65405
    db "49332/157+388/5",0
    dw 140
    db "3074/42/7-91",0
    dw 65455
    db "13421/1260-60/35",0
    dw 1871
    db "46838/160*149+293",0
    dw 43801
    db "47693-37856+311-203/66+296",0
    dw 446
    db "20137+87/50-140/5+132",0
    dw 184
    db "30956+273+40314/45*460-368",0
    dw 60812
    db "17816/94/9*60+310-362/26",0
    dw 46
    db "26551/40+37321-17176",0
    dw 20808
    db "43156/7760+323",0
    dw 328
    db "47615/48*38/160*153-378",0
    dw 35577
    db "7089*7+244-296/74-14",0
    dw 655
    db "46333-81-194",0
    dw 46058
    db "8466/15-77+320-233+399-338",0
    dw 635
    db "8990-246*4/43-56955-357+3*4",0
    dw 36160
    db "1108/26/4-271",0
    dw 65275
    db "48491-185+348",0
    dw 48654
    db "1205-119/9/8-118",0
    dw 65433
    db "62872-44/124*13+246/52/7*1483",0
    dw 26694
    db "19969-277/18/7*42",0
    dw 6552
    db "45683/127/22/3+292*174",0
    dw 51678
    db "56*804/499",0
    dw 90
    db "25536+216+282-290",0
    dw 25744
    db "25793+359/5214-212/3-120",0
    dw 21656
    db "61519-19/135-28*101-372",0
    dw 42755
    db "43956-36121-166*3-289",0
    dw 22718
    db "22379+224/120/6+63",0
    dw 94
    db "15739/2244-86+371*81-221",0
    dw 23431
    db "32550/34*61+300+284",0
    dw 58961
    db "2812-98-347/42-383+274",0
    dw 65483
    db "2301-46549-278-345",0
    dw 20665
    db "15113+19-325+150",0
    dw 14957
    db "2725*11/132*245/86*21",0
    dw 13566
    db "27799-263-200/164+88+254",0
    dw 508
    db "35541-244/42",0
    dw 840
    db "8221+143*3/136-212-346+269+133",0
    dw 28
    db "35326/6-62903/85+21",0
    dw 121
    db "31704+64828/167*34",0
    dw 6290
    db "16430/1931-356-84+29+26",0
    dw 65159
    db "62955-83/131*124+66+110+309",0
    dw 59881
    db "26779+12953-224+49908-359",0
    dw 23521
    db "28857/78+330*92-357+46/161*63",0
    dw 25011
    db "46813-392-336*1/53-256/21/2",0
    dw 14
    db "53053+56/185+366",0
    dw 653
    db "32601+9+13534+377+332/3408",0
    dw 13
    db "41233/48/1-357/78*4731+99",0
    dw 28485
    db "8688-2-89+85/61-388",0
    dw 65290
    db "44850-7-91/190",0
    dw 235
    db "39673+266+10122-214",0
    dw 49847
    db "60612+81+168/147-298",0
    dw 116
    db "60058/79/13/1-74-77",0
    dw 65443
    db "6469*6/16/35*506",0
    dw 34914
    db "5986-279/74*370-304/46",0
    dw 612
    db "64240/148/34/1",0
    dw 12
    db "37972-175+185-15880",0
    dw 22102
    db "13785/113*509/12287-136-122/106*80",0
    dw 49200
    db "49951-125-128/5835",0
    dw 8
    db "41163/2777+46982+332/62",0
    dw 763
    db "2350*1+28/3-368*80+217",0
    dw 34137
    db "24738/102-2-145/6*2031",0
    dw 30465
    db "20598/122-392+141-47530",0
    dw 17923
    db "37960+366/184+7297/60-249+139",0
    dw 15
    db "42615-36/116+212-184*145",0
    dw 57275
    db "55203-112-57/15/11+325",0
    dw 658
    db "62382+242+20/11753-273-30461+198",0
    dw 35005
    db "50116/72*90/34",0
    dw 1842
    db "4456/49+257+386+65+75/84*877",0
    dw 8770
    db "47110+54939*1-19181*2+341-59517",0
    dw 41024
    db "53845/60/9-287+52154/157",0
    dw 330
    db "4254+215+275-168/4",0
    dw 1144
    db "46000+355/132+389-7",0
    dw 733
    db "48841/22/44/4/1*1525",0
    dw 18300
    db "49131+268/8993-148-30",0
    dw 65363
    db "60039+62/125-131",0
    dw 349
    db "53497/202-3/5+198-267",0
    dw 65519
    db "12469-311*3-258/23+387",0
    dw 1961
    db "39430+346+27/168/36-154+345",0
    dw 197
    db "1039/16*398-94-266",0
    dw 25112
    db "37177+303+87-312-32318*6",0
    dw 29622
    db "15789/15+320*26*1",0
    dw 35672
    db "23919-109+316-8/91/35+397-103",0
    dw 301
    db "6293+157/38-225-126-223",0
    dw 65131
    db "45463/39*15/50+353-315-324*846",0
    dw 53298
    db "44358-158*1-149",0
    dw 44051
    db "29763/160-25*351",0
    dw 56511
    db "46155+78-27+200+22588*14+327",0
    dw 48739
    db "7580/61-216+27/124",0
    dw 527
    db "53246/200*230+81",0
    dw 61261
    db "9494*3-265",0
    dw 28217
    db "15199/56+114+14/5*330/28/92",0
    dw 10
    db "5398*2-293+27*5",0
    dw 52650
    db "48527+187/17/11*122",0
    dw 31720
    db "31741/49/4+167",0
    dw 328
    db "13098*3+169+172-99",0
    dw 39536
    db "11780/1612*470+26",0
    dw 3316
    db "30615-317+320-275",0
    dw 30343
    db "26291/112+20-166+63*346",0
    dw 52246
    db "11367*2+1+342+312/37+249",0
    dw 881
    db "65197-268-234-39123+319/1692",0
    dw 15
    db "2727*2-252/37/23+324/15*925",0
    dw 20350
    db "62502+182-178/232*125",0
    dw 33625
    db "9683/22+54-270*279",0
    dw 62496
    db "38429/131/15/3",0
    dw 6
    db "44800-342-3848-336/71-171+355",0
    dw 751
    db "36217/738*806/29",0
    dw 1361
    db "50643-266-289+305+14+66",0
    dw 50473
    db "65083/10018*8493/128*45-8",0
    dw 17902
    db "46482/196+62*61+334+31-21068",0
    dw 63072
    db "1111/10+352+381/16+63201*1",0
    dw 63253
    db "40101/79+94/10+255/8",0
    dw 39
    db "434*53/12/41/2",0
    dw 23
    db "2361*12/5153*9211+65",0
    dw 46120
    db "58112/6393+82+136-10+239/6/7",0
    dw 10
    db "36957/146-0/1/7/1",0
    dw 36
    db "60737/36*11*2/90-37948-266",0
    dw 27734
    db "8437/2/339*987-345/74",0
    dw 155
    db "51668-54-18+138+199+196-119",0
    dw 52010
    db "44464-21*1/157+57",0
    dw 340
    db "45499-302*1-341*1",0
    dw 44856
    db "44316+124+375-111*1",0
    dw 44704
    db "29265+239-331",0
    dw 29173
    db "3754/7-324-285/243-61-311",0
    dw 65433
    db "156-49920*3-252+351",0
    dw 47415
    db "39084-329/165/2+241/21/2",0
    dw 8
    db "37158-250+46/145/14",0
    dw 18
    db "11836/11+217*48-1",0
    dw 62063
    db "41152",0
    dw 41152
    db "50568/210/4",0
    dw 60
    db "10716*4-238",0
    dw 42626
    db "43532+319-370/82*44-322",0
    dw 22998
    db "28165*1-163",0
    dw 28002
    db "11497+59+71-47213+233/125/6",0
    dw 40
    db "15203-51/68+42",0
    dw 264
    db "28774-65-16/76/17*2182+91",0
    dw 48095
    db "24050+54+323+126",0
    dw 24553
    db "13104*4-61449",0
    dw 56503
    db "57582-171+273/231-64+218",0
    dw 403
    db "30700-16098+345/1101",0
    dw 13
    db "30443/47*70+17+56-343/118*68",0
    dw 25908
    db "44897+257/7061",0
    dw 6
    db "42593-79/137/4-88",0
    dw 65525
    db "51814-267+208-372",0
    dw 51383
    db "2036/28/2/2/2",0
    dw 9
    db "54276/174*28+306",0
    dw 9014
    db "64656+80/182/18",0
    dw 19
    db "58069-313/192-257/5*1587",0
    dw 12696
    db "10899+189-116+183/6*10",0
    dw 18590
    db "52248-396-393/2540+175",0
    dw 195
    db "5633/981-39",0
    dw 65502
    db "48895+285-391",0
    dw 48789
    db "36184-67/41+290/20/4*156/38",0
    dw 57
    db "61053-295+108-92",0
    dw 60774
    db "3271/30+73+315+396",0
    dw 893
    db "25294/146*144-193",0
    dw 24719
    db "8013+192-240-325",0
    dw 7640
    db "18383+13179-146/1075/4-188",0
    dw 65355
    db "54319+147+398/127",0
    dw 432
    db "6326+151+26*5/94+63",0
    dw 408
    db "43990/28+7+202*11+287/722/4",0
    dw 6
    db "41877/25-393+331/37",0
    dw 43
    db "41296+27-143/5089",0
    dw 8
    db "49062-73/31*38",0
    dw 60040
    db "21734/71-158/10/2",0
    dw 7
    db "5944*7+46/83-92+32*122",0
    dw 53802
    db "10376/96-105-22864-307",0
    dw 42368
    db "6779/1165-303-64409*61",0
    dw 50569
    db "60456-230+352-18/10387",0
    dw 5
    db "6158/3*5*4/111",0
    dw 369
    db "28599-270+45/123+16726+205/3335-29",0
    dw 65512
    db "46415+102/7965-238/116",0
    dw 562
    db "59489/49-263/85*3148/5881+371",0
    dw 376
    db "2351+342*4/1958*427-103+58201",0
    dw 60233
    db "184*85+160*2",0
    dw 31600
    db "27982-329+306+233/138*202/38",0
    dw 1084
    db "59075+229-87",0
    dw 59217
    db "15922*1+27240",0
    dw 43162
    db "50831-36-119/175*136",0
    dw 39304
    db "6772-262*8",0
    dw 52080
    db "9495/42*136",0
    dw 30736
    db "46576+54806+397",0
    dw 36243
    db "53988+4/17",0
    dw 3176
    db "61816+30-5-199-144-100",0
    dw 61398
    db "57237+10-126+188+54",0
    dw 57363
    db "51674-45+389+307",0
    dw 52325
    db "65493/35/13-388-43/254-68*139",0
    dw 26132
    db "6208*6+226*1-200-9",0
    dw 37265
    db "63375-2264/11360+296*143/77-139-215",0
    dw 205
    db "45931-389-5+106*1-47909",0
    dw 63270
    db "12763-46*3/158*173",0
    dw 41693
    db "63683-96/209/15+24*52",0
    dw 2288
    db "16723/31/4+367/3+121-277",0
    dw 11
    db "3621+5666+158*4",0
    dw 37780
    db "5575-20154-134+0-253/68",0
    dw 743
    db "43285+32692-135-42",0
    dw 10264
    db "9948/35/7+235*106-117+228",0
    dw 29261
    db "35716-394/72*87",0
    dw 42630
    db "56025/41+76+350*20/112/15/3",0
    dw 7
    db "9804*5-368/217*68",0
    dw 15232
    db "46069+189-180-198",0
    dw 45880
    db "39648-108+38519",0
    dw 12523
    db "46937-158+15848",0
    dw 62627
    db "14223+62/53+64546-183-31986",0
    dw 32646
    db "5669+99-86*6/130/10",0
    dw 26
    db "43430-41527-32920-154/96",0
    dw 357
    db "9628-34870/199*134",0
    dw 27068
    db "47798-263-32+220-33",0
    dw 47690
    db "40568-74/78*95-303+280",0
    dw 49282
    db "42714/105+178*32*2",0
    dw 37376
    db "43152+365-349",0
    dw 43168
    db "2699+357-149-17070+37870",0
    dw 23707
    db "62165+340/168/16",0
    dw 23
    db "23730/44+334/12",0
    dw 72
    db "47136*1-233/4958+172+349",0
    dw 530
    db "57119/118*132-168",0
    dw 63720
    db "28892+65+328",0
    dw 29285
    db "5554*9-121/32+225*22/1556+33464",0
    dw 33489
    db "1978-290/8-65-191-8-291",0
    dw 65192
    db "53286+386/3008*3823-246+289",0
    dw 65034
    db "24713-125-394",0
    dw 24194
    db "56872-220-29000",0
    dw 27652
    db "26450-15831*5",0
    dw 53095
    db "16999-204*2-157",0
    dw 33433
    db "49818/133/14*2116+0",0
    dw 55016
    db "53356-323+80/196+71",0
    dw 341
    db "47350-232/4997",0
    dw 9
    db "27567/104",0
    dw 265
    db "23743+365",0
    dw 24108
    db "23805+79+237*1+386/149+22+103",0
    dw 289
    db "29188/57*10*5",0
    dw 25600
    db "33046-359/149",0
    dw 219
    db "27528+200+385*1",0
    dw 28113
    db "11783/69/10+78-269+43415",0
    dw 43241
    db "52297+306/111/16/1-176-395",0
    dw 64994
    db "42461-80+27+374*1+27-316+387",0
    dw 42880
    db "46857+107+211-238*1",0
    dw 46937
    db "29552+399+320/4013",0
    dw 7
    db "32926-201+22/63+369",0
    dw 888
    db "51324+136/156/12+378/15/4",0
    dw 6
    db "18185/24*53-154",0
    dw 39967
    db "52574/106*107-356/22-45/30",0
    dw 78
    db "30864*1/107/8",0
    dw 36
    db "9462+66*5-206",0
    dw 47434
    db "50815-319/27*33",0
    dw 61710
    db "39234-229/6471*340*9",0
    dw 18360
    db "6096*8+378/155*13*13",0
    dw 53573
    db "65445+307+49+136+75",0
    dw 476
    db "54686/8729+19902-373*2+330",0
    dw 39400
    db "47071/212+47309/129*127/158-358",0
    dw 65473
    db "30055+161/105/14-200",0
    dw 65356
    db "10276/79-327+259+74-146",0
    dw 65526
    db "33832-183/49/99",0
    dw 6
    db "49768-230+297+279/216/3+212",0
    dw 289
    db "1659+385+10-104*30/101",0
    dw 579
    db "63709+9382+263",0
    dw 7818
    db "24307+265",0
    dw 24572
    db "17940+102/58*93",0
    dw 28923
    db "64994-108-228/57",0
    dw 1134
    db "35301+34954+48-170/55",0
    dw 83
    db "54073-122-52",0
    dw 53899
    db "63306-383-369-141+33",0
    dw 62446
    db "60643+271+166-222-200+51",0
    dw 60709
    db "44167+131-111-165",0
    dw 44022
    db "18960/127/24*8429-5/173",0
    dw 292
    db "10934*2+148/20*12",0
    dw 13200
    db "30029/90/14-120",0
    dw 65439
    db "24553-300+152/22",0
    dw 1109
    db "18898-141-131+175",0
    dw 18801
    db "29264-305/147+241",0
    dw 438
    db "15996-50+144*3+992+63",0
    dw 49325
    db "14470-143/1029-9109",0
    dw 56440
    db "53224/7001*305+384/21/2*865/47",0
    dw 1085
    db "11130/26+107-1",0
    dw 534
    db "26059/1005-118+56867",0
    dw 56774
    db "12951-71+276*2",0
    dw 26312
    db "48413+200/21+281",0
    dw 2595
    db "13915+274/113-301",0
    dw 65360
    db "23829/2802-58/217+35776-56",0
    dw 36021
    db "26941/87/15/3+285-383+390*120",0
    dw 35760
    db "56520+213/117/7-384/4987",0
    dw 13
    db "43456-247+57-231/126",0
    dw 341
    db "49293+93/19*11/65/3",0
    dw 146
    db "8410/3-169*13/178",0
    dw 192
    db "64804+113*1-136",0
    dw 64781
    db "8177/71*470+169+22786",0
    dw 11469
    db "2218+50-330*20",0
    dw 38760
    db "50229+187/7251*7237",0
    dw 43422
    db "44025-66+34158-326",0
    dw 12255
    db "32765/4982+394*40",0
    dw 16000
    db "60887-160/1170-202",0
    dw 65385
    db "64672/151+96*49+388-127/22*39",0
    dw 45942
    db "25491+277+4+22-372+323",0
    dw 25745
    db "23126/76*82/8+31304",0
    dw 34420
    db "51539/69*11+262",0
    dw 8468
    db "29075+88+258/30*24",0
    dw 23520
    db "46718-42759+296/25",0
    dw 170
    db "31210-51994/122-381",0
    dw 65521
    db "17071*2-9/6594",0
    dw 5
    db "51384/219*120/41",0
    dw 684
    db "32680+299-178+252",0
    dw 33053
    db "32703/118-295",0
    dw 65518
    db "25271/97",0
    dw 260
    db "8171+310-14/83",0
    dw 102
    db "3373+267+84/20-380-9",0
    dw 65333
    db "25775+128-113-287+77+99/157",0
    dw 163
    db "50416-283+54914+64",0
    dw 39575
    db "45313+12+369",0
    dw 45694
    db "33136/16-133+20+62*18-95",0
    dw 36265
    db "33753-385-215/141",0
    dw 235
    db "47193+185-350/5580-122+294+287",0
    dw 467
    db "28479/53-244",0
    dw 293
    db "50956-242/110/1/16/1",0
    dw 28
    db "15327+182-106/111+361*81",0
    dw 40419
    db "49564-49091+386+308-379*19",0
    dw 14972
    db "39402-120-245",0
    dw 39037
    db "2376*6-298-319/9-11",0
    dw 1504
    db "54771-31/13/53",0
    dw 79
    db "29332+138*1-49958",0
    dw 45048
    db "28552/35+50+49093+221/142+146/19",0
    dw 26
    db "59581+324+6662/103+121/10+34",0
    dw 47
    db "37098+105*1",0
    dw 37203
    db "44267+0+309",0
    dw 44576
    db "51679-192+334-45-63742",0
    dw 53570
    db "15132/2608+367+322",0
    dw 694
    db "11291/356-123/214",0
    dw 305
    db "10188/86*137+46-109*2",0
    dw 32206
    db "57331/191-25/4+395",0
    dw 463
    db "6452*6/56/16*238",0
    dw 10234
    db "40318-342/5514*2147-196",0
    dw 14833
    db "14730/25-28*48/40",0
    dw 673
    db "3459*2*2-168",0
    dw 13668
    db "45765+328/6428-255/109*70",0
    dw 41860
    db "37686+101-347-64560-240",0
    dw 38176
    db "30232-29656*16*3",0
    dw 27648
    db "10658/51/8*576/24*33*2/197",0
    dw 209
    db "36475/236*206/156",0
    dw 203
    db "3281*10/60*24*3",0
    dw 39312
    db "17484/62*24*3-192",0
    dw 20112
    db "36969/127-59*252+360-320-373",0
    dw 58131
    db "62418-16929-136+370+131-76",0
    dw 45778
    db "7985-177/27/12-232",0
    dw 65328
    db "22843/4558-96",0
    dw 65445
    db "58704-114/52-22663/96-84/13",0
    dw 28
    db "34540-319-10729",0
    dw 23492
    db "56730+65/3883-213+382/4",0
    dw 45
    db "61300/223*160/150/5/3*368",0
    dw 6992
    db "24445+2965-43-8599",0
    dw 18768
    db "23305-308-14+99-209+178",0
    dw 23051
    db "33041-16225-260-90/121/19",0
    dw 7
    db "63058+98-40397/2939",0
    dw 7
    db "15801/49/4-278-229",0
    dw 65109
    db "20085+392/79*163/177*184-286",0
    dw 43506
    db "32972-207/46+131*11+213",0
    dw 9486
    db "49126+303",0
    dw 49429
    db "47836+136",0
    dw 47972
    db "15841+90-195+375",0
    dw 16111
    db "41614/170*19/277*1088-212+221",0
    dw 17417
    db "12097+373-80-32275-123+2+94",0
    dw 45624
    db "43977-21-61",0
    dw 43895
    db "15555+106+173/24/19*452+43",0
    dw 15411
    db "48132/72+117-72-36/24+248",0
    dw 276
    db "28397-337/82+91+391",0
    dw 824
    db "45864/17+335/151",0
    dw 20
    db "4476+297/14-22-165",0
    dw 153
    db "16031-22020+19+178+56008",0
    dw 50216
    db "22701+203/1711-185/6",0
    dw 10894
    db "7846*4+69-268",0
    dw 31185
    db "58474-182-384-60/41",0
    dw 1410
    db "19372/35-13*113+184",0
    dw 61204
    db "51711-107/111/11-239/86+372",0
    dw 1131
    db "27694+317*1",0
    dw 28011
    db "40164+283+374/100/24-339",0
    dw 65214
    db "10751-56927/107-304+138*1744+79",0
    dw 24495
    db "22866+114",0
    dw 22980
    db "9947+388*2-258",0
    dw 20412
    db "35821-139/91/47*3243",0
    dw 25944
    db "37230-167-374",0
    dw 36689
    db "28799/2296/1/2-258",0
    dw 65284
    db "10767*5+223/203/1/9+379",0
    dw 408
    db "19389+364/60*172/113-13",0
    dw 487
    db "54171+132/131-157",0
    dw 257
    db "32943+201/181-65/4",0
    dw 29
    db "33438+166*1-152",0
    dw 33452
    db "60310+75/9828",0
    dw 6
    db "20297/55-77+61050",0
    dw 61342
    db "24276/3812-376/144*19",0
    dw 8588
    db "12933/30+217*100-68/35",0
    dw 1849
    db "19953+270/32/5*378",0
    dw 47628
    db "20019/72/13+84*364/133",0
    dw 287
    db "8076+154+333/9+165-118-62",0
    dw 936
    db "35817*1+155/18+323-336",0
    dw 1985
    db "9499/360*2426-43+219",0
    dw 63252
    db "15167*2+41+269/153+376*112*1",0
    dw 64512
    db "24606*1+213+238+297-394+134",0
    dw 25094
    db "9619-324/1371*5468/27",0
    dw 1215
    db "50652/207-321/70/25/2",0
    dw 18
    db "36920/4666",0
    dw 7
    db "27298*1-174/141-201-78",0
    dw 65449
    db "54687+393+140/3878*651",0
    dw 9114
    db "50455+295-387/162",0
    dw 310
    db "65194-39/226-344/30",0
    dw 2182
    db "34762-267/3337-384-127",0
    dw 65035
    db "10669*5+219/115/14+96*166",0
    dw 21414
    db "26514/38/10+233+55016",0
    dw 55318
    db "3458*17+166",0
    dw 58952
    db "44553/7854-160-214/2461",0
    dw 26
    db "40722-101-279-114",0
    dw 40228
    db "22884/2760",0
    dw 8
    db "31715/3625+140+260",0
    dw 408
    db "18327-172-377/113",0
    dw 157
    db "46798-284/3850*2893+86",0
    dw 34802
    db "51173+34-54+79-149",0
    dw 51083
    db "29204/52+91*35/3842",0
    dw 5
    db "58065+387/93+128+95+338/16/5",0
    dw 14
    db "35719+16/168/36-287",0
    dw 65254
    db "31007-63/112+125-235*220/186",0
    dw 196
    db "3811-33687+49+314-26-306+182",0
    dw 35873
    db "57607/72/11/7*3370",0
    dw 33700
    db "38022-286-164+264+16*1",0
    dw 37852
    db "3608+80/493*5460",0
    dw 38220
    db "50679-171",0
    dw 50508
    db "7800+371*4/107-21771-65",0
    dw 44005
    db "22995-107/380*256-83/112",0
    dw 136
    db "54930+196+240",0
    dw 55366
    db "26469-196/154+396*9*2",0
    dw 10188
    db "16143*2-286",0
    dw 32000
    db "48800-249-85-321",0
    dw 48145
    db "28851+255-163",0
    dw 28943
    db "3786-44-152/14+29532/167*238",0
    dw 42364
    db "16779*2/13*16+318/66/17",0
    dw 37
    db "29143-38451*1+76",0
    dw 56304
    db "12278-304+5648/70-233",0
    dw 18
    db "14829+7454-204+359",0
    dw 22438
    db "37577/46-5569+45+116-138-79",0
    dw 60727
    db "3485*13/20-133+273",0
    dw 2405
    db "48570+102-86+237+276/53*19",0
    dw 17594
    db "33197/155/28-367",0
    dw 65176
    db "25493+338/101+245*43/110",0
    dw 195
    db "62804/60/1*4-215/739-122-236",0
    dw 65183
    db "6773-248-299-255/52*539+101",0
    dw 61547
    db "12829/31/6-360/142",0
    dw 459
    db "38650-3/131+183*68-336-242",0
    dw 31926
    db "2659*18-5-346",0
    dw 47511
    db "9267/35-195/5-49988",0
    dw 15561
    db "60426/1+12950-341/74-382",0
    dw 65255
    db "40642-342+157/145-122/8*88",0
    dw 1672
    db "1591*27-343/1274/1/1",0
    dw 33
    db "18540/163+30+157/4/1*61",0
    dw 4575
    db "14532-277/57-130*430",0
    dw 51600
    db "25342-146/2578+301",0
    dw 310
    db "52542-7-252*1/91",0
    dw 574
    db "46962-54767-68-240-320-279",0
    dw 56824
    db "30836-9-354/61*59",0
    dw 29441
    db "22781-376-161/138",0
    dw 161
    db "5322-322-247/797+110",0
    dw 115
    db "13959+58-49/20-16*79/171-145",0
    dw 170
    db "56766-328/8388-79+237+173",0
    dw 337
    db "37672+392+125+81/70*14-175",0
    dw 7469
    db "16404/74+39495+169+231/2933+399",0
    dw 412
    db "3374*16+183/186-9-91/1",0
    dw 191
    db "60528+181-153+140+182+247-51639+153",0
    dw 9639
    db "20790-308/64-144+265/20",0
    dw 22
    db "15889+350/1433-248+351/15*1203",0
    dw 8421
    db "21510*2+358",0
    dw 43378
    db "36795+177+174+11400",0
    dw 48546
    db "27902+280+332-311",0
    dw 28203
    db "30267/5814*3769-222-209",0
    dw 18414
    db "61352-38/198+140*33",0
    dw 14817
    db "41449+52600+231-346+247-34571+227",0
    dw 59837
    db "45256-52857+9+190/2740",0
    dw 21
    db "17219/53+123/18/3*2746-269",0
    dw 21699
    db "28116-4/89*89",0
    dw 28035
    db "38586-187/128*88-347",0
    dw 25965
    db "11397+266/2+229-71+19/75",0
    dw 80
    db "45722*1-349-331-392-337",0
    dw 44313
    db "36857-58+133-60633/43-239/3+347",0
    dw 591
    db "35254+383+85-229/3510*793",0
    dw 7930
    db "14428*3-37+363/37",0
    dw 1178
    db "19157/15-293-8683+40883",0
    dw 33184
    db "22153+102/129-21436+49970",0
    dw 28706
    db "50755/749*855/48-35418-189-232",0
    dw 30890
    db "17904-183/48-46",0
    dw 323
    db "734*73-304",0
    dw 53278
    db "20695+152/52-262/10/1",0
    dw 13
    db "36126*1+359/163+165*89",0
    dw 34532
    db "7660/526*3563+43",0
    dw 49925
    db "28819/2836-387",0
    dw 65159
    db "39437/134/14/2-255-338-223",0
    dw 64730
    db "20465/93-376-325-52-263",0
    dw 64740
    db "12871+42373/195+125/12+280",0
    dw 314
    db "20607+195/26/99+296-211*10",0
    dw 930
    db "37248+375/9-229-377+220",0
    dw 3794
    db "22257/98-14/9/2",0
    dw 11
    db "53268+196-51/10492+31",0
    dw 36
    db "55315*1-258-275",0
    dw 54782
    db "27093-274-368+29-28514",0
    dw 63502
    db "19947+331+58922+11069-128-106",0
    dw 24499
    db "31506-159-299+10+62/114",0
    dw 272
    db "3674/17+279+243*84/89-251",0
    dw 445
    db "28091+339-341/111-159/7",0
    dw 13
    db "22426-260/123*193",0
    dw 34740
    db "32087-21-142+348/131*264",0
    dw 64944
    db "49583/124+339-372/11-311-222",0
    dw 65036
    db "44537-65/1883/3",0
    dw 7
    db "30922-290-48-183",0
    dw 30401
    db "22761-62441+256-218/4919",0
    dw 5
    db "8768-278+134/15*8",0
    dw 4592
    db "64555+10-358/329/5-371",0
    dw 65204
    db "35351+13+154/12+377+284-207",0
    dw 3413
    db "58402+364+280+276/165-274+229",0
    dw 314
    db "37710-105/1261+20076",0
    dw 20105
    db "56979-62-209*1/3706*1640",0
    dw 24600
    db "61956+197+169+241+31547+362",0
    dw 28936
    db "41939/193*277+209/199*71",0
    dw 21513
    db "27173+232-160+253-113",0
    dw 27385
    db "48624-235+392",0
    dw 48781
    db "48142/198/12*2682",0
    dw 53640
    db "17952-378+76/275-244-98+305/2",0
    dw 13
    db "1305/9/2+92/26-63-156",0
    dw 65323
    db "36530-213+115+313+382+79-347",0
    dw 36859
    db "10175/1233*6001*1-206/53",0
    dw 901
    db "31031+270+332+343+54",0
    dw 32030
    db "54847-70-141/23-132",0
    dw 2243
    db "15706*3-23/137+350",0
    dw 693
    db "26662+62963/61/9",0
    dw 43
    db "45422+129-381/200-149-7334",0
    dw 58278
    db "39425-376/4875*1420/721/2-201/180",0
    dw 363
    db "2003-287-284-170",0
    dw 1262
    db "35427+284-181-328",0
    dw 35202
    db "37888/32*18-247/22/17",0
    dw 56
    db "31517/75-0/19/1*781",0
    dw 17182
    db "54786+21069+315*3-166",0
    dw 31736
    db "60209*1/112*76",0
    dw 40812
    db "41633+20314+252-198/226-11+204*129",0
    dw 60243
    db "49649/172*61",0
    dw 17568
    db "17132+330+145-206",0
    dw 17401
    db "57656+28-29-93/44/17+290",0
    dw 366
    db "8652/70-164+364",0
    dw 323
    db "8848/17*58-210",0
    dw 29950
    db "6993-86+193-368/74-2649",0
    dw 62977
    db "56629-379-298/159/37-357+137",0
    dw 65325
    db "50188+241+299/4+288-56709",0
    dw 21797
    db "10662+113-21-155",0
    dw 10599
    db "37019+300+97-187/186+99+294/9",0
    dw 65
    db "65463/250-384+91/218",0
    dw 300
    db "30136+285/129/3-57/2*1833*2",0
    dw 36660
    db "14030+252+352+296*3-244",0
    dw 44546
    db "26339/73+54239",0
    dw 54599
    db "44943/164/4/7",0
    dw 9
    db "45029-170*1+222-192",0
    dw 44889
    db "30377+55355/100",0
    dw 201
    db "19793-241/136+103/4",0
    dw 61
    db "45776/150*123/142/11*1318",0
    dw 31632
    db "61404-235-190/25",0
    dw 2439
    db "10957+286/32-319*996",0
    dw 31872
    db "10142*4-157/50-282/71*1123/1",0
    dw 7861
    db "38451/3649*6415/77+264-103",0
    dw 994
    db "45914*1",0
    dw 45914
    db "62711-241/133*26",0
    dw 12194
    db "14470+126+8511/4238+191",0
    dw 196
    db "41807+397/135-351",0
    dw 65497
    db "38705+383/161+31+148",0
    dw 421
    db "59878/149+291/1-80*36",0
    dw 22032
    db "63895-73/41*27",0
    dw 42012
    db "35792/84*45+144-133/1118",0
    dw 17
    db "42923-37/61-243",0
    dw 460
    db "60810/89/22+276+60-386",0
    dw 65517
    db "18682+248/80-208*729*2-41861",0
    dw 64499
    db "55769/217/4+177*189/161",0
    dw 282
    db "44399-368+136-218/18/46-11",0
    dw 42
    db "60041-28-38929-42245-53",0
    dw 44322
    db "60213+142+56655+153+187",0
    dw 51814
    db "40746-323-398/2107-353-59",0
    dw 65142
    db "62078/230-36721-127",0
    dw 28957
    db "61825-272+225",0
    dw 61778
    db "59021/93-231+315/136+359-11773",0
    dw 54127
    db "11298+379-356/1505*1075-63",0
    dw 7462
    db "28478+0-55541+353",0
    dw 38826
    db "48111+252+57+316+247",0
    dw 48983
    db "20661-29-121-276",0
    dw 20235
    db "43984*1/6+15988/103*133/152*83",0
    dw 16351
    db "46788/16-221+257/17/6-39",0
    dw 65526
    db "14733+291-238/9*31-26-354/159",0
    dw 317
    db "62209-111/115*100/21/46-126",0
    dw 65465
    db "59356+288-294/103-191",0
    dw 385
    db "16412-313-227+24*3-27",0
    dw 47661
    db "16128/2622-12-156+120+222",0
    dw 180
    db "70+162/1+338+281-87*57+18402",0
    dw 61950
    db "49199-288-16+397/18-165",0
    dw 2573
    db "26641+142+87-136+350-319",0
    dw 26765
    db "1962+315+355*4/810",0
    dw 12
    db "7330-165+75*2+179*2",0
    dw 29318
    db "43523+82+305+172-233-54",0
    dw 43795
    db "54875+205-302-358+45591",0
    dw 34475
    db "37155-389/180*254-45",0
    dw 51771
    db "24122+396/125/11",0
    dw 17
    db "28646*1-32+196-282-33-45",0
    dw 28450
    db "17902/73-15446/5028+61942/206",0
    dw 300
    db "21844-12544-60*6/205*46*3",0
    dw 37260
    db "25679/156*232-252",0
    dw 37796
    db "7437-272-290*5+8/103-261",0
    dw 72
    db "38066/99-250*337+116/164*181-48",0
    dw 49908
    db "17636+332-276+63/26*22/287/1",0
    dw 52
    db "13017/10+93-0/11",0
    dw 126
    db "48138+238+58",0
    dw 48434
    db "15279-275*2+269+27",0
    dw 30304
    db "48218-6183-379+7-229",0
    dw 41434
    db "36445+359/150",0
    dw 245
    db "55613-201-275-44",0
    dw 55093
    db "62572+97/55-217",0
    dw 922
    db "60711-3568/211",0
    dw 270
    db "3739*16-18307-328+43",0
    dw 41232
    db "12636-129+146*3",0
    dw 37959
    db "19391*2+249+115+35284+284",0
    dw 9178
    db "1662-8608/126/3/8-164/114",0
    dw 573
    db "29973+304-87",0
    dw 30190
    db "55497/2008-124/168*161",0
    dw 62629
    db "51790/6186*150+7-270+314",0
    dw 1251
    db "6892-202+206+347/22*58*2",0
    dw 38164
    db "37474+50897+388+81-127-270",0
    dw 22907
    db "21153/38*14/1041",0
    dw 7
    db "20067/71/3-44-352-97",0
    dw 65137
    db "57310/2541+131-376-190-341",0
    dw 64782
    db "4932*11/10+92/60",0
    dw 91
    db "23962+28782-33/150+93+129",0
    dw 573
    db "47226-186/69+349",0
    dw 1030
    db "10520-157+361-350",0
    dw 10374
    db "38131/58-133-321/18+9297-381",0
    dw 8927
    db "18275+267+78",0
    dw 18620
    db "57664+228+61-34*1",0
    dw 57919
    db "2698-61174-294*8",0
    dw 54128
    db "64157-18+62053+20-376",0
    dw 60300
    db "47634+59-374/170*185+165",0
    dw 51595
    db "1592*36/23-358/6*9-58686",0
    dw 10045
    db "35192+61/155-157",0
    dw 70
    db "55156+151-281+111+346/7674*8914",0
    dw 62398
    db "57448+149/13-366+200+37+167+104",0
    dw 4572
    db "37915/154+243/72-274",0
    dw 65268
    db "47651+296-51760+60-224",0
    dw 61559
    db "22576-357/92+356",0
    dw 597
    db "60218/100+18-316/8",0
    dw 38
    db "34370/47/8-384-236/26*20",0
    dw 50000
    db "38758/98*94/140-154+97",0
    dw 208
    db "25014-167/127/1/7*2107-127",0
    dw 56762
    db "63576-181-72/162-353*748",0
    dw 27676
    db "7761+20*7/161/1/10*1354+311",0
    dw 44993
    db "14155+160-30+208+13+161+9",0
    dw 14676
    db "12443-246+292*4+67-170",0
    dw 49853
    db "63504/57+31040/123*205",0
    dw 53505
    db "48005/5150-64-334-17",0
    dw 65130
    db "24894-178+188",0
    dw 24904
    db "10124-91-37/20/8*840",0
    dw 52080
    db "61853-1153/34/3+18",0
    dw 613
    db "36219-19/139/2-192",0
    dw 65474
    db "50117/5437*2354/111+286",0
    dw 476
    db "53277/122/11*671/21+18/34/2",0
    dw 18
    db "20841*2/102+109/9",0
    dw 57
    db "6449*5-274*1/3134",0
    dw 10
    db "43264/26+178/29/11",0
    dw 5
    db "9330+71+293-71+85+352/1156",0
    dw 8
    db "63024/63+139*28",0
    dw 31892
    db "45680-139+4/61*56",0
    dw 41776
    db "242*242-129-26206-143/160/1+213",0
    dw 413
    db "48321+164+242+77",0
    dw 48804
    db "47871-387+127",0
    dw 47611
    db "22589-56-344/132-242+114+240+367",0
    dw 647
    db "38349+134/631/9*9393/14",0
    dw 4025
    db "20641-154-340/67-351",0
    dw 65485
    db "7049/60/17+124+236/38",0
    dw 9
    db "52967-18-318",0
    dw 52631
    db "6961*6+3468-300-357",0
    dw 44577
    db "55669+352-84+221",0
    dw 56158
    db "21162+28+192-54622",0
    dw 32296
    db "40764-362-223",0
    dw 40179
    db "14119/1211-41/116*98-30761",0
    dw 24511
    db "53024+68+80/2220+11000+220*3",0
    dw 33729
    db "33975+66/35-322*51-55",0
    dw 33095
    db "36344-97-392",0
    dw 35855
    db "40126*1/150*86/93",0
    dw 246
    db "39758+112/2163*1492-64040",0
    dw 28352
    db "51719-232+350/210",0
    dw 246
    db "51111/125-357/5*3066*1+312",0
    dw 30972
    db "46203+270+374+381+156",0
    dw 47384
    db "24639/145-15723-106",0
    dw 49876
    db "4501*7-150-65/71",0
    dw 440
    db "25658+346-251+37-248-336-22376",0
    dw 2830
    db "54985/7/9*64-2/108",0
    dw 516
    db "15884-316+23/97*109+58",0
    dw 17498
    db "55063-153-280-243-201",0
    dw 54186
    db "15747/87/7+64732+123-36760/138",0
    dw 203
    db "3146+221+40/23*374-218+347/1971",0
    dw 28
    db "41186-350+238",0
    dw 41074
    db "59127/183-227-274-242-98",0
    dw 65018
    db "35936/59-283/14*1302-77/166+396",0
    dw 575
    db "53619/207+154",0
    dw 413
    db "14994-71*3+231/3284/1",0
    dw 13
    db "26608+87/30*3",0
    dw 2667
    db "58515-284/5679-321/241",0
    dw 270
    db "8758/2+35/37-212",0
    dw 65443
    db "25781-373+196/2123",0
    dw 12
    db "15298*2/143*71-29+87",0
    dw 15181
    db "63569/125/15/4",0
    dw 8
    db "2720+72*9/105*67/438",0
    dw 36
    db "51964+23-223+50/42-255+145+74",0
    dw 1197
    db "27396-72+158-191+47929",0
    dw 9684
    db "57075/178+376-87",0
    dw 609
    db "8485/799",0
    dw 10
    db "62037-246",0
    dw 61791
    db "17738-348/6*14-38",0
    dw 40534
    db "45565/3042*91*44",0
    dw 56056
    db "42504/105+275/4/12*4501",0
    dw 63014
    db "60105-174*1+15647",0
    dw 10042
    db "52778*1-45/1*1/7531+252",0
    dw 259
    db "31842+339-39602/54*31+138",0
    dw 33494
    db "29907/96+223-36+32",0
    dw 530
    db "38598+38+41/127-349+346",0
    dw 301
    db "43889/157*211/123+155+392/3",0
    dw 341
    db "24615/3/507+49*387",0
    dw 25155
    db "10878/1549*362-43-51-108*3",0
    dw 6996
    db "59351+196-66/18+365*2",0
    dw 7338
    db "18443/43-13760-29+318+36",0
    dw 52529
    db "31183/6-174-131+309/607*6579+36",0
    dw 52668
    db "57542/176/8*1500/62+363",0
    dw 1330
    db "16634*2/15/350",0
    dw 6
    db "43994+122-221-349+180-117+232+36",0
    dw 43877
    db "27319-210-41585+367/13/670",0
    dw 5
    db "59587-51883-306+101-109",0
    dw 7390
    db "26846-352+193",0
    dw 26687
    db "24009+90+289-382",0
    dw 24006
    db "242*34*5-341-320/54/24",0
    dw 31
    db "31765/122*214+352/4301+65364",0
    dw 65377
    db "16512+198/73*137",0
    dw 31236
    db "2373/34+360/18*831-19+170+228",0
    dw 19492
    db "29590+180",0
    dw 29770
    db "16582-142*2+15",0
    dw 32895
    db "64281/208+294*59/162",0
    dw 219
    db "10343*3/76/9*1235",0
    dw 55575
    db "59798+89+39497-146/2",0
    dw 16851
    db "5912-310+161*9-313-248+114",0
    dw 51420
    db "62953/79+367-290-263-217/8",0
    dw 49
    db "56339+68",0
    dw 56407
    db "13399*3/69-104+315-289",0
    dw 504
    db "65409/239*131-303+371-274",0
    dw 35557
    db "1129*50+103/66-64246",0
    dw 2146
    db "20371+391/69-233*54",0
    dw 3618
    db "39828-295/26/3",0
    dw 506
    db "15076+2+295+208/2661*1774/61*223",0
    dw 32335
    db "1514/4/14-10792+44960",0
    dw 34195
    db "4329-115/37*113-77-221+58*4",0
    dw 50116
    db "63317-211/33+33220/25-398*47-349",0
    dw 46980
    db "28333+322-146",0
    dw 28509
    db "62283/154*23-364",0
    dw 8928
    db "23982/74*87/2335",0
    dw 12
    db "1081+143*51+85",0
    dw 62509
    db "16862/18-64+324*29*1+157",0
    dw 34841
    db "42510-148-168",0
    dw 42194
    db "11153/85-327-48+23-239/3701*3524",0
    dw 59908
    db "27045/117*243-97",0
    dw 56036
    db "18921+381-293",0
    dw 19009
    db "43169-250/7463+359-274-364",0
    dw 65262
    db "60858+13+73-288/190+298/105*9642",0
    dw 48210
    db "39522-271/119-34-0",0
    dw 295
    db "28606-117/2+54145+76",0
    dw 2929
    db "10024+171+225/49/9/1/1",0
    dw 23
    db "35924/114*147+186+157-183+203",0
    dw 46668
    db "1958-372+363-186*30-230",0
    dw 52660
    db "30189/123/6/4",0
    dw 10
    db "35704+21-90",0
    dw 35635
    db "15064+205/79+104*216/70-149",0
    dw 767
    db "28224+4532-96-64-116",0
    dw 32480
    db "28732+279+11+82",0
    dw 29104
    db "4692/29/5*706-44-98",0
    dw 22450
    db "5698*6-41004+137+43+295+58366-314",0
    dw 51711
    db "57385-274/9926",0
    dw 5
    db "28397/96/9/1",0
    dw 32
    db "31478+264+27106",0
    dw 58848
    db "43890/81+262*28/108/4*885",0
    dw 46020
    db "26792-375-29766-10-30969",0
    dw 31208
    db "63897/76*1/4",0
    dw 210
    db "7925+44195/176+105+38693+52",0
    dw 39146
    db "61296/125-41316+298",0
    dw 25008
    db "35394+373/2261+216+93-136",0
    dw 188
    db "50638-287+165/95-140",0
    dw 391
    db "61263+132/12021*4772",0
    dw 23860
    db "35493+28/6369+291-108",0
    dw 188
    db "18310/93-12*214/7707+81",0
    dw 86
    db "35469+152-343+7",0
    dw 35285
    db "28893+190-6692/86-175/3+361",0
    dw 389
    db "50052/151*179+42/92-49",0
    dw 595
    db "50835-69/208+173/9/1-80/249",0
    dw 263
    db "26745-124*1",0
    dw 26621
    db "46318-286-272-255",0
    dw 45505
    db "48229+15552/72+244+122*6",0
    dw 7506
    db "31928/14-48098+287+202+42780+18+106",0
    dw 63111
    db "8605+183+89*2-314-101+283-46464",0
    dw 36694
    db "6586-195/1264*12262",0
    dw 61310
    db "32176/5791*9548/2255-5-13",0
    dw 3
    db "31299+182/124-52307*2",0
    dw 26964
    db "61965+194/114-8571",0
    dw 57510
    db "10854+281*3+133",0
    dw 33538
    db "51739-243+49+11+203-98",0
    dw 51661
    db "50892/8-244*2+253",0
    dw 12487
    db "8496+111-289+191/938-361+105",0
    dw 65289
    db "18442/110*282+150",0
    dw 47244
    db "45117-47",0
    dw 45070
    db "24557/1244-201+382*35*3",0
    dw 21000
    db "17955+41/35+204/8-146",0
    dw 65479
    db "59674/9807-267/65-338-76",0
    dw 590
    db "31612/175-193/61/28/2",0
    dw 19
    db "15298-54931*1-147-202",0
    dw 25554
    db "2725+6/16*296-95/124-19",0
    dw 386
    db "63810/25-249+96",0
    dw 2399
    db "19175*2",0
    dw 38350
    db "4671+354/31-223/241-198*536",0
    dw 39128
    db "52925-174-81/163-314",0
    dw 9
    db "55063-5/208/6-157+356",0
    dw 243
    db "59225/141+59896/2611-200",0
    dw 65359
    db "23883+137/137",0
    dw 175
    db "33996+308/2671/2*2672-224",0
    dw 15808
    db "6814+136-224/24/13",0
    dw 21
    db "34495-54+3",0
    dw 34444
    db "23306+95*1-184",0
    dw 23217
    db "39375-145+334+149+237/107*49",0
    dw 18277
    db "9036+182/59-16-185+44545",0
    dw 44500
    db "3421/375-336+7",0
    dw 65216
    db "33379/3964+117*88+156/49",0
    dw 227
    db "11448/105/8-150+17",0
    dw 65416
    db "56581/59+232*36+387",0
    dw 43263
    db "25186-131+141+367",0
    dw 25563
    db "14523-260+129+40821+256+310-167",0
    dw 55612
    db "43548/187*148/89*134/62*38-212",0
    dw 31404
    db "32977/68*73-103+226",0
    dw 35455
    db "26984-306*1-380+270",0
    dw 26568
    db "28511+322/78-35147+16/76",0
    dw 404
    db "39062+77+282/69",0
    dw 571
    db "50276-27-201",0
    dw 50048
    db "9088+242/64/6",0
    dw 24
    db "52963+154/191/13/3-77/214/5",0
    dw 61
    db "41990/38-139*27",0
    dw 26082
    db "30489-14-147/52",0
    dw 583
    db "10683+163*5-235",0
    dw 53995
    db "52333-56/25-43862",0
    dw 23765
    db "4646*3*2-394",0
    dw 27482
    db "1380/150",0
    dw 9
    db "41555-14-376+346+111",0
    dw 41622
    db "63885/140+286",0
    dw 742
    db "53388/226-82+238",0
    dw 392
    db "8025*3+68/133/10",0
    dw 18
    db "11400+20979-92-92",0
    dw 32195
    db "54629/50-56090+343/95",0
    dw 114
    db "9924/63/1*393",0
    dw 61701
    db "65038/27/10-54",0
    dw 186
    db "15667-378-34-36-6-353/44",0
    dw 337
    db "52416/89/20-156-124",0
    dw 65285
    db "17707/1759+326/11-221",0
    dw 65345
    db "40621/78-150*172-270-297",0
    dw 63073
    db "57892-52-381/212*68+39977",0
    dw 58405
    db "7089*7/2+277+136/95*55-392",0
    dw 14183
    db "24833-238",0
    dw 24595
    db "26878/73/9*316/576",0
    dw 21
    db "11019-327-380+290*3",0
    dw 31806
    db "52421/143+298*91/84-392-270",0
    dw 57
    db "6859/78+37+325*16-51-101*6",0
    dw 42192
    db "1971/20+338/18/3-177-378",0
    dw 64989
    db "14785*2-312-50651/145/1",0
    dw 304
    db "38135/138+263/59+390+284",0
    dw 683
    db "63783-39-208",0
    dw 63536
    db "31473/24+138/22-199",0
    dw 65402
    db "36056+122-396+29051",0
    dw 64833
    db "8320*4/113-96/9",0
    dw 22
    db "11992+296+236/4",0
    dw 3131
    db "21805+5/2/7+391-330-63-285",0
    dw 1270
    db "47143/65+276/30+395",0
    dw 428
    db "58533+386/232",0
    dw 253
    db "34223+363-37/72-165+83+13004+229",0
    dw 13630
    db "18698*2-169/123-290",0
    dw 12
    db "34855/4520+155/6-14*1412",0
    dw 18356
    db "44841-330/168*53-55*3/56/4",0
    dw 186
    db "25223*1/33*18",0
    dw 13752
    db "21134/99/15-377",0
    dw 65173
    db "39511+176-40/192",0
    dw 206
    db "65212+135",0
    dw 65347
    db "20234*2+60486*1",0
    dw 35418
    db "47581-31/7+208+336/12",0
    dw 611
    db "45685-73+232",0
    dw 45844
    db "12445*4-322-163/112+228",0
    dw 668
    db "57535/137/46+367+132/9-189",0
    dw 65403
    db "39543/7310+77-259+384/4+65*62",0
    dw 7192
    db "5517+103+336-127",0
    dw 5829
    db "332*29/322+16+316",0
    dw 361
    db "62570/168*160-311/61/4",0
    dw 242
    db "17111-31+95-118-365",0
    dw 16692
    db "35754+279-373+40/171/6",0
    dw 34
    db "14513*2-213+58938",0
    dw 22215
    db "21304*2+238",0
    dw 42846
    db "16135-170-43*3/144+177",0
    dw 508
    db "64001+203/41+117/23*407+30",0
    dw 29741
    db "45957+166+54+4-133-58/122",0
    dw 376
    db "26106/866/1*1543-183-280",0
    dw 45827
    db "23478/68-19-118",0
    dw 208
    db "60299-195/234*63/2",0
    dw 8064
    db "50247+178/2084*2330",0
    dw 55920
    db "53583+20724*4+23585/9112+2978/43-0",0
    dw 69
    db "16102/21/9-394+174/1103",0
    dw 59
    db "35697/19/62*266",0
    dw 7980
    db "18024/39/18*132+111/290*2798",0
    dw 30778
    db "63710/43+118+193*30+280",0
    dw 54040
    db "1490*19-23",0
    dw 28287
    db "37281+311-22501",0
    dw 15091
    db "57456-40100+188-249+251",0
    dw 17546
    db "56782+52/340/7-215/12",0
    dw 5445
    db "62737-376+155/186/20/3",0
    dw 5
    db "32556-398+256+299-44",0
    dw 32669
    db "6715/32*27*9-298+161/191-298",0
    dw 65503
    db "8599+58535/4-324-177+236",0
    dw 134
    db "61760-144/229",0
    dw 269
    db "2348/4+4394/64/4*1867-65",0
    dw 35408
    db "13966-29/27*58-354",0
    dw 29574
    db "32855-60-60-140-98+263",0
    dw 32760
    db "16035*3*1+337+102-329*1",0
    dw 48215
    db "57685-225/126/1+213-12+335",0
    dw 992
    db "28817+241-309+49942+204",0
    dw 13359
    db "63228/148-37146+88/10",0
    dw 2890
    db "29910-213+0/64*140+161",0
    dw 65121
    db "44058+221+95/7319*3972+70",0
    dw 23902
    db "17803+8/103+384/8/5",0
    dw 13
    db "64576/239/27-300-141*1*1",0
    dw 65105
    db "2342+81/24*376",0
    dw 37600
    db "29439+181/1653-117-99",0
    dw 65337
    db "44193/2504*1484-69+385",0
    dw 25544
    db "23942+338-247+135/654",0
    dw 36
    db "15626+38/1245/1",0
    dw 12
    db "9486-5424*6-391",0
    dw 23981
    db "18903-343-58831-36368+95/113",0
    dw 482
    db "1385/234+219*179/172",0
    dw 233
    db "24746/151*81/47",0
    dw 280
    db "33837+146-385+337",0
    dw 33935
    db "25639-384-124/59",0
    dw 425
    db "1669*36/28*11",0
    dw 23595
    db "45437-354",0
    dw 45083
    db "10395/86-226-207",0
    dw 65223
    db "48412-97+367*1/89*115",0
    dw 62790
    db "61223+399-154-309/8911*9010",0
    dw 54060
    db "7047+64+329*2",0
    dw 14880
    db "58163/1306-241+262+22+223-374",0
    dw 65472
    db "47872/17/19",0
    dw 148
    db "41106/16+148*4-103+31426/165",0
    dw 255
    db "61690+191-383+31257-177",0
    dw 27042
    db "41790/123*155+9-247",0
    dw 52307
    db "14527-295-368-286",0
    dw 13578
    db "56298/159/12+314",0
    dw 343
    db "3059+47-17/34/8+204+48/5",0
    dw 52
    db "18112-227/2+308+283/93/7",0
    dw 14
    db "42694/129+56/29/1-358",0
    dw 65191

    db "34-126/23+113+241+6",0,111
    db "239-7-126+55",0,161
    db "5*3/1*9-211-149",0,31
    db "215+61+139-A",0,149
    db "179-43/24+131",0,136
    db "225+221+128-88+149",0,123
    db "203-214+'!'+159+'('-181-(144,1)",0,100
    db "A*3/A*2*7/11+165",0,168
    db "146+76-218*5+Z",0,53
    db "(144,2)*7-52+26-127/(144,0)-251",0,6
    db "86/10*6+(144,0)/11*11-74",0,69
    db "243/64*10",0,30
    db "145-227/27",0,6
    db "'!'/1/(144,0)+(144,2)",0,12
    db "96-'@'-152-16/(144,0)*12",0,12
    db "175+71-78",0,168
    db "216-138+A",0,88
    db "125+197/B",0,3
    db "234+(144,0)/21+182-16",0,169
    db "206/31-B-(144,1)+31/10",0,7
    db "156-175+126",0,107
    db "57/5+18/2/1/2*8",0,56
    db "228+63/1*5+(144,2)/39",0,4
    db "232/64-235-204",0,76
    db "'*'/2-30+(144,0)-5-138",0,208
    db "149/39*6/3-27+190",0,169
    db "246+127-128-77-(144,0)",0,64
    db "152/21-43-0-103",0,117
    db "149-160/63*5",0,15
    db "180+212-11/28",0,4
    db "175+225+211-130",0,225
    db "42-155/16*(144,2)",0,96
    db "194-232",0,218
    db "Z+183-27-A+179/21",0,4
    db "'!'-(144,0)/28+182",0,188
    db "11-97/22+A+118",0,135
    db "A+A+162-160*5",0,110
    db "142-(144,2)-168",0,218
    db "'@'/A-'^'+A",0,178
    db "97+202/4+142-199",0,209
    db "B/4*7/(144,1)*2",0,0
    db "Z-89-(144,2)-232",0,212
    db "247/B*12/31-249+37",0,48
    db "(144,1)+25-27/(144,2)+93",0,109
    db "72/10*12-51*6/'4'",0,3
    db "217-A-226/43",0,5
    db "134/18-76/45-238*11",0,242
    db "215/27-'U'-(144,0)-218",0,112
    db "73/12-247+'!'+64",0,112
    db "101+156*7+140",0,147
    db "71/(144,1)*4+(144,1)/13-226",0,45
    db "73+193-2*12-137/59",0,3
    db "180+143/12+105",0,110
    db "177-119*3",0,174
    db "175/18-(144,0)+137+144-(144,0)",0,82
    db "(144,0)/12+63+19+'P'",0,170
    db "(144,1)-131/8*11/12*7",0,49
    db "136+54-69-26/22",0,4
    db "7+(144,2)+214-(144,2)-B-170",0,31
    db "(144,2)*5/9*6-(144,1)+A+35",0,141
    db "69/19+143+198-224",0,120
    db "167+110-208+171+163-181",0,222
    db "5+(144,1)/44-125",0,135
    db "(144,1)+A+46/(144,2)/(144,1)",0,0
    db "161/'#'+149",0,153
    db "108/5-142-249+243",0,129
    db "70-127+100+208+144/28",0,4
    db "(144,0)-A-50+109",0,153
    db "'1'+190+61/3-'!'",0,237
    db "118-14-207",0,153
    db "180/8-(144,0)/22*4",0,28
    db "171/55-24+142+54/'!'",0,5
    db "107/34+230/(144,2)-10",0,9
    db "252/67-230/5-108",0,153
    db "B-220/8*2+230-140",0,104
    db "148/22+'('/(144,0)*10",0,0
    db "217+160-247",0,130
    db "238-185+70-222",0,157
    db "(144,0)/5-(144,0)/A*2",0,34
    db "(144,2)/3+(144,0)",0,108
    db "21*3-94+46",0,15
    db "237+B*12*10",0,120
    db "212-212*7*4",0,0
    db "(144,1)+113/12-111-Z-3",0,113
    db "A*2/4*3*7-107",0,254
    db "117+239-(144,2)",0,88
    db "189",0,189
    db "80+125/51-'_'",0,165
    db "131/A+186+2",0,201
    db "A+75+'5'",0,138
    db "(144,0)/(144,2)+202+A-87/(144,0)",0,1
    db "(144,2)+72+8+89-108/21",0,3
    db "A*12/15-100+B/(144,1)",0,0
    db "A+(144,2)-109/51+47*3",0,150
    db "245/63-30+69+62-(144,2)",0,92
    db "'^'-130-222",0,254
    db "121-18/5+(144,1)",0,216
    db "22-146-(144,1)",0,192
    db "A*7-A",0,60
    db "83-124-(144,1)/2*7",0,63
    db "155-101-212+186",0,28
    db "B*12+185-175",0,250
    db "Z-212+';'",0,136
    db "166/7/(144,2)*4-116+156",0,44
    db "(144,2)-166-'!'",0,69
    db "98-(144,0)/37",0,6
    db "','+216+13/2+137",0,145
    db "226+37+206-A+38",0,241
    db "'R'-188+124-137",0,137
    db "80-136+'3'/75",0,3
    db "240/'D'-178+99",0,180
    db "244/B-181-(144,1)+136/(144,1)*8",0,0
    db "248+(144,2)+A-202",0,68
    db "(144,1)+126/2*2",0,66
    db "35-134+'!'",0,190
    db "203+Z+94-']'+Z",0,14
    db "1-219-214",0,80
    db "33+203-119+137",0,254
    db "240-232-187+150-(144,2)+B",0,235
    db "232-10-158-253",0,67
    db "247-44-174-160",0,125
    db "(144,2)/1/2+254-186*2",0,148
    db "137+(144,0)/'7'*8*7",0,224
    db "A+141/(144,2)+89",0,101
    db "B/2+155-111",0,54
    db "'/'/7-90/13-221+65",0,113
    db "Z+79/33-8-(144,2)-(144,0)",0,135
    db "(144,1)-157+69",0,108
    db "'!'/10+168/26-204/1",0,58
    db "33/Z+171+155+(144,0)",0,175
    db "78/5/1/3-253-(144,1)/(144,0)",0,0
    db "')'*4+9",0,173
    db "201+162/A+133",0,143
    db "116+54-'Y'+199",0,24
    db "(144,1)+(144,0)/9+57",0,61
    db "A+B+2-138",0,150
    db "135+122+(144,0)+101",0,206
    db "185/4+104-Z/1+132+22",0,15
    db "13+204+149+208/18-130",0,129
    db "208-240/42+175/5/7",0,5
    db "240/54+42",0,46
    db "244+21*3+94-206",0,171
    db "169+79+246/B",0,11
    db "100-B*2+239",0,143
    db "247/7*2/12*3",0,15
    db "190-91-(144,2)",0,87
    db "204/(144,1)+24*A",0,250
    db "120*2/'J'",0,3
    db "112-(144,2)/3/6",0,5
    db "37+241*11/24",0,10
    db "35+19+231*6/B",0,8
    db "233+(144,0)-248-(144,1)",0,149
    db "61+180-196/10*10/10",0,4
    db "Z*6/(144,2)/3-(144,2)/43",0,5
    db "42/4-239+43/20",0,3
    db "128/17*10+161-A",0,221
    db "118+A/5",0,25
    db "232/13/Z*10-218/B",0,1
    db "(144,2)-77/(144,2)+163",0,178
    db "129-(144,1)/14+'8'/Z*(144,0)",0,208
    db "(144,0)+88/9+203+Z*(144,0)/11",0,9
    db "(144,0)/A*4+175-(144,2)",0,203
    db "237/27*12-Z+120",0,183
    db "B+192/33-199/14",0,4
    db "'N'/7-34-70",0,163
    db "73-171/(144,2)+148",0,161
    db "80+157+2-110",0,129
    db "42*3-(144,1)/42-231-149+Z",0,169
    db "166/'6'*9/3",0,9
    db "21*4+','+B+A",0,158
    db "184+1+233-(144,1)",0,222
    db "138+151+74+161*7/(144,0)",0,0
    db "'+'*5/51-218",0,42
    db "73+A-197/2+175",0,246
    db "200-93+110/6*2+(144,0)",0,176
    db "175+24-240+128/4",0,21
    db "(144,0)+'O'/Z+100+16+174",0,39
    db "48/15*B+144/(144,2)",0,17
    db "189/4/13*6",0,18
    db "39-53/7-54+52",0,32
    db "'L'-B+126",0,182
    db "246/3+A-128",0,220
    db "(144,2)-9+50/10",0,5
    db "';'/18*2+137",0,143
    db "35+238-(144,1)/3+53*2",0,156
    db "193-'T'+46",0,155
    db "9*3+251-225",0,53
    db "98+132-Z/10/2",0,9
    db "250/A*A/A-A/1",0,15
    db "182+108-74+58/1",0,18
    db "0*10+217",0,217
    db "'.'-Z+202/50+25",0,29
    db "254-83+227",0,142
    db "188-57",0,131
    db "14*12-13/26",0,5
    db "230/39+184",0,189
    db "'0'+130",0,178
    db "105+B-76-98",0,207
    db "30*6/58-142",0,117
    db "'5'/12+75",0,79
    db "215/1-239+184",0,160
    db "30-239/10-B+148",0,132
    db "128/Z*7-'7'-227",0,251
    db "250/6-173",0,124
    db "40+109+42/14-Z",0,236
    db "170/B-251-'W'/17",0,10
    db "251/3-'V'+B*6/1/B",0,5
    db "4+149-A-'?'-131",0,205
    db "13/3+92",0,96
    db "84-222+190",0,52
    db "207/'$'*2+'>'",0,72
    db "230-31-243",0,212
    db "199-160-B*11",0,209
    db "84+209+22-173",0,142
    db "90-107+195+17",0,195
    db "40/8-(144,2)",0,249
    db "65-(144,2)*3+150+(144,1)",0,249
    db "96/5/5+194-(144,0)",0,93
    db "119/21*10+178",0,228
    db "182/A-187/25",0,3
    db "157+232/23",0,5
    db "213/(144,2)/2*5/9*4",0,16
    db "178/41-213/(144,0)+35",0,35
    db "(144,2)/3*9/(144,2)-(144,2)",0,247
    db "212/59-'0'+107*2",0,124
    db "245/2+104/37",0,6
    db "Z*6+(144,0)/1+Z",0,79
    db "B*6/31-'G'+161/19-131",0,129
    db "44-188-101",0,11
    db "83+121",0,204
    db "A-215+198-68-20",0,161
    db "183-135+(144,2)-119",0,197
    db "114-Z+146",0,227
    db "74/19+'^'*2-'A'/13+14",0,23
    db "113/31+38+71",0,112
    db "170-119+240+26/2",0,30
    db "225+152/5/A",0,2
    db "97+37/5+148-100/20",0,3
    db "189-219+B",0,246
    db "1-B-222+61",0,76
    db "99+A+60+7-247",0,185
    db "119-60/12",0,4
    db "B/5+132/17*9+89",0,161
    db "172+12-A+121-B",0,19
    db "192+11/1+(144,2)-203/1",0,12
    db "115/36+212+158/38-(144,0)",0,155
    db "(144,2)/1/A+A-81",0,186
    db "240+115/5-(144,1)+A",0,89
    db "63/10+89+49+22",0,166
    db "Z-225/(144,1)-A",0,246
    db "(144,0)-B-168+(144,0)",0,20
    db "B-A-'!'-192/A-A",0,250
    db "105/4-100",0,182
    db "23/2/1/2*12/15",0,4
    db "43-(144,2)+230*8/9",0,4
    db "61-(144,0)+86/6-136-180",0,203
    db "'Y'-'['-116-240/27+89",0,94
    db "Z+69/12+171-168/1-13",0,254
    db "189-106/8",0,10
    db "245-178/(144,0)+225+120",0,89
    db "12-75+227+240+5",0,153
    db "Z*6/(144,2)/2*8-208-B",0,92
    db "(144,2)*4+123+159+80",0,154
    db "252-230/(144,0)+155-A+164/9",0,5
    db "B*5-B/A-209",0,55
    db "227-43+(144,1)-238+227",0,113
    db "244/15-89/49*6",0,18
    db "187-199-51-59-139",0,251
    db "134/26*2*4-218-202",0,132
    db "'0'+100-'4'+85",0,181
    db "148-79/15+B-101",0,179
    db "106+98/8-28",0,253
    db "246/67+192/61-A+(144,1)",0,189
    db "(144,0)+6/(144,0)*10-A",0,0
    db "154-11+39+176-247",0,111
    db "235+(144,0)/14-249-(144,1)+142",0,214
    db "222-(144,2)/A-217-116",0,200
    db "109-(144,1)/17",0,9
    db "35/(144,1)*11+(144,1)-35-87",0,74
    db "13+122/27",0,5
    db "254-205",0,49
    db "88-126-64+66",0,220
    db "74/16+145-141*2*12",0,192
    db "180/Z+(144,1)+(144,1)/28*2",0,10
    db "161-87/9-109-196",0,215
    db "'_'+A+250+50",0,149
    db "168/34*11",0,44
    db "118*2/19+191/'*'*6/2",0,12
    db "(144,1)/52+B+Z*4",0,224
    db "37/A*(144,2)*7",0,252
    db "144-(144,0)-88",0,208
    db "(144,2)+(144,0)/23*7-193/17",0,5
    db "77/1/18*12-'>'",0,242
    db "195-33-20/20*10/3/1",0,23
    db "13/1*12-197",0,215
    db "Z+157-(144,2)-182+24",0,20
    db "28-131+154-109-121+31",0,108
    db "30+87/29*5+Z/8",0,6
    db "(144,0)-106+48/14-37-124",0,98
    db "188-179-75-62+39",0,167
    db "151-138*7-98+218",0,211
    db "143/')'-45-228/42*(144,2)-167",0,149
    db "'7'+90-10/B*6-40",0,252
    db "185-61/15-172/16+(144,0)",0,109
    db "27-111+167+57",0,140
    db "B-'0'-Z",0,195
    db "86+'6'+61",0,201
    db "133+25/'*'+43",0,46
    db "110/32-60-141-138",0,176
    db "231+121+112/34-Z",0,229
    db "162+207-205-144*6-(144,1)",0,180
    db "9-232/8*2",0,8
    db "150-27-108+45-26/Z",0,1
    db "91/7+254+213+B",0,244
    db "155/'$'*3",0,12
    db "B-0*11+224+117+(144,0)",0,153
    db "240/43-66/'+'",0,4
    db "193+(144,1)/(144,0)*8",0,8
    db "173+27+230-90-120",0,220
    db "Z+Z-B+115/B+179",0,187
    db "227/(144,1)-152/34*8-(144,0)",0,176
    db "232/(144,1)*7*8*3",0,168
    db "180/A*5+(144,0)-209",0,241
    db "' '/1*2/4-165",0,107
    db "191/(144,0)+112",0,113
    db "Z+42-B/6",0,9
    db "191+57+8*10*(144,1)",0,0
    db "193/36-'J'+B-(144,2)-88-(144,1)",0,167
    db "119-116+129+A/17",0,8
    db "247+217/2-67+190-242/66",0,3
    db "194+170/B+105+171/5",0,5
    db "241+B+'Q'-'G'+(144,2)-152",0,131
    db "229-86/24*A",0,50
    db "(144,0)-231+(144,2)",0,141
    db "75-']'/53-244",0,16
    db "A+151",0,161
    db "148/' '*10",0,40
    db "164-30+151",0,29
    db "194+58-195+234/9",0,3
    db "242-104+209+179",0,14
    db "(144,2)/3-Z/56",0,4
    db "147/17*6/Z",0,1
    db "220+152+101",0,217
    db "107-17+105-A+'G'",0,0
    db "252/18-179",0,91
    db "(144,0)/(144,0)-41+246/44-71",0,189
    db "35+124-208+247+39/(144,1)+100",0,101
    db "(144,1)+188-234/2+B",0,95
    db "126+173+249+128+(144,0)+160",0,172
    db "103+82-115+234-236",0,68
    db "48+'!'-85-227-(144,1)+144",0,229
    db "177+242-2/12",0,13
    db "130/41-'U'+167+(144,0)/5",0,37
    db "197+149+A",0,100
    db "106-188",0,174
    db "204/21*5/14",0,3
    db "128-105+28-184/(144,0)+188",0,189
    db "203+'='+251",0,3
    db "77+235/2/2*6-41+60",0,103
    db "156-82/14+228+6",0,239
    db "89/28+17-252+241",0,9
    db "164/A/1-A",0,6
    db "'3'+135+81",0,11
    db "104+251/27+B+Z-A",0,46
    db "A*7+5/16",0,4
    db "92/13*Z",0,231
    db "101*2-15+238/9",0,18
    db "95/6+'>'-(144,2)+194",0,3
    db "114-110+152-(144,1)-7",0,209
    db "174/2-214-Z",0,96
    db "108-159+238",0,187
    db "B-B+(144,2)-B+159+A",0,161
    db "175/39*2+106+83",0,197
    db "(144,1)/43-B",0,240
    db "192/55*12+'*'+231",0,53
    db "14+125-160/19",0,12
    db "17-'!'-40+(144,0)/6",0,8
    db "155-174/2+5+191",0,58
    db "229+55-'P'-60",0,144
    db "89-172+(144,2)/10",0,18
    db "41+B*4+230-249-124",0,101
    db "181-221/17-182",0,86
    db "(144,1)+Z/68",0,3
    db "'A'/16+(144,0)-B",0,88
    db "213/Z+237+105",0,92
    db "'3'/13+127-118+'T'+100",0,196
    db "76*2-13",0,139
    db "(144,0)+177*9/28",0,8
    db "157+(144,2)+134+134",0,181
    db "(144,2)+0-186+60",0,142
    db "244-147+13+125+101",0,80
    db "129+'1'+126-A-50-132-8",0,104
    db "49*3-173-(144,0)",0,126
    db "156-(144,0)-175",0,133
    db "215/31+A/1/1",0,16
    db "170+194*2/24+'M'",0,86
    db "150-140+134/47",0,3
    db "(144,0)+Z+(144,1)/B+100+120",0,223
    db "57-143/8*7",0,147
    db "(144,2)*12/30+204/17",0,12
    db "131+(144,0)/47+(144,0)",0,109
    db "221+B+3/55*8",0,32
    db "206-240-B/(144,1)",0,1
    db "102/28*12+194/48+119+212",0,79
    db "63+Z/22-183+153/27",0,8
    db "254-172",0,82
    db "50/(144,0)-(144,0)-211+82",0,23
    db "(144,0)/12",0,8
    db "38+99-(144,2)-211-'!'+186+98",0,165
    db "'Z'/24+203+249-194-240",0,21
    db "(144,2)-210/(144,1)",0,0
    db "191-(144,2)+118+198",0,239
    db "118-96+224-26/26-237",0,27
    db "(144,0)+253/16+53",0,59
    db "Z/(144,1)+79+138",0,217
    db "'!'-10*6-20/13+162",0,171
    db "'7'+54-124/2/17",0,7
    db "55*2+(144,1)-129",0,177
    db "3+171/53*3+144",0,153
    db "(144,2)/3-196/8+B",0,28
    db "(144,0)+(144,1)+99-146-226",0,27
    db "Z+196-Z/B+235/48",0,5
    db "(144,0)+91-152+';'+1-(144,2)-198",0,149
    db "149-211+(144,1)+217+173",0,12
    db "(144,2)+145-171-64-62-145",0,227
    db "'B'/21-140-236",0,139
    db "208/63*3*10",0,90
    db "B-84+59",0,251
    db "4-88-161+86",0,97
    db "98+(144,0)-182",0,20
    db "134/4-29",0,4
    db "42-123+(144,0)-241-35-53",0,206
    db "'H'-193+252",0,131
    db "81+214/3+183/40*5",0,20
    db "183+(144,2)+134*2+A+217-99",0,18
    db "253+144-10/4",0,32
    db "225+182-Z",0,118
    db "99-18-(144,0)+165-11",0,131
    db "122-25-'>'/5*3-B+213",0,214
    db "'0'/13*A/3",0,10
    db "22+(144,1)-10/34+56-201",0,117
    db "219+(144,0)+A-192+(144,2)",0,153
    db "A+B-8*3",0,66
    db "248/30+201-142/Z",0,2
    db "'!'/1/10+220+'#'",0,2
    db "31+13+(144,1)/36",0,6
    db "230-5-(144,0)-'7'",0,66
    db "188/20+157",0,166
    db "186-(144,1)/22/1",0,11
    db "B+134+161",0,59
    db "B/4*B+(144,1)/3",0,13
    db "105/28*12/6-'['",0,171
    db "Z-48+B",0,5
    db "3+'T'-(144,2)",0,75
    db "171-Z/26-(144,2)+B",0,13
    db "B*6-26/27+29/7",0,4
    db "110-21-'!'/14",0,4
    db "46+201+(144,0)/(144,2)+66",0,73
    db "(144,0)-12-'!'/16-67",0,192
    db "31-35-'H'-204+'B'-154",0,144
    db "51-72-166+97/A",0,16
    db "161/37-193+220/'!'",0,0
    db "223-115/B*10/14",0,3
    db "4-47-121",0,92
    db "166+150-218+B*2/61",0,3
    db "139/4-33-15+13",0,255
    db "74+11/24*5-114/7/A",0,2
    db "25/5*3-Z+175",0,157
    db "81/B+109+2+111",0,226
    db "30/2/2*3",0,21
    db "152-209+221/11",0,14
    db "A+93/B+(144,2)+205",0,222
    db "218/'*'-23",0,238
    db "179-117-(144,2)/13",0,3
    db "104+144-2-235/(144,2)",0,0
    db "13-2*7/10*9",0,63
    db "Z+97-157-B",0,209
    db "246-119+155",0,26
    db "118+(144,2)/31*10",0,40
    db "103-114-26",0,219
    db "138-14-14-234+234+101",0,211
    db "63-(144,0)+107+71+(144,2)",0,149
    db "183-151/6+208-43",0,170
    db "170+Z-126+238+13-200",0,128
    db "64/10-70+'6'",0,246
    db "46-92+(144,2)-145+(144,0)+'!'",0,214
    db "99/29*7/5",0,4
    db "130/(144,0)+90-180/(144,1)-102-129",0,25
    db "81-237+Z-230+207+A",0,120
    db "63-','-64+195+236",0,130
    db "198+23-182+15",0,54
    db "36-250/(144,2)+253+218-72",0,146
    db "'F'-55+170-29/19",0,8
    db "(144,1)-243+143-214/' '",0,4
    db "B/2*6+'N'",0,138
    db "(144,2)/1+2/2+63",0,70
    db "209+(144,0)+25/26+201+39",0,243
    db "228+(144,0)/19",0,4
    db "1-103+200-(144,1)",0,158
    db "208-170*4-A/4",0,35
    db "133+220/3+67",0,99
    db "249-B-183+'*'/B+227",0,231
    db "142-B+171/5-'>'+171",0,116
    db "209+119/11+26",0,32
    db "171+129/(144,0)*12-148",0,108
    db "214+93/8",0,6
    db "22/3-83+100-231*2",0,98
    db "61/(144,2)+'3'/2",0,28
    db "71*3-B+251+240",0,172
    db "(144,1)/28+21-169-')'",0,74
    db "130+193-160+207+103",0,217
    db "77+81-(144,1)/26+11",0,19
    db "218-186-147/29",0,4
    db "(144,0)+243/Z+249",0,251
    db "239/23*10",0,100
    db "138+193/1+210",0,29
    db "196/29",0,6
    db "(144,1)+(144,2)-A-A",0,188
    db "207+122*2-(144,1)",0,206
    db "Z/7+102",0,106
    db "109+2+211",0,66
    db "65/7-129",0,136
    db "140-Z/28+41+211+48",0,47
    db "16+250-146/14-(144,1)",0,68
    db "(144,2)*3/9+101",0,105
    db "23+'G'-18-78",0,254
    db "A*3/2/(144,0)",0,0
    db "236-85/5+(144,2)*6",0,252
    db "218-242+'R'*2",0,116
    db "166+48/'!'*3/3-(144,2)-73",0,177
    db "Z-77/8/3+235",0,243
    db "102/20*8*6",0,240
    db "(144,1)/39+250/45*3",0,15
    db "(144,1)-'0'/39",0,3
    db "93+65+130-(144,1)",0,92
    db "Z/10-31",0,228
    db "82-107-B-61-96",0,54
    db "180/55*A+188",0,218
    db "A+(144,2)+41/(144,2)",0,5
    db "35/2+253-'6'",0,216
    db "(144,0)+227/A+(144,0)+(144,1)+(144,0)",0,155
    db "155+A/23*10",0,70
    db "164/20*8",0,64
    db "3-153/9+21+189",0,221
    db "A+181+203-146+']'",0,85
    db "Z-242+75-44+19",0,97
    db "173-234",0,195
    db "235-168/12-59",0,202
    db "64-170-9-(144,2)",0,129
    db "0+27*5+163/13-6",0,253
    db "115/A*12+B+156-186",0,122
    db "4*A-231",0,65
    db "32/3*4+91+88-234+246",0,231
    db "216+232/(144,0)*3",0,3
    db "131/2/18-149",0,110
    db "95-37/16+34+250-145-82",0,60
    db "95-38/11",0,5
    db "(144,2)-187+86+127*3",0,114
    db "110+143-(144,0)-B+37+123",0,33
    db "35/1/1/2/(144,1)",0,0
    db "109/(144,1)-106+';'+36",0,245
    db "245-201-118/A*2*6",0,216
    db "0*10*Z+112",0,112
    db "(144,1)-23",0,173
    db "'V'/14-29+214+192",0,127
    db "111+B",0,131
    db "(144,2)-10",0,2
    db "125/34*11+83",0,116
    db "Z-213/15-170/13*4",0,28
    db "204+A/47+241-B",0,225
    db "92/10*7+11",0,74
    db "220+247-']'-250/32-246",0,13
    db "'I'+'!'/27+158",0,161
    db "127+251-253+32+'0'",0,205
    db "(144,2)-172+113",0,209
    db "B-B*10-233",0,23
    db "8-172+1+173",0,10
    db "165/B-B",0,244
    db "(144,0)*2-120-208-124",0,12
    db "237/74-160/4/1",0,24
    db "162/31-B-3",0,238
    db "62-(144,1)+116+93+85/28",0,5
    db "252-(144,0)/(144,1)+32-(144,1)/9",0,10
    db "'!'+(144,2)+247/6*2+87",0,99
    db "31+115/A-(144,2)-199/15",0,3
    db "'K'/(144,0)-158+(144,0)",0,202
    db "153/27*2+107",0,117
    db "67/(144,0)+93/22+(144,2)/B",0,0
    db "64-200-143",0,233
    db "16-B-193*2",0,118
    db "'X'+B-B-51-125",0,168
    db "'4'-179/A/3",0,4
    db "229/')'-137+204/20",0,3
    db "75/7+218/Z-140/4",0,30
    db "192-(144,0)+152/6*2/7",0,11
    db "'4'-225/22-239/4",0,5
    db "219/72+194",0,197
    db "244-B/A/4+215-(144,1)",0,24
    db "Z+161/2/3+82",0,114
    db "47+199-254/20-234",0,34
    db "125/14*3+160/15",0,12
    db "B-221-107/39+67",0,72
    db "254-216/8-154+131",0,237
    db "106-245+(144,1)+145/51+207-165",0,45
    db "24*3-119+110+80",0,143
    db "(144,0)-176/28",0,6
    db "115-68-132-188+A-204",0,45
    db "26*5+A",0,140
    db "249/47*5+99-216",0,164
    db "119+(144,2)/28",0,4
    db "229/70-'A'+60",0,254
    db "B/1/1/5",0,4
    db "117+118/'G'",0,3
    db "140/1-15/16",0,7
    db "(144,0)+114/32*B",0,120
    db "95+128/24*7/B+118",0,121
    db "88/26-'O'",0,180
    db "99-108+131",0,122
    db "'A'-224/24",0,4
    db "'['+84-50-124",0,1
    db "163+(144,0)-45/12*3+155",0,209
    db "178+6+157",0,85
    db "150-(144,2)-53",0,85
    db "202/'6'*7+'G'-61+142",0,173
    db "227/26*5*3",0,120
    db "240/2/24*5",0,25
    db "200/Z*7/11*12",0,36
    db "0*6-240-(144,1)/11",0,6
    db "253+15-196/(144,0)",0,0
    db "160/6+244-B/73",0,3
    db "'!'*2+191-101",0,156
    db "110/23-196*3+182/B",0,5
    db "'D'-B*2/29-189-'!'",0,37
    db "(144,0)-172-191",0,253
    db "241-34/32",0,6
    db "113/10*2-38-A-95",0,135
    db "219/'E'-6+60-185+47",0,175
    db "30/6-17+126-'U'",0,29
    db "175-200-216",0,15
    db "B-63/'!'+'!'*2",0,78
    db "210-160-88",0,218
    db "237-Z/Z*8+75",0,123
    db "211-191/5*(144,2)/8",0,6
    db "'V'-B+(144,2)",0,78
    db "B+188-116",0,92
    db "(144,0)+175+151-225",0,205
    db "32/3*4+175-31",0,184
    db "100+164*A-150/34-196",0,65
    db "135/15-190",0,75
    db "210/36+(144,0)-69*3",0,120
    db "6-174-'A'+252-194",0,81
    db "53-202/15*3+163",0,184
    db "(144,0)/12+(144,1)+A",0,214
    db "4-184-202+(144,1)",0,70
    db "34-86-'!'",0,171
    db "169-B+171/19+B/1",0,23
    db "238-A-147-227/12-(144,1)/20",0,3
    db "198-92/6*11-50",0,137
    db "217+114/11-238",0,24
    db "15/4-103+A",0,166
    db "26-23+(144,2)*8/37",0,3
    db "A-100/6+183",0,210
    db "(144,2)-(144,1)-222+170",0,20
    db "A-207/13*10/4-12",0,254
    db "136+87+120-179+148",0,56
    db "A-104",0,162
    db "B-23-(144,2)+0",0,241
    db "B*8-170+204/27",0,7
    db "'2'+5+B",0,75
    db "139+96-100/3-97",0,204
    db "'?'-117+20/(144,0)+254+212",0,212
    db "185+7",0,192
    db "138+B/3/2",0,26
    db "48/(144,0)-30",0,226
    db "(144,0)-115/69*9",0,27
    db "206-(144,2)",0,194
    db "(144,2)+47-172+215",0,102
    db "207-'V'+168-'K'",0,214
    db "(144,1)-212-'W'",0,153
    db "98-10+118+212/49",0,3
    db "A*8+211",0,35
    db "27+(144,1)/57+Z",0,36
    db "156/51-204-(144,2)",0,43
    db "92/28*B/B+B",0,23
    db "15+84+147-144/3",0,34
    db "230+208",0,182
    db "62-4",0,58
    db "182+(144,0)-219/1",0,67
    db "106-A/24-'!'+(144,0)+219",0,38
    db "48-119-46",0,139
    db "162-212+217-228+98",0,37
    db "A*10/10+51",0,61
    db "194+203-6/28+15*6",0,114
    db "B/4*2-158/24",0,4
    db "A+115-72-196",0,113
    db "(144,2)+53+(144,0)+(144,1)/23*12+38",0,86
    db "177/4-96/5+(144,0)",0,144
    db "122-248-93/5*4/(144,2)",0,2
    db "103+137+93-139/6",0,32
    db "3-142+17/7",0,19
    db "118+104+Z",0,255
    db "A*5-115",0,191
    db "39/2-223/(144,1)-180",0,76
    db "122/14-91/26-59/'!'*7",0,42
    db "124+(144,1)-161+190",0,93
    db "Z-87-'?'+64-B",0,183
    db "42*4+56+(144,1)",0,164
    db "136-35/Z*4-96/A",0,17
    db "20/Z*8",0,0
    db "83/20*A/(144,2)-(144,1)",0,63
    db "196+132+120+96",0,32
    db "(144,2)-26/8-241+91",0,136
    db "','/7-95",0,167
    db "'D'-142/B+5/B",0,0
    db "':'-185/24+23-(144,2)-13-254",0,5
    db "A",0,10
    db "220+69+'H'/B",0,5
    db "25-249+218/13+222+146",0,131
    db "42/7+(144,1)+136+(144,0)",0,186
    db "9*2-95-224",0,211
    db "28-(144,1)+144+14/13*5/Z",0,2
    db "206+A/43-131+58/26+185",0,192
    db "A-120/9",0,16
    db "B/5+(144,2)-'^'",0,178
    db "':'-121+'!'-239",0,243
    db "243-'S'+10+37",0,207
    db "(144,2)*2/2+'C'/22",0,3
    db "202+133+8+44+173",0,48
    db "199/20-(144,2)/38-186-144",0,188
    db "190-106/14-158",0,104
    db "(144,0)-234+B",0,146
    db "12*8-211+215+19+225",0,88
    db "26*7-186/60+87",0,91
    db "225-150+147-(144,2)-139",0,71
    db "252+109+127/'*'-4",0,1
    db "Z*2+(144,1)*6+238",0,18
    db "162-7-0-153+(144,1)/(144,1)",0,1
    db "59/14-253+Z-28+0",0,12
    db "30/4-'D'/60+108+185-148",0,148
    db "47/9",0,5
    db "'1'/7-227-B*3+5",0,53
    db "16-44+248",0,220
    db "52-(144,2)*3-45",0,75
    db "148+162-159-Z",0,118
    db "132-137/26-'X'",0,177
    db "'/'/5-101-20",0,144
    db "196/54-'='+52",0,250
    db "75+B-115/52",0,4
    db "169-31+Z-109*2",0,124
    db "161-148/2-113+153",0,46
    db "(144,2)-98-Z/32*4-81",0,191
    db "(144,0)/11-A-'='+161+175",0,18
    db "'$'+'!'+A+'J'/(144,1)-31+130",0,99
    db "99/14+92/9/2",0,5
    db "72+B+160-250*3",0,6
    db "93-(144,2)+150+219",0,194
    db "225/'C'-97/31+65/19",0,3
    db "102+24+90-246-151/(144,1)",0,0
    db "(144,2)+132-100",0,44
    db "137/27*8+26",0,66
    db "252+'1'+51",0,96
    db "123+112-243-B/66*3",0,9
    db "240+190+109/7",0,3
    db "62+'D'-(144,0)+188/20",0,10
    db "141-139",0,2
    db "A+43/12+161",0,165
    db "141/32-134",0,126
    db "219/(144,2)*8-164/6",0,39
    db "149+116*6-200",0,110
    db "(144,0)+109+93",0,50
    db "117-68/14*6/2",0,9
    db "143+58+191-B/10",0,11
    db "190/(144,1)+17/2-'I'/51*7",0,21
    db "91+184+251-142",0,128
    db "176/50+(144,1)",0,199
    db "18-33+96+0",0,81
    db "A-216-B/(144,0)*7*5",0,0
    db "1-'M'/39*A/3-141",0,128
    db "'-'+18+128+'P'/A",0,1
    db "192+129-(144,1)/8",0,15
    db "109/11-244",0,21
    db "148-A-Z",0,105
    db "27/A-210+43/Z-'B'-','",0,148
    db "A-17-81-227-139-115",0,199
    db "167-(144,2)",0,155
    db "236-A+25",0,251
    db "'>'/5*(144,2)-B-4-(144,0)",0,16
    db "'B'+23-26/(144,0)",0,0
    db "123*2/7/2+145+209+0",0,115
    db "138-129+A/5",0,3
    db "168+233-83*3-234",0,208
    db "Z/10*12/4",0,9
    db "248/55+Z/1*4+90",0,238
    db "234/75-109/26",0,5
    db "'?'+'W'/Z+(144,1)/19",0,10
    db "167+177+3",0,91
    db "215+36-(144,1)+86+227+Z",0,145
    db "147-170+31*3+38-171",0,147
    db "70-222+(144,0)+78/2",0,15
    db "58-(144,2)-253",0,49
    db "(144,0)/A+41*2/24",0,4
    db "(144,0)+Z+'*'+60+232",0,215
    db "(144,2)*8/21*8+56+187",0,19
    db "235/54*8",0,32
    db "191/42+181+166",0,95
    db "55-234/24*10/4",0,7
    db "20+66-122-A-21",0,189
    db "179-131/7",0,6
    db "187/(144,2)*3+21+230",0,40
    db "112+113/5+138/52",0,3
    db "30*6-6+(144,0)/4",0,5
    db "173-167*7/6*11-(144,1)-253",0,140
    db "(144,1)-212-175-49-150",0,122
    db "23-117+227/1+161",0,38
    db "(144,0)-191+Z+8/37",0,5
    db "245-A-(144,0)",0,131
    db "55-42/2*8-156",0,148
    db "252/21-150/25",0,4
    db "'_'+'*'+116-62/62",0,3
    db "157-39-'I'*3",0,135
    db "(144,0)-149/6-171",0,120
    db "(144,0)-73+103/'$'*12/B",0,1
    db "B-165/28+234",0,237
    db "158+121/4",0,5
    db "146-39-2-200+A",0,171
    db "60-B*3/(144,2)",0,10
    db "246/'9'-23/B/1",0,11
    db "137-200/28*'!'",0,198
    db "82/23-249+A-152",0,124
    db "81-232/B",0,5
    db "208-148+239-188",0,111
    db "236+149/41+231",0,234
    db "')'-41+182-70",0,112
    db "232/22-'!'+185-237/52",0,3
    db "177-B+33+79",0,13
    db "31/9+131+128*8-24",0,24
    db "182-116-56*(144,2)",0,120
    db "28-59+203+146",0,62
    db "70/(144,2)+122/35+123/(144,2)",0,10
    db "121-A-5/34*11*7",0,231
    db "'!'/10-239/4",0,5
    db "117-116+46+104/12+129",0,141
    db "B-247-186+197*5+71",0,15
    db "4-118-61+B/15",0,6
    db "'C'-0/9+102",0,109
    db "251+181",0,176
    db "35*6+B+(144,0)",0,78
    db "101+98+224+3/11/(144,1)",0,0
    db "'3'/15+246+156",0,149
    db "10*2*5/A+68-189",0,145
    db "38/1+153+102*2",0,74
    db "(144,1)/'@'+130/1-42",0,91
    db "17/1+115/33",0,4
    db "128/38-(144,2)/47",0,5
    db "'A'/10+247+121/38",0,3
    db "150+129+178+138-178",0,161
    db "73/10",0,7
    db "230/'8'*2*12/22",0,4
    db "133+B-224+Z+B",0,238
    db "(144,1)-155+37/3",0,26
    db "(144,1)/63+A+188/12",0,16
    db "179-93-Z/4",0,13
    db "138+'/'/38",0,4
    db "(144,1)-109+1",0,88
    db "149/(144,2)+'='/Z",0,2
    db "B/(144,1)*2-B+69/10+189",0,193
    db "Z-3/1/6",0,5
    db "142-211",0,187
    db "(144,2)-(144,1)-4-6/9",0,6
    db "41/4+241-172+'9'/2",0,68
    db "117-189-251-'V'-'!'+' '+213",0,59
    db "125/9/3",0,4
    db "1+181-218/40",0,5
    db "79+113/53+204/22+206",0,215
    db "19-15*A",0,40
    db "146-134-(144,1)+A",0,82
    db "158+129/2*2*2-251",0,65
    db "158-196/6",0,36
    db "107/33*7-225",0,52
    db "105-(144,1)+65+'8'+84+229",0,87
    db "128/27-250-'Y'",0,177
    db "105-200+204+251",0,104
    db "169-158+131",0,142
    db "80-A",0,70
    db "(144,2)+B-142+A-143",0,13
    db "250-101/6+205-182",0,47
    db "10-105-117-46-22",0,232
    db "244/(144,0)+159/20-67",0,197
    db "B/3+18/(144,1)+'O'",0,79
    db "30*7-191+B/3+32",0,45
    db "127+B+178-(144,1)",0,129
    db "249+A*4*3",0,36
    db "66+223+':'/4",0,22
    db "B-106/50+190",0,193
    db "144/36+62/4",0,16
    db "247/12*6/9+B",0,33
    db "156+169+1+33",0,103
    db "19/A+223-(144,1)",0,28
    db "109/26*A+225",0,9
    db "199/Z*10/19-5",0,254
    db "114/25+240/'D'",0,3
    db "8-254+148",0,158
    db "112/(144,0)-8/(144,1)-92",0,165
    db "'Z'-189/43-(144,1)+20",0,83
    db "103+(144,0)+64-A*6+253/5",0,5
    db "6+245-39",0,212
    db "147+126*2-(144,1)+62",0,156
    db "(144,0)+140+33",0,21
    db "253+154/8*4",0,72
    db "241-228+(144,1)/41+(144,1)",0,201
    db "228/39*11/17",0,3
    db "215/A-41",0,236
    db "(144,2)+'('/13",0,4
    db "'?'-123/6",0,32
    db "6+(144,2)*9-1/16-(144,1)/3",0,23
    db "139+B-16+A",0,153
    db "56+145+95/3/B",0,0
    db "227+211-205/B",0,11
    db "175/15*(144,2)/34*(144,2)",0,36
    db "169/50-67/21*6/10",0,5
    db "153-79-'W'+28/3+27/B",0,1
    db "144-123/5-238-Z-'2'",0,195
    db "11+76+Z-143",0,233
    db "179-0-157/5",0,4
    db "155+178*3",0,231
    db "49*5/'-'+2",0,7
    db "90-A/(144,1)+204-126+201",0,23
    db "181/'!'*5",0,25
    db "'Z'-201/34-124-251",0,141
    db "192-(144,1)+150-191+232+161",0,92
    db "150-230-221/47+130/8",0,16
    db "9-B-250/50-160-0",0,101
    db "240/60*9-229",0,63
    db "Z+34+176/62*10*8",0,240
    db "27/2/2*Z-214",0,240
    db "36-22+58+207",0,23
    db "189+119-A-103-35/16",0,10
    db "A-(144,2)/69+237+'Y'/12-210",0,52
    db "214-99+225-122+248",0,210
    db "46/13+'!'/3+243-3",0,252
    db "240-249+57",0,48
    db "19/2*10-(144,0)",0,242
    db "(144,2)+106+'X'/A",0,20
    db "(144,2)*2-66+28+126",0,112
    db "15/4*4-23-120/28",0,4
    db "186+197-(144,1)-178+A",0,19
    db "200/50-194+136/'8'",0,3
    db "222+202-(144,0)",0,64
    db "164+161+98+51",0,218
    db "167+233+'F'",0,214
    db "41/1/2/3",0,6
    db "245-115-153-142/6-69/18",0,11
    db "37/2/5*12/(144,1)",0,0
    db "120/7+159/9+8+233",0,4
    db "32-(144,0)-A+(144,0)*11",0,242
    db "205-34-171+140-3/21-154",0,108
    db "146+193-118",0,221
    db "B+253-Z+106",0,90
    db "(144,2)/1-201-207+12",0,128
    db "172+64-241+125-213",0,163
    db "37+115+74-172-230",0,80
    db "74/17-2-232-201",0,81
    db "232/60*4+227/69",0,3
    db "143+226+127-138",0,102
    db "18-221+172-219",0,6
    db "(144,2)*8/16",0,6
    db "186+(144,1)-158-23/'4'",0,3
    db "'%'/5+164",0,171
    db "(144,2)-26-','-179+250",0,13
    db "A-219/9*6*3",0,90
    db "32-61+217-102",0,86
    db "145/16+85+(144,2)+253",0,103
    db "208/35*Z/44",0,3
    db "B*3/Z+102",0,103
    db "25+29+235+17",0,50
    db "A-251+41-161/31-226",0,34
    db "B-60/(144,0)*4",0,8
    db "(144,0)/16+96+175*8",0,168
    db "158/22+239/'0'-Z+B",0,248
    db "54+12/17",0,3
    db "')'+B-117-(144,0)-168",0,184
    db "(144,2)-180+'5'/40*2",0,6
    db "178+226-123-72-242",0,223
    db "B-227-23*4-72-89",0,199
    db "(144,1)-236-194+246",0,12
    db "'E'-6+211-203+1",0,72
    db "Z+117/'!'+114/1",0,118
    db "198+239-238/B",0,9
    db "0-176/19",0,4
    db "45-251-(144,2)/5+19",0,26
    db "147+29-Z",0,143
    db "254+A-(144,2)/64",0,3
    db "168+B-118/5",0,14
    db "247/'@'*4",0,12
    db "17+90/26",0,4
    db "(144,1)+Z-(144,1)*7",0,231
    db "60+182+217+230",0,177
    db "214+64+6+209+159-187",0,209
    db "169/24-49-(144,0)-21-86",0,3
    db "228+154-72*3",0,162
    db "51/16-142",0,117
    db "B*2+223+(144,1)/16",0,12
    db "12*8-(144,2)",0,84
    db "186-161+241*B+(144,1)",0,140
    db "130-B/18+176-216-139",0,83
    db "211-32/'+'",0,4
    db "28-154/40",0,3
    db "185-50+171/7+26+110",0,143
    db "194/(144,2)/A+(144,2)",0,13
    db "28*9/40+(144,0)+184",0,38
    db "B/2*10",0,100
    db "225+(144,2)/41",0,5
    db "243+197",0,184
    db "86-A-116-(144,2)",0,204
    db "236/61*3-35",0,230
    db "159/'+'-98",0,161
    db "212+Z/73+73/10-39",0,224
    db "155/20+14/3*3",0,21
    db "130/25+8",0,13
    db "149-127+148-(144,2)+85/Z",0,7
    db "68/3-79/(144,1)",0,1
    db "113/29+131",0,134
    db "')'+104-111-11",0,23
    db "104/21*12+76/8-181",0,90
    db "9+(144,0)/18-131/28+'!'+26",0,63
    db "251-B+122+254",0,95
    db "249/39*8+241-234",0,55
    db "A*7-12+210-40",0,228
    db "27/8-40-235+20",0,4
    db "B+0/4*2-247-216/17",0,3
    db "19+237+217-Z-208+107/12",0,6
    db "177-209+34*10-6",0,14
    db "106-'O'/3*(144,2)-146+(144,0)",0,66
    db "211+A-225",0,252
    db "227/(144,2)-149-B",0,105
    db "37*6-127-'?'-96+';'",0,251
    db "223-64+174/B+(144,2)",0,15
    db "218/11/(144,1)*7*8",0,0
    db "193-218/A",0,23
    db "'Z'+152/44*8",0,40
    db "(144,0)-243/20*12",0,60
    db "141/12/2",0,5
    db "139-178/29*4-173",0,111
    db "156/22-B+223/25",0,8
    db "102+52+190/2/3/1",0,14
    db "115/(144,0)+207/43+(144,2)+25",0,41
    db "160-161+'E'/3/3",0,7
    db "187/44+190",0,194
    db "(144,2)+','/8*12*2/10",0,16
    db "A-159+(144,1)-(144,0)/1/13",0,15
    db "72+99/Z",0,5
    db "136/26*9",0,45
    db "46-39*4*5/(144,1)",0,0
    db "Z/(144,2)",0,2
    db "(144,1)+44-176*3",0,192
    db "129/42*9/8*3",0,9
    db "16+203+97-220",0,96
    db "111-223+247+111",0,246
    db "'!'+179+B-'^'",0,138
    db "A+145+31/42-111/44",0,3
    db "152-244+200/21",0,5
    db "Z*5/32",0,5
    db "59/4/3-149/20*12",0,60
    db "122/26+64-186-136+B",0,22
    db "252/26+165+A+(144,1)",0,124
    db "138/12*8-'^'",0,250
    db "201-225-205",0,27
    db "165+202-68+(144,0)",0,147
    db "166+177/27+20-147/'#'",0,3
    db "222/46+127/B+62",0,68
    db "207-111/4/7+137/3",0,46
    db "42+175/59",0,3
    db "5*4*7+18",0,158
    db "194+B",0,214
    db "88/1+161",0,249
    db "159-'7'",0,104
    db "136+B-(144,1)-142",0,74
    db "139/24+144-Z",0,116
    db "212-68-(144,2)+59-237/9",0,23
    db "58/5+100+164",0,19
    db "Z*2-143+180",0,103
    db "171/3-235/(144,0)",0,0
    db "(144,0)-24-Z+(144,2)/17",0,3
    db "170-(144,0)/8*5",0,40
    db "0*B+23/4+A-138",0,133
    db "191-198-177*2+112*4",0,0
    db "229+154-B-(144,1)/(144,0)+'='",0,62
    db "82/25-168",0,91
    db "Z/9+35+A",0,48
    db "9*3-241/(144,0)*3+(144,2)-148",0,120
    db "33-103-187",0,255
    db "148-Z",0,115
    db "164+210/17+129/32",0,4
    db "(144,1)/16+5-B/Z-164",0,99
    db "212+15/16*3-'#'*11",0,77
    db "87/4-157",0,120
    db "48-(144,2)+92-222",0,162
    db "121-234/30+225",0,229
    db "246+68/18-92",0,167
    db "16-120-50+129+202-B-101",0,56
    db "210/Z-112-B+197",0,71
    db "228+137-225",0,140
    db "166-(144,1)-108-120+'L'",0,74
    db "13/3*2*4*6",0,192
    db "192/32+(144,0)-98+142",0,154
    db "12+55+136",0,203
    db "244+202-194/3",0,84
    db "38-(144,1)/B",0,4
    db "138/30+32-214/13",0,6
    db "67/5/3+117",0,121
    db "176+251-(144,1)/(144,1)",0,1
    db "99-40",0,59
    db "162+21-A",0,173
    db "136-(144,2)/Z",0,3
    db "(144,0)-22+221+'E'",0,116
    db "9-(144,2)-20/(144,0)",0,2
    db "(144,0)-134/68-187-(144,1)",0,132
    db "226/'/'-218/11-Z/2",0,113
    db "230+30",0,4
    db "172-214+234-1",0,191
    db "32+206+173-'!'",0,122
    db "235+216-157/1",0,38
    db "40-11-B*12+89",0,197
    db "224+B/22",0,11
    db "211-188*6+A",0,148
    db "';'+101+24+A",0,194
    db "Z/A+34+110/27",0,5
    db "Z-111-'8'",0,122
    db "163/39*5/2",0,10
    db "32+1/3/2*A",0,50
    db "'S'/11-5-81",0,177
    db "44+38-6",0,76
    db "15*3/(144,1)",0,0
    db "97+143+(144,0)-142",0,202
    db "45-42-(144,2)/50*8-B",0,12
    db "173/29+86-227-69-'.'",0,5
    db "(144,1)+137+(144,0)+250-10+(144,0)+B",0,33
    db "162-(144,1)/60",0,3
    db "(144,1)/Z-166+176+101+250+4",0,114
    db "246-126+129",0,249
    db "160-227+66+212",0,211
    db "126-47-(144,2)",0,67
    db "A+205+123/11+28",0,35
    db "(144,2)/1+Z",0,45
    db "(144,1)-(144,2)-149/7+32+229",0,10
    db "129-238-23-159",0,221
    db "178-Z/'#'+51-(144,2)-41",0,2
    db "84-66+105-227",0,152
    db "B*11-166-79/36",0,6
    db "214-245-'4'/3",0,57
    db "188-164/1/4",0,6
    db "171-102/3-A+A-72",0,207
    db "72/(144,2)+252-161+240",0,81
    db "A+26+155",0,191
    db "73-(144,0)",0,225
    db "240+117+239/Z",0,2
    db "193-186+150+'N'+(144,1)",0,175
    db "14+162/9-77",0,198
    db "136-107-153-19",0,113
    db "102-172",0,186
    db "235-15-'!'-'!'",0,154
    db "187+151-44",0,38
    db "(144,2)*5+(144,0)/(144,1)*10",0,0
    db "203/27-249-246",0,24
    db "';'+192",0,251
    db "B*6+205+12-226",0,111
    db "10*2/(144,1)+20+179",0,199
    db "158/6/1-228",0,54
    db "'O'*2/29+250/3",0,85
    db "27*9+(144,1)-(144,1)-B-105/35",0,3
    db "226-240/77*8+205",0,229
    db "160+204-Z/9",0,8
    db "'Q'-141+'B'*5+132",0,162
    db "'6'+(144,1)+'O'*3-117",0,102
    db "129+209-(144,0)/(144,2)*9-Z",0,138
    db "206/14*11+29-5",0,178
    db "B/(144,2)+119+189",0,53
    db "167+197-211-33",0,120
    db "197/(144,1)+(144,2)*9+130",0,247
    db "6*2/1",0,12
    db "169-242/(144,1)+130+(144,0)",0,234
    db "99-205-60/Z",0,2
    db "25-83/58-B",0,239
    db "247-199/3+199",0,215
    db "194+A-208/Z-196",0,67
    db "Z/B-41",0,216
    db "A-223-190/22+226",0,230
    db "233+224-216-'X'",0,153
    db "164-222+25+(144,0)",0,71
    db "(144,2)-197/17-79-133",0,48
    db "8+142-30/15-133",0,131
    db "99/(144,1)-248*8",0,64
    db "253+217/12*2",0,34
    db "184-A/29-109-140",0,13
    db "31*2+144",0,206
    db "B/5-12-B-176",0,52
    db "193-138-125+31",0,217
    db "195-148/2/4+175",0,180
    db "205-171*5/41",0,4
    db "126-252-190+74+114-238",0,146
    db "'^'-245+244+152",0,245
    db "A+Z/B",0,2
    db "88/8*9+A/30",0,3
    db "A+141+Z",0,184
    db "(144,2)-A+25*3+130",0,211
    db "173+177+Z-194+249+B",0,202
    db "A-27-(144,1)-188-171/20",0,9
    db "66-59+35/5+218/49-17",0,243
    db "0+(144,1)-171/5*6+(144,1)",0,226
    db "235/A-227-181",0,127
    db "149+(144,2)-191-39",0,187
    db "142+144-187-A",0,89
    db "200/57*6*10",0,180
    db "(144,0)-189/49-182-206",0,127
    db "3*4/2-192+217",0,31
    db "250+1-211-83/7/7",0,4
    db "(144,0)-4+57+A",0,167
    db "87-167+104-'^'-A+68",0,244
    db "223-136/19+237-'!'",0,208
    db "213/')'-222-192-141-80",0,138
    db "31*8+185/21-174-B",0,70
    db "160+209-150",0,219
    db "173+A+107-133+23/18+65",0,75
    db "'!'*5/28*6/7*10+109",0,149
    db "104+1-(144,0)",0,1
    db "230-(144,1)-223+192",0,3
    db "10+'3'+242-38",0,9
    db "5-250-147+87",0,207
    db "B/4*7+(144,1)",0,231
    db "(144,0)/3/3/2",0,5
    db "46-9+167-161",0,43
    db "(144,0)/2-95-210",0,3
    db "191-216-171-127",0,189
    db "149+86-170+72/17+149+28",0,185
    db "1*11*12+85",0,217
    db "179/'.'-84",0,175
    db "19/3+0*11",0,66
    db "179-216-B",0,199
    db "(144,2)-132-219",0,173
    db "202-184+141+69+202-188",0,242
    db "Z+(144,2)/10*8",0,32
    db "A*A/12",0,8
    db "179-7/55+(144,0)/(144,0)",0,1
    db "129/13+180-181",0,8
    db "38+232-'/'/A/2",0,11
    db "7-B+(144,0)/26-(144,0)",0,155
    db "104/A-165+24",0,125
    db "B-132/16",0,9
    db "114/A+0",0,11
    db "B+A-219+210+34",0,55
    db "136-96*5+12",0,212
    db "(144,0)+Z+111+(144,2)-91",0,169
    db "79-148-147*5-(144,0)",0,96
    db "4*6-208+141+208+(144,2)",0,177
    db "197-165+249+(144,1)",0,221
    db "'!'-211+(144,0)-16-B",0,146
    db "49/8-177+128",0,213
    db "85-178+209-253-101",0,18
    db "251/32*12-48-241/13-83",0,176
    db "43/12+159-(144,0)-218",0,96
    db "86/24+38*4",0,164
    db "129+71/1",0,200
    db "108/26+134-239",0,155
    db "A-(144,2)",0,254
    db "108/21+6",0,11
    db "A-A+124-117",0,7
    db "126/25-142-89/1",0,30
    db "223+98-162+38/1",0,197
    db "B/1+187",0,207
    db "75-41+170+123",0,71
    db "20+1+168/6-203",0,84
    db "144+A/24",0,6
    db "2*3-127-138-74+Z+B",0,232
    db "108/21-114",0,147
    db "B/1-251+164",0,189
    db "103/24*2-153-158+225",0,178
    db "A*2/3+23",0,29
    db "32-198+')'",0,131
    db "232+'0'+Z-Z-231/B",0,2
    db "(144,1)-(144,0)-(144,2)+220-243",0,57
    db "234-(144,0)/14*11",0,99
    db "Z-144/17*7/(144,0)",0,0
    db "167-150-134/29",0,4
    db "179+207-72-B+229",0,11
    db "(144,2)*5+63-122*4-'V'",0,174
    db "(144,0)/23+244-94+198",0,96
    db "9+20*7",0,203
    db "21+137-78+186*7",0,70
    db "(144,1)/'3'*6/(144,1)+149",0,149
    db "203/21-122-'G'",0,72
    db "119/4+248-184/(144,1)",0,0
    db "141-100+118-242",0,173
    db "177+102*5+46-91",0,70
    db "172-21+28+A",0,189
    db "B*11/39*6+156+95",0,25
    db "107-126/'#'*7",0,42
    db "195-A-241-20-78+Z",0,135
    db "19-245+12+'H'",0,114
    db "Z-92+Z-207",0,23
    db "'K'+238/16-17",0,242
    db "Z/(144,2)+209-(144,1)-51",0,220
    db "138/7+235-209/1/3",0,15
    db "244-6+222-43/38+221",0,225
    db "209/'1'*11/(144,2)",0,3
    db "A+110+(144,0)+165-191+'I'",0,15
    db "(144,1)",0,196
    db "10+A-116-230+123/1+47",0,100
    db "225/20/2-127",0,134
    db "A+252+12-239-(144,0)+(144,2)-198",0,1
    db "115/1-4+189",0,44
    db "61+245+Z-65",0,18
    db "241-A+114-107/69+(144,0)",0,107
    db "247+245/54-223-'Z'",0,203
    db "(144,2)/2*7+(144,0)-152",0,250
    db "54+29/20-A",0,250
    db "4+199+(144,0)+244",0,39
    db "162-240-116+60/19",0,6
    db "221+(144,2)/6-133/44-92",0,167
    db "193-204+174+12",0,175
    db "' '/8*11+117-(144,0)/12",0,4
    db "7*5-'7'-97",0,139
    db "';'-246-(144,0)+33/'!'",0,7
    db "7+131",0,138
    db "199/(144,2)/1-221",0,51
    db "84-27",0,57
    db "69/7+83-147",0,201
    db "A+(144,0)/'#'*A",0,30
    db "4*A/10",0,4
    db "(144,0)+Z-10-148",0,235
    db "25-13*2+206-(144,2)/(144,1)",0,1
    db "(144,0)-B+100/10*5+'E'/A",0,15
    db "171+175/14-16/Z",0,7
    db "27/1-165",0,118
    db "A+164+126/(144,1)+158",0,158
    db "187+176/15+(144,0)",0,111
    db "20-222-(144,2)+62/17",0,6
    db "98+6/23",0,4
    db "(144,1)-136/(144,2)+108/(144,2)",0,9
    db "77+212+(144,1)",0,229
    db "162-213+(144,2)+206+(144,1)",0,107
    db "'!'*2+37+13",0,116
    db "66+86/'('",0,3
    db "218+B-19/(144,0)",0,2
    db "150/25*11+156+5-11/12",0,18
    db "85+211/6+224",0,230
    db "B+28+'2'+15-B+246/24",0,3
    db "4+108-140",0,228
    db "198/52+164",0,167
    db "10*B/62+'4'/(144,0)*(144,0)",0,0
    db "'W'+117/25*B",0,160
    db "167/B",0,8
    db "113-219+82-211-A",0,11
    db "(144,1)/30-126/32-(144,2)",0,248
    db "17/1/2-142-'/'/Z*8",0,16
    db "86/17-216+247+136",0,172
    db "':'-226/25*8*7+A",0,178
    db "12-127/29*10/5*4",0,32
    db "119-214/16-248*2/11",0,3
    db "241-(144,2)-121-(144,1)",0,168
    db "251+Z/7*7",0,28
    db "Z/5*(144,2)/18-7",0,253
    db "97-'I'-(144,1)+140-59",0,165
    db "1+4",0,5
    db "72/21*8/6*Z+86",0,218
    db "'!'+Z*3+153",0,95
    db "38-234-A+144",0,194
    db "132-54-115-135",0,84
    db "94/2/13*10",0,30
    db "152/(144,2)-96-220-116",0,92
    db "250+(144,0)/B*11",0,44
    db "88/6-B+(144,2)",0,6
    db "189/16+202+212",0,169
    db "124-A-100-(144,0)-207",0,215
    db "(144,2)-242/3-162",0,102
    db "A*5+9+185/28*11-1",0,87
    db "236-153+151",0,234
    db "99+31+'Q'",0,211
    db "82-158/54*11*6/14",0,14
    db "2+10+33/8*Z",0,165
    db "72+151+'_'+135+(144,1)",0,137
    db "218-118+(144,0)+168+B",0,136
    db "146/7+' '+'A'/(144,0)",0,1
    db "167-'!'+Z+176",0,87
    db "Z/3/(144,0)+231",0,231
    db "180+41-178*3/')'-172",0,87
    db "Z+'8'+79/16-')'",0,225
    db "171-193+27-136+145-225",0,45
    db "51+160",0,211
    db "73/8*2*2-187/1",0,105
    db "163/47*2*B",0,120
    db "85/5+113",0,130
    db "58+96/20+8*9/'!'",0,4
    db "72+216+'1'*2",0,162
    db "20+B/12-76-(144,1)/70",0,3
    db "138+11/30-B+204-209",0,235
    db "22/2+B-(144,1)-125",0,222
    db "171-67+93+6+252/56",0,3
    db "(144,0)-B*2/30+69-195",0,135
    db "'F'-46/6-(144,0)",0,156
    db "Z-119/26-Z",0,229
    db "114+23-140+(144,0)+211",0,56
    db "127-204-162-95-40",0,138
    db "(144,0)/8+132-250",0,151
    db "21-23/(144,0)",0,2
    db "177/15+144+3/5/(144,2)",0,2
    db "(144,1)/'9'-174+'$'",0,121
    db "129/40-155+98",0,202
    db "213-117",0,96
    db "86/3+83",0,111
    db "233-2+(144,0)-73",0,6
    db "77/16",0,4
    db "Z-A/5*11+216*2",0,8
    db "136-203/53",0,3
    db "190-241+230",0,179
    db "(144,2)/2*11",0,66
    db "12+126/14-7-(144,2)/4",0,61
    db "75-B/15",0,3
    db "27*9-(144,1)+41/7",0,12
    db "250+185+Z/44-5",0,255
    db "A*10+(144,2)+161/4+233",0,237
    db "130/22-(144,0)+B-253-59/'#'",0,3
    db "86/A+54/13-46+211",0,169
    db "212+113-225+108-186-140",0,138
    db "234-22+66/4+250-Z",0,222
    db "78+A/27+(144,0)",0,107
    db "113-149+52+(144,1)-(144,2)",0,200
    db "199+(144,2)-110+'8'-(144,1)",0,217
    db "125/9+102-232",0,139
    db "60+'!'/(144,0)-B-233",0,3
    db "14+244-107/10",0,15
    db "128/9-124-(144,2)+65",0,199
    db "112-217-76+241",0,60
    db "226/45",0,5
    db "72+109-209/'0'-(144,2)",0,248
    db "(144,2)/2+176/55",0,3
    db "(144,0)+(144,2)+(144,0)/'4'*3+A",0,22
    db "132/5*4/6",0,17
    db "192+103/9-151",0,109
    db "79/12-207/4/(144,1)",0,0
    db "187/B-135-199",0,187
    db "122/15+148-100",0,56
    db "224+118/26+158",0,161
    db "219+161/(144,2)*2*6",0,120
    db "A-161/27*10",0,30
    db "136-221-19-(144,2)/' '",0,4
    db "(144,2)-87-113-98/'B'+202/55",0,3
    db "250/62+229",0,233
    db "60-Z/7+173/30",0,5
    db "133/31*3-155",0,113
    db "106*2/3",0,70
    db "198/6-101+15-(144,0)",0,99
    db "'2'*3+197-A",0,81
    db "235-243+(144,2)-129",0,131
    db "(144,2)-194+B-25-211",0,114
    db "221-138+(144,2)-(144,1)",0,155
    db "222-188-220-B",0,50
    db "(144,1)+(144,0)-(144,2)/1+220",0,252
    db "93/(144,1)-21-16-132/25+'!'",0,36
    db "146+(144,2)/51-25",0,234
    db "108-(144,2)/24*4-212",0,60
    db "(144,1)+121/12",0,5
    db "66-206-87+(144,0)+249/7/2",0,9
    db "219-(144,1)/6-217-224-38+104",0,140
    db "97-5-185",0,163
    db "49+(144,2)-93+206+197/2",0,57
    db "134-135/34+175+(144,0)+Z+20",0,83
    db "(144,2)+123-83*3+26-159",0,23
    db "39+(144,2)+62-49",0,64
    db "27-125+180-249-160+67",0,252
    db "36/10-(144,0)-181",0,230
    db "60/3/A",0,2
    db "109+143+172/1-193",0,231
    db "68+43+132/'$'-200/5-175",0,93
    db "75+176+125+125",0,245
    db "62-47+234/64*3*12",0,108
    db "151-'!'*2-197",0,39
    db "'U'-166+103/1/A*6-135",0,133
    db "97+Z-A+178",0,42
    db "57/2/A*12",0,24
    db "Z+138/13-25-254",0,246
    db "244/60*A/11-8+225",0,220
    db "45-'F'-(144,2)+162-41",0,84
    db "135-229/6",0,27
    db "237-'%'",0,200
    db "113+'G'-189+123+215/24",0,3
    db "216/16*3*4",0,156
    db "(144,2)*2*9/18/3+B",0,24
    db "222+128+147-(144,2)",0,229
    db "127-227/21",0,7
    db "159/21",0,7
    db "B+150/'6'-123",0,136
    db "39-163/'%'*12+176+111-135",0,188
    db "52+211-183-227-239-10",0,116
    db "107+28/19*2+239-71+'2'",0,232
    db "61/(144,0)+A-17",0,249
    db "15/3+208-143-119",0,207
    db "132+164-40*(144,2)-105/(144,0)",0,1
    db "84-34/10+35",0,40
    db "141+136-8-136+A-102*5",0,205
    db "115-66-98",0,207
    db "39-253-242+74+45+(144,0)",0,23
    db "138",0,138
    db "137-75-(144,2)/(144,2)",0,4
    db "123+32-63/14-184",0,78
    db "12+98+81",0,191
    db "180-59-34+220/8",0,6
    db "61+68+30",0,159
    db "B/1*3-70-6-138",0,102
    db "72/14-11+54+181",0,229
    db "35*3/(144,2)-15-229",0,20
    db "'_'+B+A-186+(144,2)",0,207
    db "155+143-111-'!'+125",0,23
    db "59-29+179/4",0,52
    db "39-122+221",0,138
    db "33-':'/62*7*12",0,252
    db "130+62+187+208/7*B",0,200
    db "46+115/20-224",0,40
    db "'+'/6+224-107",0,124
    db "B*12/'O'+15",0,18
    db "(144,2)*10-82",0,38
    db "B/B",0,1
    db "91+47+247+32-203+60",0,18
    db "105/19-118/41-85",0,174
    db "112/35",0,3
    db "235/60-232-A/3",0,5
    db "Z*2/6/2-178",0,83
    db "(144,1)-54-177+138-25",0,78
    db "121/20",0,6
    db "201/27*12+138-Z",0,189
    db "113+B/11/3*11-32",0,12
    db "198/48*6+151-A",0,165
    db "(144,0)-172-162-125+(144,1)/6",0,16
    db "14/3*8+157+173",0,106
    db "40+213",0,253
    db "68-149+153-117/62+208",0,211
    db "(144,1)-88/14*(144,2)-'-'",0,39
    db "215-9-152+41",0,95
    db "44*4/46-118",0,141
    db "187/8",0,23
    db "174+249-156/2-182",0,79
    db "225-A-199/B+197",0,197
    db "160/36",0,4
    db "137+213-108-167+32/B+204",0,209
    db "A+A-(144,0)/(144,1)*(144,0)",0,0
    db "(144,2)+239/12-157+33-62",0,90
    db "180+193-182/20+41+231",0,25
    db "65/(144,1)-52-178",0,26
    db "115-40+150+45",0,14
    db "183+217/33-A+27",0,21
    db "Z/4-97/20-B",0,244
    db "250-12-206-57+213",0,188
    db "137-'I'/13+119",0,123
    db "B*(144,2)+4+48",0,36
    db "29+241/2*'!'",0,231
    db "210/38+178",0,183
    db "247/5+186-211*2/11",0,4
    db "144-0-153-89",0,158
    db "173/25*6+A-A",0,36
    db "223/(144,1)+32+114",0,147
    db "53+12",0,65
    db "(144,0)-144/'*'*3",0,15
    db "150+187-77",0,4
    db "236+186+228-158",0,236
    db "177-27-102/14",0,3
    db "122-(144,0)-107",0,167
    db "254+170+219+208+187",0,14
    db "26+155/28*4-33/49",0,5
    db "Z-161/35+249",0,252
    db "47/1+(144,1)/A*5-231",0,145
    db "179+198-178/5/8+170",0,174
    db "249+250+58-124+11-252",0,192
    db "145-180+A-222+121+A+209",0,93
    db "238/37-B/44",0,5
    db "218-197*5+4+105/4",0,53
    db "91/3+A/5+(144,0)",0,112
    db "'7'/6*10",0,90
    db "146-9-109/4",0,7
    db "201-48+52/11+28",0,46
    db "235+B/(144,1)",0,1
    db "(144,0)-Z-180+'Q'",0,228
    db "118-177+250/18",0,10
    db "207+124+29+40-22",0,122
    db "12-185/22-124",0,135
    db "25/(144,1)*(144,2)",0,0
    db "143+227-(144,1)-248",0,182
    db "133-234+'M'/B",0,11
    db "39/A+59+(144,0)-123/11",0,3
    db "244/56-104-103-249+127",0,187
    db "218-225+170/45",0,3
    db "251+162/B-(144,0)",0,159
